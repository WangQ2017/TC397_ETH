AUTOSAR XML (schema 4-0-3)
package /MICROSAR
  bsw implementation BswM_Impl: programming-language=C, sw-version=14.00.00, used-code-generator=DaVinci Configurator, vendor-id=30, ar-release-version=4.00.03, behavior=BswMBehavior
  bsw implementation EcuM_Impl: programming-language=C, sw-version=10.00.02, used-code-generator=DaVinci Configurator, vendor-id=30, ar-release-version=4.00.03, behavior=EcuMBehavior
package /MICROSAR/BswM_ib_bswmd/BswModuleDescriptions
  bsw module description BswM
    bsw internal behavior BswMBehavior
      exclusive area BSWM_EXCLUSIVE_AREA_0
      6 x bsw schedulable entity:
        BswM_MainFunction_OsApplication_OsCore5: implemented-entry=BswM_MainFunction_OsApplication_OsCore5
        BswM_MainFunction_OsApplication_OsCore4: implemented-entry=BswM_MainFunction_OsApplication_OsCore4
        BswM_MainFunction_OsApplication_OsCore3: implemented-entry=BswM_MainFunction_OsApplication_OsCore3
        BswM_MainFunction_OsApplication_OsCore1: implemented-entry=BswM_MainFunction_OsApplication_OsCore1
        BswM_MainFunction_OsApplication_OsCore2: implemented-entry=BswM_MainFunction_OsApplication_OsCore2
        BswM_MainFunction_OsApplication_OsCore0: implemented-entry=BswM_MainFunction_OsApplication_OsCore0
      6 x bsw timing event, all with period=0.01:
        BswM_MainFunction_OsApplication_OsCore5TimingEvent0: starts-on-event=BswM_MainFunction_OsApplication_OsCore5
        BswM_MainFunction_OsApplication_OsCore4TimingEvent0: starts-on-event=BswM_MainFunction_OsApplication_OsCore4
        BswM_MainFunction_OsApplication_OsCore3TimingEvent0: starts-on-event=BswM_MainFunction_OsApplication_OsCore3
        BswM_MainFunction_OsApplication_OsCore1TimingEvent0: starts-on-event=BswM_MainFunction_OsApplication_OsCore1
        BswM_MainFunction_OsApplication_OsCore2TimingEvent0: starts-on-event=BswM_MainFunction_OsApplication_OsCore2
        BswM_MainFunction_OsApplication_OsCore0TimingEvent0: starts-on-event=BswM_MainFunction_OsApplication_OsCore0
  6 x bsw module entry, all with call-type=SCHEDULED, execution-context=TASK:
    BswM_MainFunction_OsApplication_OsCore0
    BswM_MainFunction_OsApplication_OsCore1
    BswM_MainFunction_OsApplication_OsCore5
    BswM_MainFunction_OsApplication_OsCore4
    BswM_MainFunction_OsApplication_OsCore3
    BswM_MainFunction_OsApplication_OsCore2
package /MICROSAR/EcuM_ib_bswmd/BswModuleDescriptions
  bsw module description EcuM
    bsw internal behavior EcuMBehavior
      4 x exclusive area:
        ECUM_EXCLUSIVE_AREA_0  # This exclusive area shall disable all wake up interrupts to prevent overwriting of some global variables.
        ECUM_EXCLUSIVE_AREA_1  # This exclusive area is only used in case of multi core and if the the EcuM is configured to handle also the slave cores. It must be configured as a spinlock to allow access to some variables simultaneously from multiple cores.
        ECUM_EXCLUSIVE_AREA_2  # This exclusive area is used for accessing the clock variable. It shall disable GPT interrupts and task changes. Only necessary if 32 Bit access is not atomic and Alarm Clock is present.
        ECUM_EXCLUSIVE_AREA_3  # This This exclusive area must be configured as a spin lock to protect access on global shutdown target variables.
      bsw schedulable entity EcuM_MainFunction: implemented-entry=EcuM_MainFunction
      6 x bsw timing event, all with starts-on-event=EcuM_MainFunction, period=0.01:
        EcuM_MainFunctionTimingEvent{0..5}
  bsw module entry EcuM_MainFunction: call-type=SCHEDULED, execution-context=TASK
