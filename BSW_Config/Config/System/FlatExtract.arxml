AUTOSAR XML (schema 00048)
package /COM/VECTOR/CFG/WORKFLOW/SYSDESC/SYNC
  system SYSTEM: category=ECU_EXTRACT
    system mapping MAPPINGS
    root-software-compositions:
      root sw composition prototype COMPOSITIONTYPE: flat-map=FLATMAP, software-composition=COMPOSITIONTYPE
  composition sw component type COMPOSITIONTYPE  # UB:Derived from original system description
    24 x component:
      Det: type=Det
      EcuM: type=EcuM
      Os_OsCore{0..5}_swc: type=Os_OsCore{0..5}_swc
      Cdd_Core{0..5}: type=Cdd_Core{0..5}
      BswM: type=BswM
      Cdd_nm: type=Cdd_Nm
      Cdd_log: type=Cdd_Log
      StbM: type=StbM
      ComM: type=ComM
      Cdd_StbM: type=Cdd_StbM
      Cdd_PPS: type=Cdd_PPS
      Dcm: type=Dcm
      Cdd_UDS: type=Cdd_UDS
      Cdd_SomeIP: type=Cdd_SomeIP
    connect BswM.Switch_ESH_ModeSwitch -> BswM.Notification_ESH_ModeNotification
    connect Cdd_nm.BswM_SRI_BswM_MSI_ESH_RunRequest_BswM_MDGP_ESH_RunRequest -> BswM.Request_ESH_RunRequest_0
    connect Cdd_UDS.DID_0x16F_DataServices_DcmDspData_NetPara -> Dcm.DataServices_DcmDspData_NetPara
    connect Cdd_UDS.RID_0x250_RoutineServices_DcmDspRoutine_0x250_SetPhyTxMode -> Dcm.RoutineServices_DcmDspRoutine_0x250_SetPhyTxMode
    connect BswM.Switch_SDC_Mode_S_SdServerService_0xC3C1_SenState_EH_SdEventHandler_0xC3C1_SenState -> Cdd_SomeIP.BswM_MSI_SDC_SdEventHandlerState_0xC3C1_SenState
    connect BswM.Switch_SDC_Mode_C_SdClientService_0xC3CD_VechicleInfo_CEG_SdConsumedEventGroup_0xC3CD_VechicleInfo -> Cdd_SomeIP.BswM_MSI_SDC_SdConsumedEventGroupState_0xC3CB_VechicleSpeed
    connect BswM.Switch_SDC_Mode_C_SdClientService_0xC3CC_VechicleStatus -> Cdd_SomeIP.BswM_MSI_SDC_SdClientServiceState_0xC3CC_VechicleStatus
    connect BswM.Switch_SDC_Mode_S_SdServerService_0xC3C2_EcuState_EH_SdEventHandler_0xC3C2_EcuState -> Cdd_SomeIP.BswM_MSI_SDC_SdEventHandlerState_0xC3C2_EcuState
    connect BswM.Switch_SDC_Mode_C_SdClientService_0xC3CD_VechicleInfo -> Cdd_SomeIP.BswM_MSI_SDC_SdClientServiceState_0xC3CD_VechicleInfo
    connect BswM.Switch_SDC_Mode_C_SdClientService_0xC3CB_VechicleSpeed -> Cdd_SomeIP.BswM_MSI_SDC_SdClientServiceState_0xC3CB_VechicleSpeed
    connect BswM.Switch_SDC_Mode_S_SdServerService_0xC3C0_FaultInfo_EH_SdEventHandler_0xC3C0_FaultInfo -> Cdd_SomeIP.BswM_MSI_SDC_SdEventHandlerState_0xC3C0_FaultInfo
    connect BswM.Switch_SDC_Mode_C_SdClientService_0xC3CD_VechicleInfo_CEG_SdConsumedEventGroup_0xC3CD_VechicleInfo -> Cdd_SomeIP.BswM_MSI_SDC_SdConsumedEventGroupState_0xC3CD_VechicleInfo
    connect BswM.Switch_SDC_Mode_C_SdClientService_0xC3CC_VechicleStatus_CEG_SdConsumedEventGroup_0xC3CC_VechicleStatus -> Cdd_SomeIP.BswM_MSI_SDC_SdConsumedEventGroupState_0xC3CC_VechicleStatus
  end to end protection set E2EPROTECTIONSET
  port interface mapping set PORTINTERFACEMAPPINGSET
