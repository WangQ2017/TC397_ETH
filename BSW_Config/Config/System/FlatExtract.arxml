AUTOSAR XML (schema 00048)
package /COM/VECTOR/CFG/WORKFLOW/SYSDESC/SYNC
  system SYSTEM: category=ECU_EXTRACT
    system mapping MAPPINGS
    root-software-compositions:
      root sw composition prototype COMPOSITIONTYPE: flat-map=FLATMAP, software-composition=COMPOSITIONTYPE
  composition sw component type COMPOSITIONTYPE  # UB:Derived from original system description
    21 x component:
      Det: type=Det
      EcuM: type=EcuM
      Os_OsCore{0..5}_swc: type=Os_OsCore{0..5}_swc
      Cdd_Core{0..5}: type=Cdd_Core{0..5}
      BswM: type=BswM
      swc_lock: type=lock_control
      Cdd_nm: type=Cdd_Nm
      window_core1: type=window_core1
      ComM: type=ComM
      StbM: type=StbM
      Dcm: type=Dcm
    connect BswM.Switch_ESH_ModeSwitch -> BswM.Notification_ESH_ModeNotification
    connect Cdd_nm.BswM_SRI_BswM_MSI_ESH_RunRequest_BswM_MDGP_ESH_RunRequest -> BswM.Request_ESH_RunRequest_0
  end to end protection set E2EPROTECTIONSET
  port interface mapping set PORTINTERFACEMAPPINGSET
