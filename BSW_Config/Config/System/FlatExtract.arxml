AUTOSAR XML (schema 00048)
package /COM/VECTOR/CFG/WORKFLOW/SYSDESC/SYNC
  system SYSTEM: category=ECU_EXTRACT
    system mapping MAPPINGS
    root-software-compositions:
      root sw composition prototype COMPOSITIONTYPE: flat-map=FLATMAP, software-composition=COMPOSITIONTYPE
  composition sw component type COMPOSITIONTYPE  # UB:Derived from original system description
    23 x component:
      Det: type=Det
      EcuM: type=EcuM
      Os_OsCore{0..5}_swc: type=Os_OsCore{0..5}_swc
      Cdd_Core{0..5}: type=Cdd_Core{0..5}
      BswM: type=BswM
      Cdd_nm: type=Cdd_Nm
      Cdd_log: type=Cdd_Log
      StbM: type=StbM
      ComM: type=ComM
      Cdd_StbM: type=Cdd_StbM
      Cdd_PPS: type=Cdd_PPS
      Dcm: type=Dcm
      Cdd_UDS: type=Cdd_UDS
    connect BswM.Switch_ESH_ModeSwitch -> BswM.Notification_ESH_ModeNotification
    connect Cdd_nm.BswM_SRI_BswM_MSI_ESH_RunRequest_BswM_MDGP_ESH_RunRequest -> BswM.Request_ESH_RunRequest_0
    connect Cdd_UDS.DID_0x16F_DataServices_DcmDspData_NetPara -> Dcm.DataServices_DcmDspData_NetPara
    connect Cdd_UDS.RID_0x250_RoutineServices_DcmDspRoutine_0x250_SetPhyTxMode -> Dcm.RoutineServices_DcmDspRoutine_0x250_SetPhyTxMode
  end to end protection set E2EPROTECTIONSET
  port interface mapping set PORTINTERFACEMAPPINGSET
