AUTOSAR XML (schema 00048)
package /COM/VECTOR/CFG/WORKFLOW/SYSDESC/SYNC
  system SYSTEM: category=ECU_EXTRACT
    system mapping MAPPINGS
    root-software-compositions:
      root sw composition prototype COMPOSITIONTYPE: flat-map=FLATMAP, software-composition=COMPOSITIONTYPE
  composition sw component type COMPOSITIONTYPE  # UB:Derived from original system description
    24 x component:
      Det: type=Det
      EcuM: type=EcuM
      Os_OsCore{0..5}_swc: type=Os_OsCore{0..5}_swc
      Cdd_Core{0..5}: type=Cdd_Core{0..5}
      BswM: type=BswM
      Cdd_nm: type=Cdd_Nm
      ComM: type=ComM
      StbM: type=StbM
      Dcm: type=Dcm
      NvM: type=NvM
      Cdd_log: type=Cdd_Log
      DemMaster_0: type=DemMaster_0
      DemSatellite_0: type=DemSatellite_0
      Cdd_UDS: type=Cdd_UDS
    connect BswM.Switch_ESH_ModeSwitch -> BswM.Notification_ESH_ModeNotification
    connect Cdd_nm.BswM_SRI_BswM_MSI_ESH_RunRequest_BswM_MDGP_ESH_RunRequest -> BswM.Request_ESH_RunRequest_0
    connect Cdd_UDS.CSDataServices_Data_Did_0x16E_MCU_Info -> DemMaster_0.CBReadData_Data_Did_0x16E_MCU_Info
    connect Cdd_UDS.DID_0x16F_DataServices_Version_Info -> Dcm.DataServices_Version_Info
    connect Cdd_UDS.RID_0x050_RoutineServices_DcmDspRoutine_Get_Link_Quality_Start -> Dcm.RoutineServices_DcmDspRoutine_Get_Link_Quality_Start
  end to end protection set E2EPROTECTIONSET
  port interface mapping set PORTINTERFACEMAPPINGSET
