AUTOSAR XML (schema 4-0-3)
package /COM/VECTOR/CFG/WORKFLOW/SYSDESC/SYNC
  flat map FLATMAP
    7 x flat instance descriptor:
      Cdd_Core{0..5}: upstream-reference=EcuSwComposition.Cdd_Core{0..5}, ecu-extract-reference=COMPOSITIONTYPE.Cdd_Core{0..5}
      Cdd_nm: upstream-reference=EcuSwComposition.Cdd_nm, ecu-extract-reference=COMPOSITIONTYPE.Cdd_nm
