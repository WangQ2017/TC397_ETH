AUTOSAR XML (schema 4-0-3)
package /COM/VECTOR/CFG/WORKFLOW/SYSDESC/SYNC
  flat map FLATMAP
    12 x flat instance descriptor:
      Cdd_Core{0..5}: upstream-reference=EcuSwComposition.Cdd_Core{0..5}, ecu-extract-reference=COMPOSITIONTYPE.Cdd_Core{0..5}
      Cdd_nm: upstream-reference=EcuSwComposition.Cdd_nm, ecu-extract-reference=COMPOSITIONTYPE.Cdd_nm
      Cdd_log: upstream-reference=EcuSwComposition.Cdd_log, ecu-extract-reference=COMPOSITIONTYPE.Cdd_log
      Cdd_StbM: upstream-reference=EcuSwComposition.Cdd_StbM, ecu-extract-reference=COMPOSITIONTYPE.Cdd_StbM
      Cdd_PPS: upstream-reference=EcuSwComposition.Cdd_PPS, ecu-extract-reference=COMPOSITIONTYPE.Cdd_PPS
      Cdd_UDS: upstream-reference=EcuSwComposition.Cdd_UDS, ecu-extract-reference=COMPOSITIONTYPE.Cdd_UDS
      Cdd_SomeIP: upstream-reference=EcuSwComposition.Cdd_SomeIP, ecu-extract-reference=COMPOSITIONTYPE.Cdd_SomeIP
