AUTOSAR XML (schema 4-0-3)
package /COM/VECTOR/CFG/WORKFLOW/SYSDESC/SYNC
  flat map FLATMAP
    9 x flat instance descriptor:
      Cdd_Core{0..5}: upstream-reference=EcuSwComposition.Cdd_Core{0..5}, ecu-extract-reference=COMPOSITIONTYPE.Cdd_Core{0..5}
      swc_lock: upstream-reference=EcuSwComposition.swc_lock, ecu-extract-reference=COMPOSITIONTYPE.swc_lock
      Cdd_nm: upstream-reference=EcuSwComposition.Cdd_nm, ecu-extract-reference=COMPOSITIONTYPE.Cdd_nm
      window_core1: upstream-reference=EcuSwComposition.window_core1, ecu-extract-reference=COMPOSITIONTYPE.window_core1
