AUTOSAR XML (schema 00048)
package /ComponentTypes
  application sw component type Cdd_Core3
    behavior Cdd_Core3_InternalBehavior
      init event Cdd_Core3_InitEvent: start-on-event=Cdd_Core3_Init
      timing event TMT_Cdd_Core3_Runnable10ms: start-on-event=Cdd_Core3_Runnable10ms, period=0.01
      runnable Cdd_Core3_Init
      runnable Cdd_Core3_Runnable10ms
  swc implementation Cdd_Core3_Implementation: behavior=Cdd_Core3_InternalBehavior
