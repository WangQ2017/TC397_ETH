AUTOSAR XML (schema 00048)
package /ComponentTypes
  application sw component type Cdd_PPS
    behavior Cdd_PPS_InternalBehavior
      timing event TMT_Cdd_PPS_Runnable5ms: start-on-event=Cdd_PPS_Runnable5ms, period=0.005
      init event Cdd_PPS_InitEvent: start-on-event=Cdd_PPS_Init
      runnable Cdd_PPS_Runnable5ms
      runnable Cdd_PPS_Init
  swc implementation Cdd_PPS_Implementation: behavior=Cdd_PPS_InternalBehavior
