AUTOSAR XML (schema 00048)
package /ComponentTypes
  application sw component type Cdd_StbM
    behavior Cdd_StbM_InternalBehavior
      timing event TMT_Cdd_StbM_Runnable100ms: start-on-event=Cdd_StbM_Runnable100ms, period=0.1
      init event Cdd_StbM_InitEvent: start-on-event=Cdd_StbM_Init
      timing event TMT_Cdd_StbM_Runnable5ms: start-on-event=Cdd_StbM_Runnable5ms, period=0.005
      runnable Cdd_StbM_Runnable100ms
      runnable Cdd_StbM_Init
      runnable Cdd_StbM_Runnable5ms
  swc implementation Cdd_StbM_Implementation: behavior=Cdd_StbM_InternalBehavior
