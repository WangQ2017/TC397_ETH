AUTOSAR XML (schema 00048)
package /ComponentTypes
  application sw component type Cdd_Stbm
    behavior Cdd_Stbm_InternalBehavior
      timing event TMT_Cdd_Stbm_Runnable100ms: start-on-event=Cdd_Stbm_Runnable100ms, period=0.1
      init event Cdd_Stbm_InitEvent: start-on-event=Cdd_Stbm_Init
      timing event TMT_Cdd_Stbm_Runnable5ms: start-on-event=Cdd_Stbm_Runnable5ms, period=0.005
      runnable Cdd_Stbm_Runnable100ms
      runnable Cdd_Stbm_Init
      runnable Cdd_Stbm_Runnable5ms
  swc implementation Cdd_Stbm_Implementation: behavior=Cdd_Stbm_InternalBehavior
