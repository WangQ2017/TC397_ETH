AUTOSAR XML (schema 00048)
package /ComponentTypes
  application sw component type window_core1
    behavior window_core1_InternalBehavior
      init event window_core1_InitEvent: start-on-event=window_core1_Init
      timing event TMT_Runnable_windows_2ms: start-on-event=Runnable_windows_2ms, period=0.002
      runnable window_core1_Init
      runnable Runnable_windows_2ms
  swc implementation window_core1_Implementation: behavior=window_core1_InternalBehavior
