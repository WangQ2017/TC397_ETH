AUTOSAR XML (schema 00048)
package /ComponentTypes
  application sw component type lock_control
    behavior lock_control_InternalBehavior
      timing event TMT_Runnable_2ms: start-on-event=Runnable_2ms, period=0.002
      init event lock_control_InitEvent: start-on-event=lock_control_Init
      runnable Runnable_2ms: minimum-start-interval=0.002
      runnable lock_control_Init
  swc implementation lock_control_Implementation: behavior=lock_control_InternalBehavior
