AUTOSAR XML (schema 00048)
package /ComponentTypes
  application sw component type Cdd_Core2
    behavior Cdd_Core2_InternalBehavior
      init event Cdd_Core2_InitEvent: start-on-event=Cdd_Core2_Init
      timing event TMT_Cdd_Core2_Runnable10ms: start-on-event=Cdd_Core2_Runnable10ms, period=0.01
      runnable Cdd_Core2_Init
      runnable Cdd_Core2_Runnable10ms
  swc implementation Cdd_Core2_Implementation: behavior=Cdd_Core2_InternalBehavior
