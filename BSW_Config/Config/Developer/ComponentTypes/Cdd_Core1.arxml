AUTOSAR XML (schema 00048)
package /ComponentTypes
  application sw component type Cdd_Core1
    behavior Cdd_Core1_InternalBehavior
      init event Cdd_Core1_InitEvent: start-on-event=Cdd_Core1_Init
      timing event TMT_Cdd_Core1_Runnable10ms: start-on-event=Cdd_Core1_Runnable10ms, period=0.01
      runnable Cdd_Core1_Init
      runnable Cdd_Core1_Runnable10ms
  swc implementation Cdd_Core1_Implementation: behavior=Cdd_Core1_InternalBehavior
