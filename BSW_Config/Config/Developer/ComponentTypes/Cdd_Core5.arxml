AUTOSAR XML (schema 00048)
package /ComponentTypes
  application sw component type Cdd_Core5
    behavior Cdd_Core5_InternalBehavior
      init event Cdd_Core5_InitEvent: start-on-event=Cdd_Core5_Init
      timing event TMT_Cdd_Core5_Runnable10ms: start-on-event=Cdd_Core5_Runnable10ms, period=0.01
      runnable Cdd_Core5_Init
      runnable Cdd_Core5_Runnable10ms
  swc implementation Cdd_Core5_Implementation: behavior=Cdd_Core5_InternalBehavior
