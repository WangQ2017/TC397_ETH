AUTOSAR XML (schema 00048)
package /ComponentTypes
  application sw component type Cdd_Log
    behavior Cdd_Log_InternalBehavior
      init event Runnable_InitEvent: start-on-event=Cdd_Log_Runnable_init
      timing event TMT_Cdd_Log_Runnable5ms: start-on-event=Cdd_Log_Runnable5ms, period=0.005
      runnable Cdd_Log_Runnable_init
      runnable Cdd_Log_Runnable5ms
  swc implementation Cdd_Log_Implementation: behavior=Cdd_Log_InternalBehavior
