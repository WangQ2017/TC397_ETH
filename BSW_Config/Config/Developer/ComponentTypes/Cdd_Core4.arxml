AUTOSAR XML (schema 00048)
package /ComponentTypes
  application sw component type Cdd_Core4
    behavior Cdd_Core4_InternalBehavior
      init event Cdd_Core4_InitEvent: start-on-event=Cdd_Core4_Init
      timing event TMT_Cdd_Core4_Runnable10ms: start-on-event=Cdd_Core4_Runnable10ms, period=0.01
      runnable Cdd_Core4_Init
      runnable Cdd_Core4_Runnable10ms
  swc implementation Cdd_Core4_Implementation: behavior=Cdd_Core4_InternalBehavior
