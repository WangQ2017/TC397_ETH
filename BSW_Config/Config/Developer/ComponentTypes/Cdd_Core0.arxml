AUTOSAR XML (schema 00048)
package /ComponentTypes
  application sw component type Cdd_Core0
    behavior Cdd_Core0_InternalBehavior
      init event Cdd_Core0_InitEvent: start-on-event=Cdd_Core0_Init
      4 x timing event:
        TMT_Cdd_Core0_Runnable10ms: start-on-event=Cdd_Core0_Runnable10ms, period=0.01
        TMT_Cdd_Core0_Runnable20ms: start-on-event=Cdd_Core0_Runnable20ms, period=0.02
        TMT_Cdd_Core0_Runnable5ms: start-on-event=Cdd_Core0_Runnable5ms, period=0.005
        TMT_Cdd_Core0_Runnable1ms: start-on-event=Cdd_Core0_Runnable1ms, period=0.001
      5 x runnable:
        Cdd_Core0_Init
        Cdd_Core0_Runnable10ms: minimum-start-interval=0.005
        Cdd_Core0_Runnable20ms: minimum-start-interval=0.02
        Cdd_Core0_Runnable5ms
        Cdd_Core0_Runnable1ms
  swc implementation Cdd_Core0_Implementation: behavior=Cdd_Core0_InternalBehavior
