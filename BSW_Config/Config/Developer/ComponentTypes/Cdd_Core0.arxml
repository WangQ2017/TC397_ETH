AUTOSAR XML (schema 00048)
package /ComponentTypes
  application sw component type Cdd_Core0
    behavior Cdd_Core0_InternalBehavior
      init event Cdd_Core0_InitEvent: start-on-event=Cdd_Core0_Init
      timing event TMT_Runnable_5ms: start-on-event=Runnable_5ms, period=0.005
      timing event TMT_Runnable_20: start-on-event=Runnable_20, period=0.02
      runnable Cdd_Core0_Init
      runnable Runnable_5ms: minimum-start-interval=0.005
      runnable Runnable_20: minimum-start-interval=0.02
  swc implementation Cdd_Core0_Implementation: behavior=Cdd_Core0_InternalBehavior
