AUTOSAR XML (schema 00048)
package /ECUCompositionTypes
  composition sw component type ECU_Composition
    9 x component:
      Cdd_Core{0..5}: type=Cdd_Core{0..5}
      swc_lock: type=lock_control
      Cdd_nm: type=Cdd_Nm
      window_core1: type=window_core1
package /EndToEndProtections
  end to end protection set EndToEndProtectionSet
package /Systems
  system TC397_BSW
    root-software-compositions:
      root sw composition prototype EcuSwComposition: software-composition=ECU_Composition
