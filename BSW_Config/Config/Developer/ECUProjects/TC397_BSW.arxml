AUTOSAR XML (schema 00048)
package /ECUCompositionTypes
  composition sw component type ECU_Composition
    9 x component:
      Cdd_Core{0..5}: type=Cdd_Core{0..5}
      Cdd_nm: type=Cdd_Nm
      Cdd_log: type=Cdd_Log
      Cdd_UDS: type=Cdd_UDS
package /EndToEndProtections
  end to end protection set EndToEndProtectionSet
package /Systems
  system TC397_BSW
    root-software-compositions:
      root sw composition prototype EcuSwComposition: software-composition=ECU_Composition
