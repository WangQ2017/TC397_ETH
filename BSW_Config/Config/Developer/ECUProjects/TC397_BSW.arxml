AUTOSAR XML (schema 00048)
package /ECUCompositionTypes
  composition sw component type ECU_Composition
    12 x component:
      Cdd_Core{0..5}: type=Cdd_Core{0..5}
      Cdd_nm: type=Cdd_Nm
      Cdd_log: type=Cdd_Log
      Cdd_StbM: type=Cdd_StbM
      Cdd_PPS: type=Cdd_PPS
      Cdd_UDS: type=Cdd_UDS
      Cdd_SomeIP: type=Cdd_SomeIP
package /EndToEndProtections
  end to end protection set EndToEndProtectionSet
package /Systems
  system TC397_BSW
    root-software-compositions:
      root sw composition prototype EcuSwComposition: software-composition=ECU_Composition
