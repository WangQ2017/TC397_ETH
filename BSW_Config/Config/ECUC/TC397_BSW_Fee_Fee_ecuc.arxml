AUTOSAR XML (schema 00048)
package /ActiveEcuC
  module config Fee: implementation-config-variant=VARIANT-POST-BUILD-LOADABLE, module-description=Fee_Impl
    FeeGeneral:
      FeeDevErrorDetect = true
      FeeSafetyEnable = false
      FeeInitCheckApi = false
      FeeMainFunctionPeriod = 0.01
      FeePollingMode = false
      FeeSetModeSupported = true
      FeeVersionInfoApi = false
      FeeVirtualPageSize = 8
      FeeBlockTypeConfigured = FEE_DOUBLE_SECTOR_DATA_ONLY
      FeeNvmJobEndNotification = NvM_JobEndNotification
      FeeNvmJobErrorNotification = NvM_JobErrorNotification
      FeeQsJobEndNotification = QS_JobEndNotification
      FeeQsJobErrorNotification = QS_JobErrorNotification
    FeePublishedInformation: FeeBlockOverhead=17, FeePageOverhead=1
    FeeIfxSpecificConfig:
      FeeThresholdValue = 200
      FeeMaxBlockCount = 1
      FeeUseEraseSuspend = false
      FeeStateVarStructure = Fee_StateVar
      FeeUnConfigBlock = FEE_UNCONFIG_BLOCK_IGNORE
      FeeUnConfigBlkOverflowHandle = FEE_CONTINUE
      FeeGcRestart = FEE_GC_RESTART_INIT
      FeeGetCycleCountApi = false
      FeeEraseAllEnable = false
      FeeGetPrevDataApi = false
      FeeCancelAllApi = false
      FeeMaxBytesPerCycle = FEE_MAX_BYTES_512
      FeeNvmIllegalStateNotification = NvM_IllegalStateNotification
      FeeQsIllegalStateNotification = NULL_PTR
      FeeQsHardenErrorNotification = NULL_PTR
      FeeVirginFlashIllegalState = false
    CommonPublishedInformation:
      ArMajorVersion = 4
      ArMinorVersion = 2
      ArPatchVersion = 2
      SwMajorVersion = 10
      SwMinorVersion = 40
      SwPatchVersion = 2
      ModuleId = 21
      VendorId = 17
      Release = _TRICORE_TC397
    6 x FeeBlockConfiguration, all with FeeQsBlockInstances=0, FeeQsBlockAddress=0, FeeQuasiStaticManager=false, FeeImmediateData=false, FeeNumberOfWriteCycles=0, FeeDeviceIndex=FlsGeneral:
      FeeBlock_DemAdminDataBlock: FeeBlockNumber=800, FeeBlockSize=18
      FeeBlock_DemAdminDataBlock_cons0: FeeBlockNumber=33, FeeBlockSize=1
      FeeBlock_DemStatusDataBlock: FeeBlockNumber=768, FeeBlockSize=16
      FeeBlock_NvMConfigBlock: FeeBlockNumber=208, FeeBlockSize=4
      FeeBlock_NvMConfigBlock_cons0: FeeBlockNumber=209, FeeBlockSize=4
      FeeBlock_DemPrimaryDataBlock0: FeeBlockNumber=16, FeeBlockSize=32
