AUTOSAR XML (schema 00048)
package /ActiveEcuC
  module config EcuM: implementation-config-variant=VARIANT-PRE-COMPILE, module-description=EcuM_Impl
    EcuMFlexGeneral: EcuMAlarmClockPresent=false, EcuMResetLoopDetection=false, EcuMEnableDefBehaviour=false
    EcuMGeneral:
      EcuMDevErrorDetect = true
      EcuMIncludeDem = true
      EcuMIncludeDet = true
      EcuMVersionInfoApi = false
      EcuMMainFunctionPeriod = 0.01
      EcuMDeferredBswMNotification = false
      EcuMSlaveCoreHandling = true
      EcuMEnableFixBehavior = false
      EcuMNonChannelWakeupInRun = false
      EcuMGeneration: EcuMOutOfBoundsWriteSanitizer=false, EcuMOutOfBoundsReadSanitizer=false, EcuMInterfacesForDeactivatedData=false
    EcuMConfiguration
      EcuMCommonConfiguration: EcuMConfigConsistencyHash=16989167403581334515, EcuMDefaultAppMode=OSDEFAULTAPPMODE, EcuMOSResource=OsResource
        5 x EcuMWakeupSource, all with EcuMValidationTimeout=0, EcuMCheckWakeupTimeout=0, EcuMWakeupSourcePolling=false:
          ECUM_WKSOURCE_POWER: EcuMWakeupSourceId=0
          ECUM_WKSOURCE_RESET: EcuMWakeupSourceId=1
          ECUM_WKSOURCE_INTERNAL_RESET: EcuMWakeupSourceId=2
          ECUM_WKSOURCE_INTERNAL_WDG: EcuMWakeupSourceId=3
          ECUM_WKSOURCE_EXTERNAL_WDG: EcuMWakeupSourceId=4
        EcuMDefaultShutdownTarget: EcuMDefaultState=EcuMStateOff
        EcuMDriverInitListZero
          19 x EcuMDriverInitItem:
            Det_Init: index=0, EcuMModuleID=Det, EcuMModuleService=Det_Init, EcuMModuleHeader=Det.h
            Rte_InitMemory: index=1, EcuMModuleID=Rte, EcuMModuleService=Rte_InitMemory, EcuMModuleHeader=Rte_Main.h
            BswM_InitMemory: index=2, EcuMModuleID=BswM, EcuMModuleService=BswM_InitMemory, EcuMModuleHeader=BswM.h
            Det_InitMemory: index=3, EcuMModuleID=Det, EcuMModuleService=Det_InitMemory, EcuMModuleHeader=Det.h
            Eth_30_Tc3xx_InitMemory: EcuMModuleID=Eth_30_Tc3xx, EcuMModuleService=Eth_30_Tc3xx_InitMemory, EcuMModuleHeader=Eth_30_Tc3xx.h
            ComM_InitMemory: EcuMModuleID=ComM, EcuMModuleService=ComM_InitMemory, EcuMModuleHeader=ComM.h
            EthTsyn_InitMemory: EcuMModuleID=EthTSyn, EcuMModuleService=EthTSyn_InitMemory, EcuMModuleHeader=EthTSyn.h
            SoAd_InitMemory: EcuMModuleID=SoAd, EcuMModuleService=SoAd_InitMemory, EcuMModuleHeader=SoAd.h
            StbM_InitMemory: EcuMModuleID=StbM, EcuMModuleService=BswM_InitMemory, EcuMModuleHeader=StbM.h
            Com_InitMemory: EcuMModuleID=Com, EcuMModuleService=Com_InitMemory, EcuMModuleHeader=Com.h
            PduR_InitMemory: EcuMModuleID=PduR, EcuMModuleService=PduR_InitMemory, EcuMModuleHeader=PduR.h
            EthSM_InitMemory: EcuMModuleID=EthSM, EcuMModuleService=EthSM_InitMemory, EcuMModuleHeader=EthSM.h
            UdpNm_InitMemory: EcuMModuleID=UdpNm, EcuMModuleService=UdpNm_InitMemory, EcuMModuleHeader=UdpNm.h
            EthIf_InitMemory: EcuMModuleID=EthIf, EcuMModuleService=EthIf_InitMemory, EcuMModuleHeader=EthIf.h
            TcpIp_InitMemory: EcuMModuleID=TcpIp, EcuMModuleService=TcpIp_InitMemory, EcuMModuleHeader=TcpIp.h
            EthTrcv_30_Tja1100_InitMemory: EcuMModuleID=EthTrcv_30_Tja1100, EcuMModuleService=EthTrcv_30_Tja1100_InitMemory, EcuMModuleHeader=EthTrcv_30_Tja1100.h
            Nm_InitMemory: EcuMModuleID=Nm, EcuMModuleService=Nm_InitMemory, EcuMModuleHeader=Nm.h
            Dem_PreInit: EcuMModuleID=Dem, EcuMModuleService=Dem_PreInit, EcuMModuleHeader=Dem.h
            Dem_InitMemory: EcuMModuleID=Dem, EcuMModuleService=Dem_InitMemory, EcuMModuleHeader=Dem.h
        EcuMDriverInitListOne
          8 x EcuMDriverInitItem:
            Mcu_Init: index=2, EcuMModuleID=Mcu, EcuMModuleService=Mcu_Init, EcuMModuleHeader=Mcu.h
            Mcu_Init_AdditionalCode: index=3, EcuMModuleID=Code, EcuMAdditionalInitCode=Mcu_InitClock(0);while (MCU_PLL_LOCKED != Mcu_GetPllStatus());Mcu_DistributePllClock();, EcuMModuleHeader=Mcu.h
            BswM_PreInit: EcuMModuleID=BswM, EcuMModuleService=BswM_PreInit, EcuMModuleHeader=BswM.h
            Port_Init: EcuMModuleID=Port, EcuMModuleService=Port_Init, EcuMModuleHeader=Port.h
            PduR_PreInit: EcuMModuleID=PduR, EcuMModuleService=PduR_PreInit, EcuMModuleHeader=PduR.h
            EthTrcv_PhyReset: EcuMModuleID=Code, EcuMAdditionalInitCode=EthTrcv_PhyReset();, EcuMModuleHeader=EthTrcv_Callout.h
            Fls_17_Dmu_Init: EcuMModuleID=Fls, EcuMModuleService=Fls_17_Dmu_Init, EcuMModuleHeader=Fls_17_Dmu.h
            Fee_Init: EcuMModuleID=Fee, EcuMModuleService=Fee_Init, EcuMModuleHeader=Fee.h
      EcuMFlexConfiguration:
        EcuMNormalMcuModeRef = McuModeSettingConf
        EcuMPartitionRef = EcucPartition_Core{0..3}
        EcuMPartitionRef = EcucPartition_Core5
        EcuMPartitionRef = EcucPartition_Core4
        3 x EcuMResetMode:
          ECUM_RESET_MCU: EcuMResetModeId=0
          ECUM_RESET_WDG: EcuMResetModeId=1
          ECUM_RESET_IO: EcuMResetModeId=2
        4 x EcuMShutdownCause:
          ECUM_CAUSE_UNKNOWN: EcuMShutdownCauseId=0
          ECUM_CAUSE_ECU_STATE: EcuMShutdownCauseId=1
          ECUM_CAUSE_WDGM: EcuMShutdownCauseId=2
          ECUM_CAUSE_DCM: EcuMShutdownCauseId=3
        ECUM_RESET_WAKEUP (EcuMResetMode): EcuMResetModeId=3
