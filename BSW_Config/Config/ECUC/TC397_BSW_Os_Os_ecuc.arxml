AUTOSAR XML (schema 00048)
package /ActiveEcuC
  module config Os: implementation-config-variant=VARIANT-PRE-COMPILE, module-description=Os_Impl
    SystemTimer_OsCore0 (OsCounter):
      OsCounterMaxAllowedValue = 1073741823
      OsCounterMinCycle = 1
      OsCounterType = HARDWARE
      OsSecondsPerTick = 1E-8
      OsCounterTicksPerBase = 1
      OsCounterAccessingApplication = SystemApplication_OsCore{0..5}
      OsDriver: OsDriverHighResolution=true, OsDriverHardwareTimerChannelRef=STM0_Ch0, OsDriverIsrRef=CounterIsr_SystemTimer_OsCore0
    OsOS:
      OsScalabilityClass = SC1
      OsStackMonitoring = true
      OsStatus = EXTENDED
      OsUseGetServiceId = false
      OsUseParameterAccess = false
      OsUseResScheduler = false
      OsForcibleTermination = false
      OsGenerateCalloutStubs = true
      OsGenerateMemMap = COMPLETE
      OsGenerateMemMapForNearAddressing = true
      OsGenerateMemMapForThreads = false
      OsServiceProtection = false
      OsStackUsageMeasurement = false
      OsUseXSignalAsyncApiCalls = false
      OsFpuUsage = NONE
      OsUseCase = STANDARD
      OsNumberOfCores = 6
      OsSystemTimer = SystemTimer_OsCore0
      OsMasterCore = OsCore0
      OsHooks: OsErrorHook=true, OsPostTaskHook=true, OsPreTaskHook=true, OsShutdownHook=true, OsStartupHook=true, OsPanicHook=false, OsProtectionHook=false
      OsStackSummary
        74 x OsStack:
          OsCore0_Kernel: OsStackSize=1024, OsStackType=CORE_KERNEL_STACK, OsStackCore=OsCore0, OsStackUser=OsCore0
          OsCore0_Init: OsStackSize=1024, OsStackType=CORE_INIT_STACK, OsStackCore=OsCore0, OsStackUser=OsCore0
          OsCore0_Error: OsStackSize=1024, OsStackType=CORE_ERROR_STACK, OsStackCore=OsCore0, OsStackUser=OsCore0
          OsCore0_Task_Prio4294967295: OsStackSize=1024, OsStackType=TASK_SHARED_PRIORITY_STACK, OsStackCore=OsCore0, OsStackUser=IdleTask_OsCore0
          OsCore0_Isr_Core: OsStackSize=1024, OsStackType=ISR_SHARED_CORE_STACK, OsStackCore=OsCore0, OsStackUser=CounterIsr_SystemTimer_OsCore0, OsStackUser=XSignalIsr_OsCore0, OsStackUser=EthIsr_EthCtrlConfig_MAIN_EthInterruptServiceRoutine_Q0Tx, OsStackUser=ASCLIN0ERR_ISR, OsStackUser=ASCLIN0TX_ISR, OsStackUser=EthIsr_PPS
          OsCore0_Task_Prio50: OsStackSize=1024, OsStackType=TASK_SHARED_PRIORITY_STACK, OsStackCore=OsCore0, OsStackUser=Default_Init_Task_Trusted, OsStackUser=OsTask_Bsw_1ms_Core0
          OsCore0_Task_Prio48: OsStackSize=1024, OsStackType=TASK_SHARED_PRIORITY_STACK, OsStackCore=OsCore0, OsStackUser=OsTask_Init_OsCore0
          OsCore1_Kernel: OsStackSize=1024, OsStackType=CORE_KERNEL_STACK, OsStackCore=OsCore1, OsStackUser=OsCore1
          OsCore1_Init: OsStackSize=1024, OsStackType=CORE_INIT_STACK, OsStackCore=OsCore1, OsStackUser=OsCore1
          OsCore1_Error: OsStackSize=1024, OsStackType=CORE_ERROR_STACK, OsStackCore=OsCore1, OsStackUser=OsCore1
          OsCore1_Task_Prio4294967295: OsStackSize=1024, OsStackType=TASK_SHARED_PRIORITY_STACK, OsStackCore=OsCore1, OsStackUser=IdleTask_OsCore1
          OsCore2_Kernel: OsStackSize=1024, OsStackType=CORE_KERNEL_STACK, OsStackCore=OsCore2, OsStackUser=OsCore2
          OsCore2_Init: OsStackSize=1024, OsStackType=CORE_INIT_STACK, OsStackCore=OsCore2, OsStackUser=OsCore2
          OsCore2_Error: OsStackSize=1024, OsStackType=CORE_ERROR_STACK, OsStackCore=OsCore2, OsStackUser=OsCore2
          OsCore3_Kernel: OsStackSize=1024, OsStackType=CORE_KERNEL_STACK, OsStackCore=OsCore3, OsStackUser=OsCore3
          OsCore3_Init: OsStackSize=1024, OsStackType=CORE_INIT_STACK, OsStackCore=OsCore3, OsStackUser=OsCore3
          OsCore3_Error: OsStackSize=1024, OsStackType=CORE_ERROR_STACK, OsStackCore=OsCore3, OsStackUser=OsCore3
          OsCore4_Kernel: OsStackSize=1024, OsStackType=CORE_KERNEL_STACK, OsStackCore=OsCore4, OsStackUser=OsCore4
          OsCore4_Init: OsStackSize=1024, OsStackType=CORE_INIT_STACK, OsStackCore=OsCore4, OsStackUser=OsCore4
          OsCore4_Error: OsStackSize=1024, OsStackType=CORE_ERROR_STACK, OsStackCore=OsCore4, OsStackUser=OsCore4
          OsCore5_Kernel: OsStackSize=1024, OsStackType=CORE_KERNEL_STACK, OsStackCore=OsCore5, OsStackUser=OsCore5
          OsCore5_Init: OsStackSize=1024, OsStackType=CORE_INIT_STACK, OsStackCore=OsCore5, OsStackUser=OsCore5
          OsCore5_Error: OsStackSize=1024, OsStackType=CORE_ERROR_STACK, OsStackCore=OsCore5, OsStackUser=OsCore5
          OsCore5_Task_Prio4294967295: OsStackSize=1024, OsStackType=TASK_SHARED_PRIORITY_STACK, OsStackCore=OsCore5, OsStackUser=IdleTask_OsCore5
          OsCore4_Task_Prio4294967295: OsStackSize=1024, OsStackType=TASK_SHARED_PRIORITY_STACK, OsStackCore=OsCore4, OsStackUser=IdleTask_OsCore4
          OsCore3_Task_Prio4294967295: OsStackSize=1024, OsStackType=TASK_SHARED_PRIORITY_STACK, OsStackCore=OsCore3, OsStackUser=IdleTask_OsCore3
          OsCore2_Task_Prio4294967295: OsStackSize=1024, OsStackType=TASK_SHARED_PRIORITY_STACK, OsStackCore=OsCore2, OsStackUser=IdleTask_OsCore2
          OsCore{1..4}_Task_Prio49: OsStackSize=1024, OsStackType=TASK_SHARED_PRIORITY_STACK, OsStackCore=OsCore{1..4}, OsStackUser=Default_Init_Task_Core{1..4}_Trusted
          OsCore5_Task_Prio49: OsStackSize=1024, OsStackType=TASK_SHARED_PRIORITY_STACK, OsStackCore=OsCore5, OsStackUser=Default_Init_Task_Core6_Trusted
          OsCore5_Task_Prio50: OsStackSize=1024, OsStackType=TASK_SHARED_PRIORITY_STACK, OsStackCore=OsCore5, OsStackUser=Default_Init_Task_Core6
          OsCore4_Isr_Core: OsStackSize=1024, OsStackType=ISR_SHARED_CORE_STACK, OsStackCore=OsCore4, OsStackUser=XSignalIsr_OsCore4, OsStackUser=CounterIsr_SystemTimer_OsCore4
          OsCore{1..3}_Isr_Core: OsStackSize=1024, OsStackType=ISR_SHARED_CORE_STACK, OsStackCore=OsCore{1..3}, OsStackUser=XSignalIsr_OsCore{1..3}, OsStackUser=CounterIsr_SystemTimer_OsCore{1..3}
          OsCore5_Isr_Core: OsStackSize=1024, OsStackType=ISR_SHARED_CORE_STACK, OsStackCore=OsCore5, OsStackUser=XSignalIsr_OsCore5, OsStackUser=CounterIsr_SystemTimer_OsCore5
          OsCore1_Task_Prio34: OsStackSize=1024, OsStackType=TASK_SHARED_PRIORITY_STACK, OsStackCore=OsCore1, OsStackUser=OsTask_Bsw_OsCore1
          OsCore1_Task_Prio48: OsStackSize=1024, OsStackType=TASK_SHARED_PRIORITY_STACK, OsStackCore=OsCore1, OsStackUser=OsTask_Init_OsCore1
          OsCore5_Task_Prio30: OsStackSize=1024, OsStackType=TASK_SHARED_PRIORITY_STACK, OsStackCore=OsCore5, OsStackUser=OsTask_Bsw_OsCore5
          OsCore5_Task_Prio48: OsStackSize=1024, OsStackType=TASK_SHARED_PRIORITY_STACK, OsStackCore=OsCore5, OsStackUser=OsTask_Init_OsCore5
          OsCore4_Task_Prio31: OsStackSize=1024, OsStackType=TASK_SHARED_PRIORITY_STACK, OsStackCore=OsCore4, OsStackUser=OsTask_Bsw_OsCore4
          OsCore4_Task_Prio48: OsStackSize=1024, OsStackType=TASK_SHARED_PRIORITY_STACK, OsStackCore=OsCore4, OsStackUser=OsTask_Init_OsCore4
          OsCore3_Task_Prio32: OsStackSize=1024, OsStackType=TASK_SHARED_PRIORITY_STACK, OsStackCore=OsCore3, OsStackUser=OsTask_Bsw_OsCore3
          OsCore3_Task_Prio48: OsStackSize=1024, OsStackType=TASK_SHARED_PRIORITY_STACK, OsStackCore=OsCore3, OsStackUser=OsTask_Init_OsCore3
          OsCore2_Task_Prio33: OsStackSize=1024, OsStackType=TASK_SHARED_PRIORITY_STACK, OsStackCore=OsCore2, OsStackUser=OsTask_Bsw_OsCore2
          OsCore2_Task_Prio48: OsStackSize=1024, OsStackType=TASK_SHARED_PRIORITY_STACK, OsStackCore=OsCore2, OsStackUser=OsTask_Init_OsCore2
          OsCore5_Task_Prio10: OsStackSize=1024, OsStackType=TASK_SHARED_PRIORITY_STACK, OsStackCore=OsCore5, OsStackUser=OsTask_Asw_OsCore5
          OsCore4_Task_Prio11: OsStackSize=1024, OsStackType=TASK_SHARED_PRIORITY_STACK, OsStackCore=OsCore4, OsStackUser=OsTask_Asw_OsCore4
          OsCore3_Task_Prio12: OsStackSize=1024, OsStackType=TASK_SHARED_PRIORITY_STACK, OsStackCore=OsCore3, OsStackUser=OsTask_Asw_OsCore3
          OsCore2_Task_Prio13: OsStackSize=1024, OsStackType=TASK_SHARED_PRIORITY_STACK, OsStackCore=OsCore2, OsStackUser=OsTask_Asw_OsCore2
          OsCore1_Task_Prio14: OsStackSize=1024, OsStackType=TASK_SHARED_PRIORITY_STACK, OsStackCore=OsCore1, OsStackUser=OsTask_Asw_OsCore1
          OsCore0_Task_Prio55: OsStackSize=1024, OsStackType=TASK_SHARED_PRIORITY_STACK, OsStackCore=OsCore0, OsStackUser=Default_Init_Task
          OsCore1_Task_Prio54: OsStackSize=1024, OsStackType=TASK_SHARED_PRIORITY_STACK, OsStackCore=OsCore1, OsStackUser=Default_Init_Task_Core1
          OsCore2_Task_Prio53: OsStackSize=1024, OsStackType=TASK_SHARED_PRIORITY_STACK, OsStackCore=OsCore2, OsStackUser=Default_Init_Task_Core2
          OsCore3_Task_Prio52: OsStackSize=1024, OsStackType=TASK_SHARED_PRIORITY_STACK, OsStackCore=OsCore3, OsStackUser=Default_Init_Task_Core3
          OsCore4_Task_Prio51: OsStackSize=1024, OsStackType=TASK_SHARED_PRIORITY_STACK, OsStackCore=OsCore4, OsStackUser=Default_Init_Task_Core4
          OsTask_Asw_OsCore0: OsStackSize=4096, OsStackType=TASK_EXTENDED_STACK, OsStackCore=OsCore0, OsStackUser=Os/OsTask_Asw_OsCore0
          OsCore{0..5}_Shutdown: OsStackSize=1024, OsStackType=CORE_SHUTDOWN_STACK, OsStackCore=OsCore{0..5}, OsStackUser=OsCore{0..5}
          OsCore{0..5}_Startup: OsStackSize=1024, OsStackType=CORE_STARTUP_STACK, OsStackCore=OsCore{0..5}, OsStackUser=OsCore{0..5}
          OsCore0_Task_Prio20: OsStackSize=1024, OsStackType=TASK_SHARED_PRIORITY_STACK, OsStackCore=OsCore0, OsStackUser=OsTask_Bsw_20ms_Core0
          OsCore0_Task_Prio30: OsStackSize=1024, OsStackType=TASK_SHARED_PRIORITY_STACK, OsStackCore=OsCore0, OsStackUser=OsTask_Bsw_10ms_Core0
          OsTask_Bsw_5ms_Core0: OsStackSize=1024, OsStackType=TASK_EXTENDED_STACK, OsStackCore=OsCore0, OsStackUser=Os/OsTask_Bsw_5ms_Core0
    OsPublishedInformation: OsKernelVersion=7, OsPlatformName=TriCoreAurix
      TC39x (OsDerivativeInformation):
        OsMpuPrivilegedRegionsConfigurable = false
        OsMpuAlignment = 8
        OsMpuMemoryGapSize = 16
        OsMpuEndAddressAccessible = false
        OsStackAlignment = 8
        OsExceptionVectorTableAlignment = 256
        OsInterruptVectorTableAlignment = 8192
        OsHardwareManuals = User Manual: TC3XX_ts__TargetSpec_rev1v3v0.pdf V1.3.0, 2016-02 Errata Sheet: TC39x AA_Errata_Sheet_rev1v0_2016-06-08.pdf Rel. 1.0, 2016-06-08
        6 x OsPhysicalCore, all with OsPhysicalCoreType=TC1.6.2P, OsPhysicalCoreExceptionSources=8, OsPhysicalCorePrivelegedHwAccess=true:
          Core0: OsPhysicalCoreId=0, OsPhysicalCoreDefaultEntrySymbol=_start_tc0, OsPhysicalCoreMasterStartAllowed=true, OsPhysicalCoreIsAutostart=true, OsPhysicalCoreStackProtectionUnit=OsPhysicalCore0DataMpu
            OsPhysicalCore0DataMpu (OsPhysicalCoreMpu): OsPhysicalCoreMpuId=0, OsPhysicalCoreMpuMaxRegions=18, OsPhysicalCoreMpuType=DATA
            OsPhysicalCore0CodeMpu (OsPhysicalCoreMpu): OsPhysicalCoreMpuId=1, OsPhysicalCoreMpuMaxRegions=10, OsPhysicalCoreMpuType=CODE
          Core1: OsPhysicalCoreId=1, OsPhysicalCoreDefaultEntrySymbol=_start_tc1, OsPhysicalCoreMasterStartAllowed=false, OsPhysicalCoreIsAutostart=false, OsPhysicalCoreStackProtectionUnit=OsPhysicalCore1DataMpu
            OsPhysicalCore1DataMpu (OsPhysicalCoreMpu): OsPhysicalCoreMpuId=0, OsPhysicalCoreMpuMaxRegions=18, OsPhysicalCoreMpuType=DATA
            OsPhysicalCore1CodeMpu (OsPhysicalCoreMpu): OsPhysicalCoreMpuId=1, OsPhysicalCoreMpuMaxRegions=10, OsPhysicalCoreMpuType=CODE
          Core2: OsPhysicalCoreId=2, OsPhysicalCoreDefaultEntrySymbol=_start_tc2, OsPhysicalCoreMasterStartAllowed=false, OsPhysicalCoreIsAutostart=false, OsPhysicalCoreStackProtectionUnit=OsPhysicalCore2DataMpu
            OsPhysicalCore2DataMpu (OsPhysicalCoreMpu): OsPhysicalCoreMpuId=0, OsPhysicalCoreMpuMaxRegions=18, OsPhysicalCoreMpuType=DATA
            OsPhysicalCore2CodeMpu (OsPhysicalCoreMpu): OsPhysicalCoreMpuId=1, OsPhysicalCoreMpuMaxRegions=10, OsPhysicalCoreMpuType=CODE
          Core3: OsPhysicalCoreId=3, OsPhysicalCoreDefaultEntrySymbol=_start_tc3, OsPhysicalCoreMasterStartAllowed=false, OsPhysicalCoreIsAutostart=false, OsPhysicalCoreStackProtectionUnit=OsPhysicalCore3DataMpu
            OsPhysicalCore3DataMpu (OsPhysicalCoreMpu): OsPhysicalCoreMpuId=0, OsPhysicalCoreMpuMaxRegions=18, OsPhysicalCoreMpuType=DATA
            OsPhysicalCore3CodeMpu (OsPhysicalCoreMpu): OsPhysicalCoreMpuId=1, OsPhysicalCoreMpuMaxRegions=10, OsPhysicalCoreMpuType=CODE
          Core4: OsPhysicalCoreId=4, OsPhysicalCoreDefaultEntrySymbol=_start_tc4, OsPhysicalCoreMasterStartAllowed=false, OsPhysicalCoreIsAutostart=false, OsPhysicalCoreStackProtectionUnit=OsPhysicalCore4DataMpu
            OsPhysicalCore4DataMpu (OsPhysicalCoreMpu): OsPhysicalCoreMpuId=0, OsPhysicalCoreMpuMaxRegions=18, OsPhysicalCoreMpuType=DATA
            OsPhysicalCore4CodeMpu (OsPhysicalCoreMpu): OsPhysicalCoreMpuId=1, OsPhysicalCoreMpuMaxRegions=10, OsPhysicalCoreMpuType=CODE
          Core5: OsPhysicalCoreId=6, OsPhysicalCoreDefaultEntrySymbol=_start_tc5, OsPhysicalCoreMasterStartAllowed=false, OsPhysicalCoreIsAutostart=false, OsPhysicalCoreStackProtectionUnit=OsPhysicalCore5DataMpu
            OsPhysicalCore5DataMpu (OsPhysicalCoreMpu): OsPhysicalCoreMpuId=0, OsPhysicalCoreMpuMaxRegions=18, OsPhysicalCoreMpuType=DATA
            OsPhysicalCore5CodeMpu (OsPhysicalCoreMpu): OsPhysicalCoreMpuId=1, OsPhysicalCoreMpuMaxRegions=10, OsPhysicalCoreMpuType=CODE
        6 x OsHardwareTimer, all with OsHardwareTimerSize=32, OsHardwareTimerUnit=FRT, OsHardwareTimerType=STM:
          STM0: OsHardwareTimerBaseAddress=4026535936, OsHardwareTimerId=0
            STM0_Ch0 (OsHardwareTimerChannel): OsHardwareTimerChannelIntSource=768, OsHardwareTimerChannelOffset=0, OsHardwareTimerChannelId=0
            STM0_Ch1 (OsHardwareTimerChannel): OsHardwareTimerChannelIntSource=772, OsHardwareTimerChannelOffset=1, OsHardwareTimerChannelId=1
          STM1: OsHardwareTimerBaseAddress=4026536192, OsHardwareTimerId=1
            STM1_Ch0 (OsHardwareTimerChannel): OsHardwareTimerChannelIntSource=776, OsHardwareTimerChannelOffset=0, OsHardwareTimerChannelId=0
            STM1_Ch1 (OsHardwareTimerChannel): OsHardwareTimerChannelIntSource=780, OsHardwareTimerChannelOffset=1, OsHardwareTimerChannelId=1
          STM2: OsHardwareTimerBaseAddress=4026536448, OsHardwareTimerId=2
            STM2_Ch0 (OsHardwareTimerChannel): OsHardwareTimerChannelIntSource=784, OsHardwareTimerChannelOffset=0, OsHardwareTimerChannelId=0
            STM2_Ch1 (OsHardwareTimerChannel): OsHardwareTimerChannelIntSource=788, OsHardwareTimerChannelOffset=1, OsHardwareTimerChannelId=1
          STM3: OsHardwareTimerBaseAddress=4026536704, OsHardwareTimerId=3
            STM3_Ch0 (OsHardwareTimerChannel): OsHardwareTimerChannelIntSource=792, OsHardwareTimerChannelOffset=0, OsHardwareTimerChannelId=0
            STM3_Ch1 (OsHardwareTimerChannel): OsHardwareTimerChannelIntSource=796, OsHardwareTimerChannelOffset=1, OsHardwareTimerChannelId=1
          STM4: OsHardwareTimerBaseAddress=4026536960, OsHardwareTimerId=4
            STM4_Ch0 (OsHardwareTimerChannel): OsHardwareTimerChannelIntSource=800, OsHardwareTimerChannelOffset=0, OsHardwareTimerChannelId=0
            STM4_Ch1 (OsHardwareTimerChannel): OsHardwareTimerChannelIntSource=804, OsHardwareTimerChannelOffset=1, OsHardwareTimerChannelId=1
          STM5: OsHardwareTimerBaseAddress=4026537216, OsHardwareTimerId=5
            STM5_Ch0 (OsHardwareTimerChannel): OsHardwareTimerChannelIntSource=808, OsHardwareTimerChannelOffset=0, OsHardwareTimerChannelId=0
            STM5_Ch1 (OsHardwareTimerChannel): OsHardwareTimerChannelIntSource=812, OsHardwareTimerChannelOffset=1, OsHardwareTimerChannelId=1
        AURIXTC3XX_IR (OsSystemIntCtrl): OsSystemIntCtrlMaxPrios=255, OsSystemIntCtrlPrioOrder=ASC, OsSystemIntCtrlMaxSources=8192, OsSystemIntCtrlBaseAddress=4026757120
        GPT (OsHardwareTimer): OsHardwareTimerSize=16, OsHardwareTimerUnit=PIT, OsHardwareTimerBaseAddress=4026537984, OsHardwareTimerId=0, OsHardwareTimerType=PIT
          GPT_Ch0 (OsHardwareTimerChannel): OsHardwareTimerChannelIntSource=744, OsHardwareTimerChannelOffset=0, OsHardwareTimerChannelId=0
          GPT_Ch1 (OsHardwareTimerChannel): OsHardwareTimerChannelIntSource=756, OsHardwareTimerChannelOffset=1, OsHardwareTimerChannelId=1
        OsMemoryRegionSpecifics
          18 x OsMemoryRegionAccess:
            PS0_R: OsMemoryRegionAccessRights=R, OsMemoryRegionAccessType=PROTECTION_SET0
            PS0_W: OsMemoryRegionAccessRights=W, OsMemoryRegionAccessType=PROTECTION_SET0
            PS0_X: OsMemoryRegionAccessRights=X, OsMemoryRegionAccessType=PROTECTION_SET0
            PS1_R: OsMemoryRegionAccessRights=R, OsMemoryRegionAccessType=PROTECTION_SET1
            PS1_W: OsMemoryRegionAccessRights=W, OsMemoryRegionAccessType=PROTECTION_SET1
            PS1_X: OsMemoryRegionAccessRights=X, OsMemoryRegionAccessType=PROTECTION_SET1
            PS2_R: OsMemoryRegionAccessRights=R, OsMemoryRegionAccessType=PROTECTION_SET2
            PS2_W: OsMemoryRegionAccessRights=W, OsMemoryRegionAccessType=PROTECTION_SET2
            PS2_X: OsMemoryRegionAccessRights=X, OsMemoryRegionAccessType=PROTECTION_SET2
            PS3_R: OsMemoryRegionAccessRights=R, OsMemoryRegionAccessType=PROTECTION_SET3
            PS3_W: OsMemoryRegionAccessRights=W, OsMemoryRegionAccessType=PROTECTION_SET3
            PS3_X: OsMemoryRegionAccessRights=X, OsMemoryRegionAccessType=PROTECTION_SET3
            PS4_R: OsMemoryRegionAccessRights=R, OsMemoryRegionAccessType=PROTECTION_SET4
            PS4_W: OsMemoryRegionAccessRights=W, OsMemoryRegionAccessType=PROTECTION_SET4
            PS4_X: OsMemoryRegionAccessRights=X, OsMemoryRegionAccessType=PROTECTION_SET4
            PS5_R: OsMemoryRegionAccessRights=R, OsMemoryRegionAccessType=PROTECTION_SET5
            PS5_W: OsMemoryRegionAccessRights=W, OsMemoryRegionAccessType=PROTECTION_SET5
            PS5_X: OsMemoryRegionAccessRights=X, OsMemoryRegionAccessType=PROTECTION_SET5
        DMA (OsInterruptSupportedType):
          OsInterruptSupportedTypeSeparateSources = false
          OsInterruptSupportedTypeSeparatePriority = true
          OsInterruptSupportedTypeIsMapped = false
          OsInterruptSupportedTypePostActionRequired = false
    OSDEFAULTAPPMODE (OsAppMode)
    OS_APPMODE_ANY (OsAppMode)
    OsCore0 (OsCore):
      OsCoreIsAutostart = true
      OsCoreIsAutosar = true
      OsCoreEntrySymbol = _start
      OsCorePhysicalCoreRef = Core0
      OsCoreEcucCoreRef = EcucCoreDefinition_Core0
      OsCoreIdleTask = IdleTask_OsCore0
      OsCoreSystemApplication = SystemApplication_OsCore0
      OsCoreStacks:
        OsCoreKernelStackSize = 1024
        OsCoreStartupStackSize = 1024
        OsCoreShutdownStackSize = 1024
        OsCoreErrorStackSize = 1024
        OsCoreProtectionStackSize = 1024
        OsCoreInitStackSize = 1024
      5 x OsCoreXSignalChannel, all with OsCoreXSignalChannelSize=1:
        XSignalChl_OsCore4: OsCoreXSignalChannelReceiverIsr=XSignalIsr_OsCore4
        XSignalChl_OsCore2: OsCoreXSignalChannelReceiverIsr=XSignalIsr_OsCore2
        XSignalChl_OsCore3: OsCoreXSignalChannelReceiverIsr=XSignalIsr_OsCore3
        XSignalChl_OsCore5: OsCoreXSignalChannelReceiverIsr=XSignalIsr_OsCore5
        XSignalChl_OsCore1: OsCoreXSignalChannelReceiverIsr=XSignalIsr_OsCore1
    IdleTask_OsCore0 (OsTask):
      OsTaskActivation = 1
      OsTaskPriority = 4294967295
      OsTaskSchedule = FULL
      OsTaskStackSharing = false
      OsTaskStackSize = 1024
      OsTaskType = AUTO
      OsTaskUsesFpu = false
      OsTaskAccessingApplication = SystemApplication_OsCore{0..5}
      OsTaskAutostart: OsTaskAppModeRef=OS_APPMODE_ANY
    SystemApplication_OsCore0 (OsApplication):
      OsTrusted = true
      OsTrustedApplicationDelayTimingViolationCall = false
      OsTrustedApplicationWithProtection = false
      OsApplicationIsPrivileged = true
      OsAppUseTrustedFunctionStubs = false
      OsApplicationCoreRef = EcucCoreDefinition_Core0
      OsAppTaskRef = IdleTask_OsCore0
      OsAppCounterRef = SystemTimer_OsCore0
      OsAppIsrRef = CounterIsr_SystemTimer_OsCore0
      OsAppIsrRef = XSignalIsr_OsCore0
      OsAppIsrRef = EthIsr_EthCtrlConfig_MAIN_EthInterruptServiceRoutine_Q0Tx
      OsAppIsrRef = ASCLIN0TX_ISR
      OsAppIsrRef = ASCLIN0ERR_ISR
      OsApplicationHooks: OsAppErrorHook=false, OsAppShutdownHook=false, OsAppStartupHook=false
    CounterIsr_SystemTimer_OsCore0 (OsIsr):
      OsIsrInterruptPriority = 100
      OsIsrCategory = CATEGORY_2
      OsIsrInterruptType = EXTERNAL
      OsIsrInterruptSource = 768
      OsIsrStackSize = 1024
      OsIsrEnableNesting = false
      OsIsrUsesFpu = false
      OsIsrInitialEnableInterruptSource = false
      OsIsrSpecialFunctionName = Os_TimerHrtIsr
    Default_Init_Task (OsTask):
      OsTaskActivation = 1
      OsTaskPriority = 55
      OsTaskSchedule = FULL
      OsTaskStackSharing = false
      OsTaskStackSize = 1024
      OsTaskType = BASIC
      OsTaskUsesFpu = false
      OsTaskAccessingApplication = SystemApplication_OsCore0
      OsTaskResourceRef = OsResource
      OsTaskAccessingApplication = SystemApplication_OsCore{1..5}
      OsTaskAutostart: OsTaskAppModeRef=OSDEFAULTAPPMODE
    Default_Init_Task_Trusted (OsTask):
      OsTaskActivation = 1
      OsTaskPriority = 50
      OsTaskSchedule = FULL
      OsTaskStackSharing = false
      OsTaskStackSize = 1024
      OsTaskType = BASIC
      OsTaskUsesFpu = false
      OsTaskAccessingApplication = SystemApplication_OsCore{0..5}
      OsTaskAutostart: OsTaskAppModeRef=OSDEFAULTAPPMODE
    OsResource: OsResourceProperty=STANDARD, OsResourceAccessingApplication=SystemApplication_OsCore0, OsResourceAccessingApplication=OsApplication_OsCore0
    OsApplication_OsCore0 (OsApplication):
      OsTrusted = true
      OsTrustedApplicationDelayTimingViolationCall = false
      OsTrustedApplicationWithProtection = false
      OsApplicationIsPrivileged = true
      OsAppUseTrustedFunctionStubs = false
      OsApplicationCoreRef = EcucCoreDefinition_Core0
      OsAppTaskRef = Os/OsTask_Asw_OsCore0
      OsAppTaskRef = Os/OsTask_Bsw_5ms_Core0
      OsAppTaskRef = OsTask_Init_OsCore0
      OsAppEcucPartitionRef = EcucPartition_Core0
      OsAppTaskRef = Default_Init_Task
      OsAppTaskRef = Default_Init_Task_Trusted
      OsAppTaskRef = OsTask_Bsw_10ms_Core0
      OsAppTaskRef = OsTask_Bsw_20ms_Core0
      OsAppTaskRef = OsTask_Bsw_1ms_Core0
      OsAppAlarmRef = Rte_Al_TE2_OsTask_Bsw_10ms_Core0_0_10ms
      OsAppAlarmRef = Rte_Al_TE_EthTrcv_30_Tja1100_EthTrcv_30_Tja1100_MainFunction
      OsAppAlarmRef = Rte_Al_TE_Cdd_Core0_Cdd_Core0_Runnable20ms
      OsAppAlarmRef = Rte_Al_TE_OsTask_Asw_OsCore0_0_10ms
      OsAppAlarmRef = Rte_Al_TE_OsTask_Asw_OsCore0_0_5ms
      OsAppAlarmRef = Rte_Al_TE_Cdd_Core0_Cdd_Core0_Runnable1ms
      OsAppAlarmRef = Rte_Al_TE2_OsTask_Bsw_5ms_Core0_0_5ms
      OsAppAlarmRef = Rte_Al_TE2_OsTask_Bsw_5ms_Core0_0_10ms
      OsAppAlarmRef = Rte_Al_TE_EthIf_EthIf_MainFunctionState
      OsAppAlarmRef = Rte_Al_TE2_OsTask_Bsw_5ms_Core0_0_20ms
      OsAppIsrRef = EthIsr_PPS
      OsAppAlarmRef = Rte_Al_TE_Cdd_Stbm_Cdd_Stbm_Runnable100ms
      OsAppAlarmRef = Rte_Al_TE2_OsTask_Bsw_1ms_Core0_0_1ms
      OsApplicationHooks: OsAppErrorHook=false, OsAppShutdownHook=false, OsAppStartupHook=false
    3 x OsTask, all with OsTaskActivation=1, OsTaskSchedule=FULL, OsTaskStackSharing=false, OsTaskType=AUTO, OsTaskUsesFpu=false, OsTaskAccessingApplication=SystemApplication_OsCore0, OsTaskAccessingApplication=SystemApplication_OsCore1, OsTaskAccessingApplication=SystemApplication_OsCore2, OsTaskAccessingApplication=SystemApplication_OsCore3, OsTaskAccessingApplication=SystemApplication_OsCore4, OsTaskAccessingApplication=SystemApplication_OsCore5, OsTaskAccessingApplication=OsApplication_OsCore1, OsTaskAccessingApplication=OsApplication_OsCore2, OsTaskAccessingApplication=OsApplication_OsCore3, OsTaskAccessingApplication=OsApplication_OsCore4, OsTaskAccessingApplication=OsApplication_OsCore5:
      OsTask_Bsw_5ms_Core0: OsTaskPriority=40, OsTaskStackSize=1024, OsTaskAccessingApplication=OsApplication_OsCore0, OsTaskEventRef=Rte_Ev_Cyclic2_OsTask_Bsw_5ms_Core0_0_10ms, OsTaskEventRef=Rte_Ev_Cyclic2_OsTask_Bsw_5ms_Core0_0_5ms, OsTaskEventRef=Rte_Ev_Run_EthIf_EthIf_MainFunctionState, OsTaskEventRef=Rte_Ev_Cyclic2_OsTask_Bsw_5ms_Core0_0_20ms
      OsTask_Asw_OsCore0: OsTaskPriority=15, OsTaskStackSize=4096, OsTaskAccessingApplication=OsApplication_OsCore0, OsTaskEventRef=Rte_Ev_Cyclic_OsTask_Asw_OsCore0_0_10ms, OsTaskEventRef=Rte_Ev_Run_Cdd_Core0_Cdd_Core0_Runnable20ms, OsTaskEventRef=Rte_Ev_Cyclic_OsTask_Asw_OsCore0_0_5ms, OsTaskEventRef=Rte_Ev_Run_Cdd_Core0_Cdd_Core0_Runnable1ms, OsTaskEventRef=Rte_Ev_Run_Cdd_Stbm_Cdd_Stbm_Runnable100ms
      OsTask_Init_OsCore0: OsTaskPriority=48, OsTaskStackSize=1024
    OsCore1 (OsCore):
      OsCoreIsAutostart = false
      OsCoreIsAutosar = true
      OsCoreEntrySymbol = _start
      OsCorePhysicalCoreRef = Core1
      OsCoreEcucCoreRef = EcucCoreDefinition_Core1
      OsCoreIdleTask = IdleTask_OsCore1
      OsCoreSystemApplication = SystemApplication_OsCore1
      OsCoreStacks:
        OsCoreKernelStackSize = 1024
        OsCoreStartupStackSize = 1024
        OsCoreShutdownStackSize = 1024
        OsCoreErrorStackSize = 1024
        OsCoreProtectionStackSize = 1024
        OsCoreInitStackSize = 1024
      5 x OsCoreXSignalChannel, all with OsCoreXSignalChannelSize=1:
        XSignalChl_OsCore4: OsCoreXSignalChannelReceiverIsr=XSignalIsr_OsCore4
        XSignalChl_OsCore2: OsCoreXSignalChannelReceiverIsr=XSignalIsr_OsCore2
        XSignalChl_OsCore3: OsCoreXSignalChannelReceiverIsr=XSignalIsr_OsCore3
        XSignalChl_OsCore5: OsCoreXSignalChannelReceiverIsr=XSignalIsr_OsCore5
        XSignalChl_OsCore0: OsCoreXSignalChannelReceiverIsr=XSignalIsr_OsCore0
    IdleTask_OsCore1 (OsTask):
      OsTaskActivation = 1
      OsTaskPriority = 4294967295
      OsTaskSchedule = FULL
      OsTaskStackSharing = false
      OsTaskStackSize = 1024
      OsTaskType = AUTO
      OsTaskUsesFpu = false
      OsTaskAccessingApplication = SystemApplication_OsCore{0..5}
      OsTaskAutostart: OsTaskAppModeRef=OS_APPMODE_ANY
    SystemApplication_OsCore1 (OsApplication):
      OsTrusted = true
      OsTrustedApplicationDelayTimingViolationCall = false
      OsTrustedApplicationWithProtection = false
      OsApplicationIsPrivileged = true
      OsAppUseTrustedFunctionStubs = false
      OsApplicationCoreRef = EcucCoreDefinition_Core1
      OsAppTaskRef = IdleTask_OsCore1
      OsAppIsrRef = XSignalIsr_OsCore1
      OsAppCounterRef = SystemTimer_OsCore1
      OsAppIsrRef = CounterIsr_SystemTimer_OsCore1
      OsApplicationHooks: OsAppErrorHook=false, OsAppShutdownHook=false, OsAppStartupHook=false
    4 x OsCore, all with OsCoreIsAutostart=false, OsCoreIsAutosar=true, OsCoreEntrySymbol=_start:
      OsCore2: OsCorePhysicalCoreRef=Core2, OsCoreIdleTask=IdleTask_OsCore2, OsCoreSystemApplication=SystemApplication_OsCore2, OsCoreEcucCoreRef=EcucCoreDefinition_Core2
        OsCoreStacks:
          OsCoreKernelStackSize = 1024
          OsCoreStartupStackSize = 1024
          OsCoreShutdownStackSize = 1024
          OsCoreErrorStackSize = 1024
          OsCoreProtectionStackSize = 1024
          OsCoreInitStackSize = 1024
        5 x OsCoreXSignalChannel, all with OsCoreXSignalChannelSize=1:
          XSignalChl_OsCore4: OsCoreXSignalChannelReceiverIsr=XSignalIsr_OsCore4
          XSignalChl_OsCore3: OsCoreXSignalChannelReceiverIsr=XSignalIsr_OsCore3
          XSignalChl_OsCore5: OsCoreXSignalChannelReceiverIsr=XSignalIsr_OsCore5
          XSignalChl_OsCore0: OsCoreXSignalChannelReceiverIsr=XSignalIsr_OsCore0
          XSignalChl_OsCore1: OsCoreXSignalChannelReceiverIsr=XSignalIsr_OsCore1
      OsCore3: OsCorePhysicalCoreRef=Core3, OsCoreIdleTask=IdleTask_OsCore3, OsCoreSystemApplication=SystemApplication_OsCore3, OsCoreEcucCoreRef=EcucCoreDefinition_Core3
        OsCoreStacks:
          OsCoreKernelStackSize = 1024
          OsCoreStartupStackSize = 1024
          OsCoreShutdownStackSize = 1024
          OsCoreErrorStackSize = 1024
          OsCoreProtectionStackSize = 1024
          OsCoreInitStackSize = 1024
        5 x OsCoreXSignalChannel, all with OsCoreXSignalChannelSize=1:
          XSignalChl_OsCore4: OsCoreXSignalChannelReceiverIsr=XSignalIsr_OsCore4
          XSignalChl_OsCore2: OsCoreXSignalChannelReceiverIsr=XSignalIsr_OsCore2
          XSignalChl_OsCore5: OsCoreXSignalChannelReceiverIsr=XSignalIsr_OsCore5
          XSignalChl_OsCore0: OsCoreXSignalChannelReceiverIsr=XSignalIsr_OsCore0
          XSignalChl_OsCore1: OsCoreXSignalChannelReceiverIsr=XSignalIsr_OsCore1
      OsCore4: OsCorePhysicalCoreRef=Core4, OsCoreIdleTask=IdleTask_OsCore4, OsCoreSystemApplication=SystemApplication_OsCore4, OsCoreEcucCoreRef=EcucCoreDefinition_Core4
        OsCoreStacks:
          OsCoreKernelStackSize = 1024
          OsCoreStartupStackSize = 1024
          OsCoreShutdownStackSize = 1024
          OsCoreErrorStackSize = 1024
          OsCoreProtectionStackSize = 1024
          OsCoreInitStackSize = 1024
        5 x OsCoreXSignalChannel, all with OsCoreXSignalChannelSize=1:
          XSignalChl_OsCore2: OsCoreXSignalChannelReceiverIsr=XSignalIsr_OsCore2
          XSignalChl_OsCore3: OsCoreXSignalChannelReceiverIsr=XSignalIsr_OsCore3
          XSignalChl_OsCore5: OsCoreXSignalChannelReceiverIsr=XSignalIsr_OsCore5
          XSignalChl_OsCore0: OsCoreXSignalChannelReceiverIsr=XSignalIsr_OsCore0
          XSignalChl_OsCore1: OsCoreXSignalChannelReceiverIsr=XSignalIsr_OsCore1
      OsCore5: OsCorePhysicalCoreRef=Core5, OsCoreIdleTask=IdleTask_OsCore5, OsCoreSystemApplication=SystemApplication_OsCore5, OsCoreEcucCoreRef=EcucCoreDefinition_Core5
        OsCoreStacks:
          OsCoreKernelStackSize = 1024
          OsCoreStartupStackSize = 1024
          OsCoreShutdownStackSize = 1024
          OsCoreErrorStackSize = 1024
          OsCoreProtectionStackSize = 1024
          OsCoreInitStackSize = 1024
        5 x OsCoreXSignalChannel, all with OsCoreXSignalChannelSize=1:
          XSignalChl_OsCore4: OsCoreXSignalChannelReceiverIsr=XSignalIsr_OsCore4
          XSignalChl_OsCore2: OsCoreXSignalChannelReceiverIsr=XSignalIsr_OsCore2
          XSignalChl_OsCore3: OsCoreXSignalChannelReceiverIsr=XSignalIsr_OsCore3
          XSignalChl_OsCore0: OsCoreXSignalChannelReceiverIsr=XSignalIsr_OsCore0
          XSignalChl_OsCore1: OsCoreXSignalChannelReceiverIsr=XSignalIsr_OsCore1
    IdleTask_OsCore2 (OsTask):
      OsTaskActivation = 1
      OsTaskPriority = 4294967295
      OsTaskSchedule = FULL
      OsTaskStackSharing = false
      OsTaskStackSize = 1024
      OsTaskType = AUTO
      OsTaskUsesFpu = false
      OsTaskAccessingApplication = SystemApplication_OsCore{0..5}
      OsTaskAutostart: OsTaskAppModeRef=OS_APPMODE_ANY
    SystemApplication_OsCore2 (OsApplication):
      OsTrusted = true
      OsTrustedApplicationDelayTimingViolationCall = false
      OsTrustedApplicationWithProtection = false
      OsApplicationIsPrivileged = true
      OsAppUseTrustedFunctionStubs = false
      OsAppTaskRef = IdleTask_OsCore2
      OsApplicationCoreRef = EcucCoreDefinition_Core2
      OsAppIsrRef = XSignalIsr_OsCore2
      OsAppCounterRef = SystemTimer_OsCore2
      OsAppIsrRef = CounterIsr_SystemTimer_OsCore2
      OsApplicationHooks: OsAppErrorHook=false, OsAppShutdownHook=false, OsAppStartupHook=false
    IdleTask_OsCore3 (OsTask):
      OsTaskActivation = 1
      OsTaskPriority = 4294967295
      OsTaskSchedule = FULL
      OsTaskStackSharing = false
      OsTaskStackSize = 1024
      OsTaskType = AUTO
      OsTaskUsesFpu = false
      OsTaskAccessingApplication = SystemApplication_OsCore{0..5}
      OsTaskAutostart: OsTaskAppModeRef=OS_APPMODE_ANY
    SystemApplication_OsCore3 (OsApplication):
      OsTrusted = true
      OsTrustedApplicationDelayTimingViolationCall = false
      OsTrustedApplicationWithProtection = false
      OsApplicationIsPrivileged = true
      OsAppUseTrustedFunctionStubs = false
      OsAppTaskRef = IdleTask_OsCore3
      OsApplicationCoreRef = EcucCoreDefinition_Core3
      OsAppIsrRef = XSignalIsr_OsCore3
      OsAppCounterRef = SystemTimer_OsCore3
      OsAppIsrRef = CounterIsr_SystemTimer_OsCore3
      OsApplicationHooks: OsAppErrorHook=false, OsAppShutdownHook=false, OsAppStartupHook=false
    IdleTask_OsCore4 (OsTask):
      OsTaskActivation = 1
      OsTaskPriority = 4294967295
      OsTaskSchedule = FULL
      OsTaskStackSharing = false
      OsTaskStackSize = 1024
      OsTaskType = AUTO
      OsTaskUsesFpu = false
      OsTaskAccessingApplication = SystemApplication_OsCore{0..5}
      OsTaskAutostart: OsTaskAppModeRef=OS_APPMODE_ANY
    SystemApplication_OsCore4 (OsApplication):
      OsTrusted = true
      OsTrustedApplicationDelayTimingViolationCall = false
      OsTrustedApplicationWithProtection = false
      OsApplicationIsPrivileged = true
      OsAppUseTrustedFunctionStubs = false
      OsAppTaskRef = IdleTask_OsCore4
      OsApplicationCoreRef = EcucCoreDefinition_Core4
      OsAppIsrRef = XSignalIsr_OsCore4
      OsAppCounterRef = SystemTimer_OsCore4
      OsAppIsrRef = CounterIsr_SystemTimer_OsCore4
      OsApplicationHooks: OsAppErrorHook=false, OsAppShutdownHook=false, OsAppStartupHook=false
    IdleTask_OsCore5 (OsTask):
      OsTaskActivation = 1
      OsTaskPriority = 4294967295
      OsTaskSchedule = FULL
      OsTaskStackSharing = false
      OsTaskStackSize = 1024
      OsTaskType = AUTO
      OsTaskUsesFpu = false
      OsTaskAccessingApplication = SystemApplication_OsCore{0..5}
      OsTaskAutostart: OsTaskAppModeRef=OS_APPMODE_ANY
    SystemApplication_OsCore5 (OsApplication):
      OsTrusted = true
      OsTrustedApplicationDelayTimingViolationCall = false
      OsTrustedApplicationWithProtection = false
      OsApplicationIsPrivileged = true
      OsAppUseTrustedFunctionStubs = false
      OsAppTaskRef = IdleTask_OsCore5
      OsApplicationCoreRef = EcucCoreDefinition_Core5
      OsAppIsrRef = XSignalIsr_OsCore5
      OsAppCounterRef = SystemTimer_OsCore5
      OsAppIsrRef = CounterIsr_SystemTimer_OsCore5
      OsApplicationHooks: OsAppErrorHook=false, OsAppShutdownHook=false, OsAppStartupHook=false
    10 x OsTask, all with OsTaskActivation=1, OsTaskSchedule=FULL, OsTaskStackSharing=false, OsTaskStackSize=1024, OsTaskType=BASIC, OsTaskUsesFpu=false, OsTaskAccessingApplication=SystemApplication_OsCore0, OsTaskAccessingApplication=SystemApplication_OsCore1, OsTaskAccessingApplication=SystemApplication_OsCore2, OsTaskAccessingApplication=SystemApplication_OsCore3, OsTaskAccessingApplication=SystemApplication_OsCore4, OsTaskAccessingApplication=SystemApplication_OsCore5:
      Default_Init_Task_Core1: OsTaskPriority=54
        OsTaskAutostart: OsTaskAppModeRef=OSDEFAULTAPPMODE
      Default_Init_Task_Core1_Trusted: OsTaskPriority=49
        OsTaskAutostart: OsTaskAppModeRef=OSDEFAULTAPPMODE
      Default_Init_Task_Core2: OsTaskPriority=53
        OsTaskAutostart: OsTaskAppModeRef=OSDEFAULTAPPMODE
      Default_Init_Task_Core2_Trusted: OsTaskPriority=49
        OsTaskAutostart: OsTaskAppModeRef=OSDEFAULTAPPMODE
      Default_Init_Task_Core3: OsTaskPriority=52
        OsTaskAutostart: OsTaskAppModeRef=OSDEFAULTAPPMODE
      Default_Init_Task_Core3_Trusted: OsTaskPriority=49
        OsTaskAutostart: OsTaskAppModeRef=OSDEFAULTAPPMODE
      Default_Init_Task_Core4: OsTaskPriority=51
        OsTaskAutostart: OsTaskAppModeRef=OSDEFAULTAPPMODE
      Default_Init_Task_Core4_Trusted: OsTaskPriority=49
        OsTaskAutostart: OsTaskAppModeRef=OSDEFAULTAPPMODE
      Default_Init_Task_Core6: OsTaskPriority=50
        OsTaskAutostart: OsTaskAppModeRef=OSDEFAULTAPPMODE
      Default_Init_Task_Core6_Trusted: OsTaskPriority=49
        OsTaskAutostart: OsTaskAppModeRef=OSDEFAULTAPPMODE
    11 x OsIsr, all with OsIsrCategory=CATEGORY_2, OsIsrInterruptType=EXTERNAL, OsIsrStackSize=1024, OsIsrEnableNesting=false, OsIsrUsesFpu=false, OsIsrInitialEnableInterruptSource=false:
      XSignalIsr_OsCore4: OsIsrInterruptPriority=1, OsIsrInterruptSource=2576, OsIsrSpecialFunctionName=Os_XSigRecvIsrHandler
        OsIsrXSignalReceiver:
          OsIsrXSignalReceiverProvidedApis = ShutdownAllCores
          OsIsrXSignalReceiverProvidedApis = ActivateTask
          OsIsrXSignalReceiverProvidedApis = CancelAlarm
          OsIsrXSignalReceiverProvidedApis = ChainTask
          OsIsrXSignalReceiverProvidedApis = ControlIdle
          OsIsrXSignalReceiverProvidedApis = GetAlarm
          OsIsrXSignalReceiverProvidedApis = GetApplicationState
          OsIsrXSignalReceiverProvidedApis = GetCounterValue
          OsIsrXSignalReceiverProvidedApis = GetElapsedValue
          OsIsrXSignalReceiverProvidedApis = GetErrorHookStackUsage
          OsIsrXSignalReceiverProvidedApis = GetEvent
          OsIsrXSignalReceiverProvidedApis = GetISRStackUsage
          OsIsrXSignalReceiverProvidedApis = GetKernelStackUsage
          OsIsrXSignalReceiverProvidedApis = GetNonTrustedFunctionStackUsage
          OsIsrXSignalReceiverProvidedApis = GetProtectionHookStackUsage
          OsIsrXSignalReceiverProvidedApis = GetScheduleTableStatus
          OsIsrXSignalReceiverProvidedApis = GetShutdownHookStackUsage
          OsIsrXSignalReceiverProvidedApis = GetStartupHookStackUsage
          OsIsrXSignalReceiverProvidedApis = GetTaskStackUsage
          OsIsrXSignalReceiverProvidedApis = GetTaskState
          OsIsrXSignalReceiverProvidedApis = HookCallCallback
          OsIsrXSignalReceiverProvidedApis = NextScheduleTable
          OsIsrXSignalReceiverProvidedApis = SetAbsAlarm
          OsIsrXSignalReceiverProvidedApis = SetEvent
          OsIsrXSignalReceiverProvidedApis = SetRelAlarm
          OsIsrXSignalReceiverProvidedApis = StartScheduleTableAbs
          OsIsrXSignalReceiverProvidedApis = StartScheduleTableRel
          OsIsrXSignalReceiverProvidedApis = StopScheduleTable
          OsIsrXSignalReceiverProvidedApis = TerminateApplication
      XSignalIsr_OsCore2: OsIsrInterruptPriority=1, OsIsrInterruptSource=2512, OsIsrSpecialFunctionName=Os_XSigRecvIsrHandler
        OsIsrXSignalReceiver:
          OsIsrXSignalReceiverProvidedApis = ShutdownAllCores
          OsIsrXSignalReceiverProvidedApis = ActivateTask
          OsIsrXSignalReceiverProvidedApis = CancelAlarm
          OsIsrXSignalReceiverProvidedApis = ChainTask
          OsIsrXSignalReceiverProvidedApis = ControlIdle
          OsIsrXSignalReceiverProvidedApis = GetAlarm
          OsIsrXSignalReceiverProvidedApis = GetApplicationState
          OsIsrXSignalReceiverProvidedApis = GetCounterValue
          OsIsrXSignalReceiverProvidedApis = GetElapsedValue
          OsIsrXSignalReceiverProvidedApis = GetErrorHookStackUsage
          OsIsrXSignalReceiverProvidedApis = GetEvent
          OsIsrXSignalReceiverProvidedApis = GetISRStackUsage
          OsIsrXSignalReceiverProvidedApis = GetKernelStackUsage
          OsIsrXSignalReceiverProvidedApis = GetNonTrustedFunctionStackUsage
          OsIsrXSignalReceiverProvidedApis = GetProtectionHookStackUsage
          OsIsrXSignalReceiverProvidedApis = GetScheduleTableStatus
          OsIsrXSignalReceiverProvidedApis = GetShutdownHookStackUsage
          OsIsrXSignalReceiverProvidedApis = GetStartupHookStackUsage
          OsIsrXSignalReceiverProvidedApis = GetTaskStackUsage
          OsIsrXSignalReceiverProvidedApis = GetTaskState
          OsIsrXSignalReceiverProvidedApis = HookCallCallback
          OsIsrXSignalReceiverProvidedApis = NextScheduleTable
          OsIsrXSignalReceiverProvidedApis = SetAbsAlarm
          OsIsrXSignalReceiverProvidedApis = SetEvent
          OsIsrXSignalReceiverProvidedApis = SetRelAlarm
          OsIsrXSignalReceiverProvidedApis = StartScheduleTableAbs
          OsIsrXSignalReceiverProvidedApis = StartScheduleTableRel
          OsIsrXSignalReceiverProvidedApis = StopScheduleTable
          OsIsrXSignalReceiverProvidedApis = TerminateApplication
      XSignalIsr_OsCore3: OsIsrInterruptPriority=1, OsIsrInterruptSource=2544, OsIsrSpecialFunctionName=Os_XSigRecvIsrHandler
        OsIsrXSignalReceiver:
          OsIsrXSignalReceiverProvidedApis = ShutdownAllCores
          OsIsrXSignalReceiverProvidedApis = ActivateTask
          OsIsrXSignalReceiverProvidedApis = CancelAlarm
          OsIsrXSignalReceiverProvidedApis = ChainTask
          OsIsrXSignalReceiverProvidedApis = ControlIdle
          OsIsrXSignalReceiverProvidedApis = GetAlarm
          OsIsrXSignalReceiverProvidedApis = GetApplicationState
          OsIsrXSignalReceiverProvidedApis = GetCounterValue
          OsIsrXSignalReceiverProvidedApis = GetElapsedValue
          OsIsrXSignalReceiverProvidedApis = GetErrorHookStackUsage
          OsIsrXSignalReceiverProvidedApis = GetEvent
          OsIsrXSignalReceiverProvidedApis = GetISRStackUsage
          OsIsrXSignalReceiverProvidedApis = GetKernelStackUsage
          OsIsrXSignalReceiverProvidedApis = GetNonTrustedFunctionStackUsage
          OsIsrXSignalReceiverProvidedApis = GetProtectionHookStackUsage
          OsIsrXSignalReceiverProvidedApis = GetScheduleTableStatus
          OsIsrXSignalReceiverProvidedApis = GetShutdownHookStackUsage
          OsIsrXSignalReceiverProvidedApis = GetStartupHookStackUsage
          OsIsrXSignalReceiverProvidedApis = GetTaskStackUsage
          OsIsrXSignalReceiverProvidedApis = GetTaskState
          OsIsrXSignalReceiverProvidedApis = HookCallCallback
          OsIsrXSignalReceiverProvidedApis = NextScheduleTable
          OsIsrXSignalReceiverProvidedApis = SetAbsAlarm
          OsIsrXSignalReceiverProvidedApis = SetEvent
          OsIsrXSignalReceiverProvidedApis = SetRelAlarm
          OsIsrXSignalReceiverProvidedApis = StartScheduleTableAbs
          OsIsrXSignalReceiverProvidedApis = StartScheduleTableRel
          OsIsrXSignalReceiverProvidedApis = StopScheduleTable
          OsIsrXSignalReceiverProvidedApis = TerminateApplication
      XSignalIsr_OsCore5: OsIsrInterruptPriority=1, OsIsrInterruptSource=2608, OsIsrSpecialFunctionName=Os_XSigRecvIsrHandler
        OsIsrXSignalReceiver:
          OsIsrXSignalReceiverProvidedApis = ShutdownAllCores
          OsIsrXSignalReceiverProvidedApis = ActivateTask
          OsIsrXSignalReceiverProvidedApis = CancelAlarm
          OsIsrXSignalReceiverProvidedApis = ChainTask
          OsIsrXSignalReceiverProvidedApis = ControlIdle
          OsIsrXSignalReceiverProvidedApis = GetAlarm
          OsIsrXSignalReceiverProvidedApis = GetApplicationState
          OsIsrXSignalReceiverProvidedApis = GetCounterValue
          OsIsrXSignalReceiverProvidedApis = GetElapsedValue
          OsIsrXSignalReceiverProvidedApis = GetErrorHookStackUsage
          OsIsrXSignalReceiverProvidedApis = GetEvent
          OsIsrXSignalReceiverProvidedApis = GetISRStackUsage
          OsIsrXSignalReceiverProvidedApis = GetKernelStackUsage
          OsIsrXSignalReceiverProvidedApis = GetNonTrustedFunctionStackUsage
          OsIsrXSignalReceiverProvidedApis = GetProtectionHookStackUsage
          OsIsrXSignalReceiverProvidedApis = GetScheduleTableStatus
          OsIsrXSignalReceiverProvidedApis = GetShutdownHookStackUsage
          OsIsrXSignalReceiverProvidedApis = GetStartupHookStackUsage
          OsIsrXSignalReceiverProvidedApis = GetTaskStackUsage
          OsIsrXSignalReceiverProvidedApis = GetTaskState
          OsIsrXSignalReceiverProvidedApis = HookCallCallback
          OsIsrXSignalReceiverProvidedApis = NextScheduleTable
          OsIsrXSignalReceiverProvidedApis = SetAbsAlarm
          OsIsrXSignalReceiverProvidedApis = SetEvent
          OsIsrXSignalReceiverProvidedApis = SetRelAlarm
          OsIsrXSignalReceiverProvidedApis = StartScheduleTableAbs
          OsIsrXSignalReceiverProvidedApis = StartScheduleTableRel
          OsIsrXSignalReceiverProvidedApis = StopScheduleTable
          OsIsrXSignalReceiverProvidedApis = TerminateApplication
      XSignalIsr_OsCore1: OsIsrInterruptPriority=1, OsIsrInterruptSource=2480, OsIsrSpecialFunctionName=Os_XSigRecvIsrHandler
        OsIsrXSignalReceiver:
          OsIsrXSignalReceiverProvidedApis = ShutdownAllCores
          OsIsrXSignalReceiverProvidedApis = ActivateTask
          OsIsrXSignalReceiverProvidedApis = CancelAlarm
          OsIsrXSignalReceiverProvidedApis = ChainTask
          OsIsrXSignalReceiverProvidedApis = ControlIdle
          OsIsrXSignalReceiverProvidedApis = GetAlarm
          OsIsrXSignalReceiverProvidedApis = GetApplicationState
          OsIsrXSignalReceiverProvidedApis = GetCounterValue
          OsIsrXSignalReceiverProvidedApis = GetElapsedValue
          OsIsrXSignalReceiverProvidedApis = GetErrorHookStackUsage
          OsIsrXSignalReceiverProvidedApis = GetEvent
          OsIsrXSignalReceiverProvidedApis = GetISRStackUsage
          OsIsrXSignalReceiverProvidedApis = GetKernelStackUsage
          OsIsrXSignalReceiverProvidedApis = GetNonTrustedFunctionStackUsage
          OsIsrXSignalReceiverProvidedApis = GetProtectionHookStackUsage
          OsIsrXSignalReceiverProvidedApis = GetScheduleTableStatus
          OsIsrXSignalReceiverProvidedApis = GetShutdownHookStackUsage
          OsIsrXSignalReceiverProvidedApis = GetStartupHookStackUsage
          OsIsrXSignalReceiverProvidedApis = GetTaskStackUsage
          OsIsrXSignalReceiverProvidedApis = GetTaskState
          OsIsrXSignalReceiverProvidedApis = HookCallCallback
          OsIsrXSignalReceiverProvidedApis = NextScheduleTable
          OsIsrXSignalReceiverProvidedApis = SetAbsAlarm
          OsIsrXSignalReceiverProvidedApis = SetEvent
          OsIsrXSignalReceiverProvidedApis = SetRelAlarm
          OsIsrXSignalReceiverProvidedApis = StartScheduleTableAbs
          OsIsrXSignalReceiverProvidedApis = StartScheduleTableRel
          OsIsrXSignalReceiverProvidedApis = StopScheduleTable
          OsIsrXSignalReceiverProvidedApis = TerminateApplication
      XSignalIsr_OsCore0: OsIsrInterruptPriority=1, OsIsrInterruptSource=2448, OsIsrSpecialFunctionName=Os_XSigRecvIsrHandler
        OsIsrXSignalReceiver:
          OsIsrXSignalReceiverProvidedApis = ShutdownAllCores
          OsIsrXSignalReceiverProvidedApis = ActivateTask
          OsIsrXSignalReceiverProvidedApis = CancelAlarm
          OsIsrXSignalReceiverProvidedApis = ChainTask
          OsIsrXSignalReceiverProvidedApis = ControlIdle
          OsIsrXSignalReceiverProvidedApis = GetAlarm
          OsIsrXSignalReceiverProvidedApis = GetApplicationState
          OsIsrXSignalReceiverProvidedApis = GetCounterValue
          OsIsrXSignalReceiverProvidedApis = GetElapsedValue
          OsIsrXSignalReceiverProvidedApis = GetErrorHookStackUsage
          OsIsrXSignalReceiverProvidedApis = GetEvent
          OsIsrXSignalReceiverProvidedApis = GetISRStackUsage
          OsIsrXSignalReceiverProvidedApis = GetKernelStackUsage
          OsIsrXSignalReceiverProvidedApis = GetNonTrustedFunctionStackUsage
          OsIsrXSignalReceiverProvidedApis = GetProtectionHookStackUsage
          OsIsrXSignalReceiverProvidedApis = GetScheduleTableStatus
          OsIsrXSignalReceiverProvidedApis = GetShutdownHookStackUsage
          OsIsrXSignalReceiverProvidedApis = GetStartupHookStackUsage
          OsIsrXSignalReceiverProvidedApis = GetTaskStackUsage
          OsIsrXSignalReceiverProvidedApis = GetTaskState
          OsIsrXSignalReceiverProvidedApis = HookCallCallback
          OsIsrXSignalReceiverProvidedApis = NextScheduleTable
          OsIsrXSignalReceiverProvidedApis = SetAbsAlarm
          OsIsrXSignalReceiverProvidedApis = SetEvent
          OsIsrXSignalReceiverProvidedApis = SetRelAlarm
          OsIsrXSignalReceiverProvidedApis = StartScheduleTableAbs
          OsIsrXSignalReceiverProvidedApis = StartScheduleTableRel
          OsIsrXSignalReceiverProvidedApis = StopScheduleTable
          OsIsrXSignalReceiverProvidedApis = TerminateApplication
      CounterIsr_SystemTimer_OsCore1: OsIsrInterruptPriority=100, OsIsrInterruptSource=776, OsIsrSpecialFunctionName=Os_TimerHrtIsr
      CounterIsr_SystemTimer_OsCore2: OsIsrInterruptPriority=100, OsIsrInterruptSource=784, OsIsrSpecialFunctionName=Os_TimerHrtIsr
      CounterIsr_SystemTimer_OsCore3: OsIsrInterruptPriority=100, OsIsrInterruptSource=792, OsIsrSpecialFunctionName=Os_TimerHrtIsr
      CounterIsr_SystemTimer_OsCore4: OsIsrInterruptPriority=100, OsIsrInterruptSource=800, OsIsrSpecialFunctionName=Os_TimerHrtIsr
      CounterIsr_SystemTimer_OsCore5: OsIsrInterruptPriority=100, OsIsrInterruptSource=808, OsIsrSpecialFunctionName=Os_TimerHrtIsr
    5 x OsCounter, all with OsCounterMaxAllowedValue=1073741823, OsCounterMinCycle=1, OsCounterTicksPerBase=1, OsCounterType=HARDWARE, OsSecondsPerTick=1E-8, OsCounterAccessingApplication=SystemApplication_OsCore0, OsCounterAccessingApplication=SystemApplication_OsCore1, OsCounterAccessingApplication=SystemApplication_OsCore2, OsCounterAccessingApplication=SystemApplication_OsCore3, OsCounterAccessingApplication=SystemApplication_OsCore4, OsCounterAccessingApplication=SystemApplication_OsCore5:
      SystemTimer_OsCore1
        OsDriver: OsDriverHighResolution=true, OsDriverHardwareTimerChannelRef=STM1_Ch0, OsDriverIsrRef=CounterIsr_SystemTimer_OsCore1
      SystemTimer_OsCore2
        OsDriver: OsDriverHighResolution=true, OsDriverHardwareTimerChannelRef=STM2_Ch0, OsDriverIsrRef=CounterIsr_SystemTimer_OsCore2
      SystemTimer_OsCore3
        OsDriver: OsDriverHighResolution=true, OsDriverHardwareTimerChannelRef=STM3_Ch0, OsDriverIsrRef=CounterIsr_SystemTimer_OsCore3
      SystemTimer_OsCore4
        OsDriver: OsDriverHighResolution=true, OsDriverHardwareTimerChannelRef=STM4_Ch0, OsDriverIsrRef=CounterIsr_SystemTimer_OsCore4
      SystemTimer_OsCore5
        OsDriver: OsDriverHighResolution=true, OsDriverHardwareTimerChannelRef=STM5_Ch0, OsDriverIsrRef=CounterIsr_SystemTimer_OsCore5
    15 x OsTask, all with OsTaskSchedule=FULL, OsTaskStackSharing=false, OsTaskStackSize=1024, OsTaskType=AUTO, OsTaskUsesFpu=false, OsTaskAccessingApplication=SystemApplication_OsCore0, OsTaskAccessingApplication=OsApplication_OsCore0, OsTaskAccessingApplication=SystemApplication_OsCore1, OsTaskAccessingApplication=SystemApplication_OsCore2, OsTaskAccessingApplication=SystemApplication_OsCore3, OsTaskAccessingApplication=SystemApplication_OsCore4, OsTaskAccessingApplication=SystemApplication_OsCore5:
      OsTask_Bsw_OsCore1: OsTaskActivation=100, OsTaskPriority=34, OsTaskAccessingApplication=OsApplication_OsCore2, OsTaskAccessingApplication=OsApplication_OsCore3, OsTaskAccessingApplication=OsApplication_OsCore4, OsTaskAccessingApplication=OsApplication_OsCore5
      OsTask_Bsw_OsCore2: OsTaskActivation=100, OsTaskPriority=33, OsTaskAccessingApplication=OsApplication_OsCore1, OsTaskAccessingApplication=OsApplication_OsCore3, OsTaskAccessingApplication=OsApplication_OsCore4, OsTaskAccessingApplication=OsApplication_OsCore5
      OsTask_Bsw_OsCore3: OsTaskActivation=100, OsTaskPriority=32, OsTaskAccessingApplication=OsApplication_OsCore1, OsTaskAccessingApplication=OsApplication_OsCore2, OsTaskAccessingApplication=OsApplication_OsCore4, OsTaskAccessingApplication=OsApplication_OsCore5
      OsTask_Bsw_OsCore4: OsTaskActivation=100, OsTaskPriority=31, OsTaskAccessingApplication=OsApplication_OsCore1, OsTaskAccessingApplication=OsApplication_OsCore2, OsTaskAccessingApplication=OsApplication_OsCore3, OsTaskAccessingApplication=OsApplication_OsCore5
      OsTask_Bsw_OsCore5: OsTaskActivation=100, OsTaskPriority=30, OsTaskAccessingApplication=OsApplication_OsCore1, OsTaskAccessingApplication=OsApplication_OsCore2, OsTaskAccessingApplication=OsApplication_OsCore3, OsTaskAccessingApplication=OsApplication_OsCore4
      OsTask_Asw_OsCore1: OsTaskActivation=100, OsTaskPriority=14, OsTaskAccessingApplication=OsApplication_OsCore2, OsTaskAccessingApplication=OsApplication_OsCore3, OsTaskAccessingApplication=OsApplication_OsCore4, OsTaskAccessingApplication=OsApplication_OsCore5
      OsTask_Asw_OsCore2: OsTaskActivation=100, OsTaskPriority=13, OsTaskAccessingApplication=OsApplication_OsCore1, OsTaskAccessingApplication=OsApplication_OsCore3, OsTaskAccessingApplication=OsApplication_OsCore4, OsTaskAccessingApplication=OsApplication_OsCore5
      OsTask_Asw_OsCore3: OsTaskActivation=100, OsTaskPriority=12, OsTaskAccessingApplication=OsApplication_OsCore1, OsTaskAccessingApplication=OsApplication_OsCore2, OsTaskAccessingApplication=OsApplication_OsCore4, OsTaskAccessingApplication=OsApplication_OsCore5
      OsTask_Asw_OsCore4: OsTaskActivation=100, OsTaskPriority=11, OsTaskAccessingApplication=OsApplication_OsCore1, OsTaskAccessingApplication=OsApplication_OsCore2, OsTaskAccessingApplication=OsApplication_OsCore3, OsTaskAccessingApplication=OsApplication_OsCore5
      OsTask_Asw_OsCore5: OsTaskActivation=100, OsTaskPriority=10, OsTaskAccessingApplication=OsApplication_OsCore1, OsTaskAccessingApplication=OsApplication_OsCore2, OsTaskAccessingApplication=OsApplication_OsCore3, OsTaskAccessingApplication=OsApplication_OsCore4
      OsTask_Init_OsCore1: OsTaskActivation=1, OsTaskPriority=48, OsTaskAccessingApplication=OsApplication_OsCore2, OsTaskAccessingApplication=OsApplication_OsCore3, OsTaskAccessingApplication=OsApplication_OsCore4, OsTaskAccessingApplication=OsApplication_OsCore5
      OsTask_Init_OsCore2: OsTaskActivation=1, OsTaskPriority=48, OsTaskAccessingApplication=OsApplication_OsCore1, OsTaskAccessingApplication=OsApplication_OsCore3, OsTaskAccessingApplication=OsApplication_OsCore4, OsTaskAccessingApplication=OsApplication_OsCore5
      OsTask_Init_OsCore3: OsTaskActivation=1, OsTaskPriority=48, OsTaskAccessingApplication=OsApplication_OsCore1, OsTaskAccessingApplication=OsApplication_OsCore2, OsTaskAccessingApplication=OsApplication_OsCore4, OsTaskAccessingApplication=OsApplication_OsCore5
      OsTask_Init_OsCore4: OsTaskActivation=1, OsTaskPriority=48, OsTaskAccessingApplication=OsApplication_OsCore1, OsTaskAccessingApplication=OsApplication_OsCore2, OsTaskAccessingApplication=OsApplication_OsCore3, OsTaskAccessingApplication=OsApplication_OsCore5
      OsTask_Init_OsCore5: OsTaskActivation=1, OsTaskPriority=48, OsTaskAccessingApplication=OsApplication_OsCore1, OsTaskAccessingApplication=OsApplication_OsCore2, OsTaskAccessingApplication=OsApplication_OsCore3, OsTaskAccessingApplication=OsApplication_OsCore4
    5 x OsApplication, all with OsTrusted=true, OsTrustedApplicationDelayTimingViolationCall=false, OsTrustedApplicationWithProtection=false, OsApplicationIsPrivileged=true, OsAppUseTrustedFunctionStubs=false:
      OsApplication_OsCore1: OsApplicationCoreRef=EcucCoreDefinition_Core1, OsAppTaskRef=OsTask_Asw_OsCore1, OsAppTaskRef=OsTask_Bsw_OsCore1, OsAppTaskRef=OsTask_Init_OsCore1, OsAppEcucPartitionRef=EcucPartition_Core1, OsAppAlarmRef=Rte_Al_TE_Cdd_Core1_Cdd_Core1_Runnable10ms, OsAppTaskRef=Default_Init_Task_Core1, OsAppTaskRef=Default_Init_Task_Core1_Trusted, OsAppAlarmRef=Rte_Al_TE2_EcuM_EcuM_MainFunction
        OsApplicationHooks: OsAppErrorHook=false, OsAppShutdownHook=false, OsAppStartupHook=false
      OsApplication_OsCore2: OsApplicationCoreRef=EcucCoreDefinition_Core2, OsAppTaskRef=OsTask_Asw_OsCore2, OsAppTaskRef=OsTask_Bsw_OsCore2, OsAppTaskRef=OsTask_Init_OsCore2, OsAppEcucPartitionRef=EcucPartition_Core2, OsAppAlarmRef=Rte_Al_TE_Cdd_Core2_Cdd_Core2_Runnable10ms, OsAppTaskRef=Default_Init_Task_Core2, OsAppTaskRef=Default_Init_Task_Core2_Trusted, OsAppAlarmRef=Rte_Al_TE3_EcuM_EcuM_MainFunction
        OsApplicationHooks: OsAppErrorHook=false, OsAppShutdownHook=false, OsAppStartupHook=false
      OsApplication_OsCore3: OsApplicationCoreRef=EcucCoreDefinition_Core3, OsAppTaskRef=OsTask_Asw_OsCore3, OsAppTaskRef=OsTask_Bsw_OsCore3, OsAppTaskRef=OsTask_Init_OsCore3, OsAppEcucPartitionRef=EcucPartition_Core3, OsAppAlarmRef=Rte_Al_TE_Cdd_Core3_Cdd_Core3_Runnable10ms, OsAppTaskRef=Default_Init_Task_Core3, OsAppTaskRef=Default_Init_Task_Core3_Trusted, OsAppAlarmRef=Rte_Al_TE4_EcuM_EcuM_MainFunction
        OsApplicationHooks: OsAppErrorHook=false, OsAppShutdownHook=false, OsAppStartupHook=false
      OsApplication_OsCore4: OsApplicationCoreRef=EcucCoreDefinition_Core4, OsAppTaskRef=OsTask_Asw_OsCore4, OsAppTaskRef=OsTask_Bsw_OsCore4, OsAppTaskRef=OsTask_Init_OsCore4, OsAppEcucPartitionRef=EcucPartition_Core4, OsAppAlarmRef=Rte_Al_TE_Cdd_Core4_Cdd_Core4_Runnable10ms, OsAppTaskRef=Default_Init_Task_Core4, OsAppTaskRef=Default_Init_Task_Core4_Trusted, OsAppAlarmRef=Rte_Al_TE5_EcuM_EcuM_MainFunction
        OsApplicationHooks: OsAppErrorHook=false, OsAppShutdownHook=false, OsAppStartupHook=false
      OsApplication_OsCore5: OsApplicationCoreRef=EcucCoreDefinition_Core5, OsAppTaskRef=OsTask_Asw_OsCore5, OsAppTaskRef=OsTask_Bsw_OsCore5, OsAppTaskRef=OsTask_Init_OsCore5, OsAppEcucPartitionRef=EcucPartition_Core5, OsAppAlarmRef=Rte_Al_TE_Cdd_Core5_Cdd_Core5_Runnable10ms, OsAppTaskRef=Default_Init_Task_Core6, OsAppTaskRef=Default_Init_Task_Core6_Trusted, OsAppAlarmRef=Rte_Al_TE6_EcuM_EcuM_MainFunction
        OsApplicationHooks: OsAppErrorHook=false, OsAppShutdownHook=false, OsAppStartupHook=false
    10 x OsAlarm, all with OsAlarmAccessingApplication=OsApplication_OsCore0, OsAlarmAccessingApplication=SystemApplication_OsCore0, OsAlarmAccessingApplication=SystemApplication_OsCore1, OsAlarmAccessingApplication=SystemApplication_OsCore2, OsAlarmAccessingApplication=SystemApplication_OsCore3, OsAlarmAccessingApplication=SystemApplication_OsCore4, OsAlarmAccessingApplication=SystemApplication_OsCore5:
      Rte_Al_TE_Cdd_Core1_Cdd_Core1_Runnable10ms: OsAlarmCounterRef=SystemTimer_OsCore1, OsAlarmAccessingApplication=OsApplication_OsCore2, OsAlarmAccessingApplication=OsApplication_OsCore3, OsAlarmAccessingApplication=OsApplication_OsCore4, OsAlarmAccessingApplication=OsApplication_OsCore5
        OsAlarmAction
          OsAlarmActivateTask: OsAlarmActivateTaskRef=OsTask_Asw_OsCore1
      Rte_Al_TE_Cdd_Core2_Cdd_Core2_Runnable10ms: OsAlarmCounterRef=SystemTimer_OsCore2, OsAlarmAccessingApplication=OsApplication_OsCore1, OsAlarmAccessingApplication=OsApplication_OsCore3, OsAlarmAccessingApplication=OsApplication_OsCore4, OsAlarmAccessingApplication=OsApplication_OsCore5
        OsAlarmAction
          OsAlarmActivateTask: OsAlarmActivateTaskRef=OsTask_Asw_OsCore2
      Rte_Al_TE_Cdd_Core3_Cdd_Core3_Runnable10ms: OsAlarmCounterRef=SystemTimer_OsCore3, OsAlarmAccessingApplication=OsApplication_OsCore1, OsAlarmAccessingApplication=OsApplication_OsCore2, OsAlarmAccessingApplication=OsApplication_OsCore4, OsAlarmAccessingApplication=OsApplication_OsCore5
        OsAlarmAction
          OsAlarmActivateTask: OsAlarmActivateTaskRef=OsTask_Asw_OsCore3
      Rte_Al_TE_Cdd_Core4_Cdd_Core4_Runnable10ms: OsAlarmCounterRef=SystemTimer_OsCore4, OsAlarmAccessingApplication=OsApplication_OsCore1, OsAlarmAccessingApplication=OsApplication_OsCore2, OsAlarmAccessingApplication=OsApplication_OsCore3, OsAlarmAccessingApplication=OsApplication_OsCore5
        OsAlarmAction
          OsAlarmActivateTask: OsAlarmActivateTaskRef=OsTask_Asw_OsCore4
      Rte_Al_TE_Cdd_Core5_Cdd_Core5_Runnable10ms: OsAlarmCounterRef=SystemTimer_OsCore5, OsAlarmAccessingApplication=OsApplication_OsCore1, OsAlarmAccessingApplication=OsApplication_OsCore2, OsAlarmAccessingApplication=OsApplication_OsCore3, OsAlarmAccessingApplication=OsApplication_OsCore4
        OsAlarmAction
          OsAlarmActivateTask: OsAlarmActivateTaskRef=OsTask_Asw_OsCore5
      Rte_Al_TE2_EcuM_EcuM_MainFunction: OsAlarmCounterRef=SystemTimer_OsCore1, OsAlarmAccessingApplication=OsApplication_OsCore2, OsAlarmAccessingApplication=OsApplication_OsCore3, OsAlarmAccessingApplication=OsApplication_OsCore4, OsAlarmAccessingApplication=OsApplication_OsCore5
        OsAlarmAction
          OsAlarmActivateTask: OsAlarmActivateTaskRef=OsTask_Bsw_OsCore1
      Rte_Al_TE3_EcuM_EcuM_MainFunction: OsAlarmCounterRef=SystemTimer_OsCore2, OsAlarmAccessingApplication=OsApplication_OsCore1, OsAlarmAccessingApplication=OsApplication_OsCore3, OsAlarmAccessingApplication=OsApplication_OsCore4, OsAlarmAccessingApplication=OsApplication_OsCore5
        OsAlarmAction
          OsAlarmActivateTask: OsAlarmActivateTaskRef=OsTask_Bsw_OsCore2
      Rte_Al_TE4_EcuM_EcuM_MainFunction: OsAlarmCounterRef=SystemTimer_OsCore3, OsAlarmAccessingApplication=OsApplication_OsCore1, OsAlarmAccessingApplication=OsApplication_OsCore2, OsAlarmAccessingApplication=OsApplication_OsCore4, OsAlarmAccessingApplication=OsApplication_OsCore5
        OsAlarmAction
          OsAlarmActivateTask: OsAlarmActivateTaskRef=OsTask_Bsw_OsCore3
      Rte_Al_TE5_EcuM_EcuM_MainFunction: OsAlarmCounterRef=SystemTimer_OsCore4, OsAlarmAccessingApplication=OsApplication_OsCore1, OsAlarmAccessingApplication=OsApplication_OsCore2, OsAlarmAccessingApplication=OsApplication_OsCore3, OsAlarmAccessingApplication=OsApplication_OsCore5
        OsAlarmAction
          OsAlarmActivateTask: OsAlarmActivateTaskRef=OsTask_Bsw_OsCore4
      Rte_Al_TE6_EcuM_EcuM_MainFunction: OsAlarmCounterRef=SystemTimer_OsCore5, OsAlarmAccessingApplication=OsApplication_OsCore1, OsAlarmAccessingApplication=OsApplication_OsCore2, OsAlarmAccessingApplication=OsApplication_OsCore3, OsAlarmAccessingApplication=OsApplication_OsCore4
        OsAlarmAction
          OsAlarmActivateTask: OsAlarmActivateTaskRef=OsTask_Bsw_OsCore5
    3 x OsTask, all with OsTaskSchedule=FULL, OsTaskStackSharing=false, OsTaskStackSize=1024, OsTaskType=AUTO, OsTaskUsesFpu=false, OsTaskAccessingApplication=SystemApplication_OsCore0, OsTaskAccessingApplication=SystemApplication_OsCore1, OsTaskAccessingApplication=SystemApplication_OsCore2, OsTaskAccessingApplication=SystemApplication_OsCore3, OsTaskAccessingApplication=SystemApplication_OsCore4, OsTaskAccessingApplication=SystemApplication_OsCore5, OsTaskAccessingApplication=OsApplication_OsCore0, OsTaskAccessingApplication=OsApplication_OsCore1, OsTaskAccessingApplication=OsApplication_OsCore2, OsTaskAccessingApplication=OsApplication_OsCore3, OsTaskAccessingApplication=OsApplication_OsCore4, OsTaskAccessingApplication=OsApplication_OsCore5:
      OsTask_Bsw_10ms_Core0: OsTaskActivation=1, OsTaskPriority=30
      OsTask_Bsw_20ms_Core0: OsTaskActivation=3, OsTaskPriority=20
      OsTask_Bsw_1ms_Core0: OsTaskActivation=3, OsTaskPriority=50
    Rte_Al_TE2_OsTask_Bsw_10ms_Core0_0_10ms (OsAlarm):
      OsAlarmCounterRef = SystemTimer_OsCore0
      OsAlarmAccessingApplication = OsApplication_OsCore{1..5}
      OsAlarmAccessingApplication = SystemApplication_OsCore{0..5}
      OsAlarmAction
        OsAlarmActivateTask: OsAlarmActivateTaskRef=OsTask_Bsw_10ms_Core0
    EthIsr_EthCtrlConfig_MAIN_EthInterruptServiceRoutine_Q0Tx (OsIsr):  # /ActiveEcuC/Eth PLAIN_TEXT ISR for Ethernet Module (EthCtrlConfig_MAIN).
      OsIsrInterruptPriority = 50
      OsIsrCategory = CATEGORY_2
      OsIsrInterruptType = EXTERNAL
      OsIsrInterruptSource = 1416
      OsIsrStackSize = 1024
      OsIsrEnableNesting = false
      OsIsrUsesFpu = false
      OsIsrInitialEnableInterruptSource = true
    3 x OsAlarm, all with OsAlarmCounterRef=SystemTimer_OsCore0, OsAlarmAccessingApplication=OsApplication_OsCore1, OsAlarmAccessingApplication=OsApplication_OsCore2, OsAlarmAccessingApplication=OsApplication_OsCore3, OsAlarmAccessingApplication=OsApplication_OsCore4, OsAlarmAccessingApplication=OsApplication_OsCore5, OsAlarmAccessingApplication=SystemApplication_OsCore0, OsAlarmAccessingApplication=SystemApplication_OsCore1, OsAlarmAccessingApplication=SystemApplication_OsCore2, OsAlarmAccessingApplication=SystemApplication_OsCore3, OsAlarmAccessingApplication=SystemApplication_OsCore4, OsAlarmAccessingApplication=SystemApplication_OsCore5:
      Rte_Al_TE_EthTrcv_30_Tja1100_EthTrcv_30_Tja1100_MainFunction
        OsAlarmAction
          OsAlarmActivateTask: OsAlarmActivateTaskRef=OsTask_Bsw_20ms_Core0
      Rte_Al_TE_Cdd_Core0_Cdd_Core0_Runnable20ms
        OsAlarmAction
          OsAlarmSetEvent: OsAlarmSetEventRef=Rte_Ev_Run_Cdd_Core0_Cdd_Core0_Runnable20ms, OsAlarmSetEventTaskRef=Os/OsTask_Asw_OsCore0
      Rte_Al_TE_OsTask_Asw_OsCore0_0_10ms
        OsAlarmAction
          OsAlarmSetEvent: OsAlarmSetEventRef=Rte_Ev_Cyclic_OsTask_Asw_OsCore0_0_10ms, OsAlarmSetEventTaskRef=Os/OsTask_Asw_OsCore0
    Rte_Ev_Cyclic_OsTask_Asw_OsCore0_0_10ms (OsEvent)
    Rte_Ev_Run_Cdd_Core0_Cdd_Core0_Runnable20ms (OsEvent)
    Rte_Al_TE_OsTask_Asw_OsCore0_0_5ms (OsAlarm):
      OsAlarmCounterRef = SystemTimer_OsCore0
      OsAlarmAccessingApplication = OsApplication_OsCore{1..5}
      OsAlarmAccessingApplication = SystemApplication_OsCore{0..5}
      OsAlarmAction
        OsAlarmSetEvent: OsAlarmSetEventRef=Rte_Ev_Cyclic_OsTask_Asw_OsCore0_0_5ms, OsAlarmSetEventTaskRef=Os/OsTask_Asw_OsCore0
    Rte_Ev_Cyclic_OsTask_Asw_OsCore0_0_5ms (OsEvent)
    Rte_Al_TE_Cdd_Core0_Cdd_Core0_Runnable1ms (OsAlarm):
      OsAlarmCounterRef = SystemTimer_OsCore0
      OsAlarmAccessingApplication = OsApplication_OsCore{1..5}
      OsAlarmAccessingApplication = SystemApplication_OsCore{0..5}
      OsAlarmAction
        OsAlarmSetEvent: OsAlarmSetEventRef=Rte_Ev_Run_Cdd_Core0_Cdd_Core0_Runnable1ms, OsAlarmSetEventTaskRef=Os/OsTask_Asw_OsCore0
    Rte_Ev_Run_Cdd_Core0_Cdd_Core0_Runnable1ms (OsEvent)
    ASCLIN0TX_ISR (OsIsr):
      OsIsrInterruptPriority = 129
      OsIsrCategory = CATEGORY_2
      OsIsrInterruptType = EXTERNAL
      OsIsrInterruptSource = 80
      OsIsrStackSize = 1024
      OsIsrEnableNesting = false
      OsIsrUsesFpu = false
      OsIsrInitialEnableInterruptSource = false
    ASCLIN0ERR_ISR (OsIsr):
      OsIsrInterruptPriority = 128
      OsIsrCategory = CATEGORY_2
      OsIsrInterruptType = EXTERNAL
      OsIsrInterruptSource = 88
      OsIsrStackSize = 1024
      OsIsrEnableNesting = false
      OsIsrUsesFpu = false
      OsIsrInitialEnableInterruptSource = false
    3 x OsAlarm, all with OsAlarmCounterRef=SystemTimer_OsCore0, OsAlarmAccessingApplication=OsApplication_OsCore1, OsAlarmAccessingApplication=OsApplication_OsCore2, OsAlarmAccessingApplication=OsApplication_OsCore3, OsAlarmAccessingApplication=OsApplication_OsCore4, OsAlarmAccessingApplication=OsApplication_OsCore5, OsAlarmAccessingApplication=SystemApplication_OsCore0, OsAlarmAccessingApplication=SystemApplication_OsCore1, OsAlarmAccessingApplication=SystemApplication_OsCore2, OsAlarmAccessingApplication=SystemApplication_OsCore3, OsAlarmAccessingApplication=SystemApplication_OsCore4, OsAlarmAccessingApplication=SystemApplication_OsCore5:
      Rte_Al_TE2_OsTask_Bsw_5ms_Core0_0_5ms
        OsAlarmAction
          OsAlarmSetEvent: OsAlarmSetEventRef=Rte_Ev_Cyclic2_OsTask_Bsw_5ms_Core0_0_5ms, OsAlarmSetEventTaskRef=Os/OsTask_Bsw_5ms_Core0
      Rte_Al_TE2_OsTask_Bsw_5ms_Core0_0_10ms
        OsAlarmAction
          OsAlarmSetEvent: OsAlarmSetEventRef=Rte_Ev_Cyclic2_OsTask_Bsw_5ms_Core0_0_10ms, OsAlarmSetEventTaskRef=Os/OsTask_Bsw_5ms_Core0
      Rte_Al_TE_EthIf_EthIf_MainFunctionState
        OsAlarmAction
          OsAlarmSetEvent: OsAlarmSetEventRef=Rte_Ev_Run_EthIf_EthIf_MainFunctionState, OsAlarmSetEventTaskRef=Os/OsTask_Bsw_5ms_Core0
    3 x OsEvent:
      Rte_Ev_Cyclic2_OsTask_Bsw_5ms_Core0_0_10ms
      Rte_Ev_Cyclic2_OsTask_Bsw_5ms_Core0_0_5ms
      Rte_Ev_Run_EthIf_EthIf_MainFunctionState
    Rte_Al_TE2_OsTask_Bsw_5ms_Core0_0_20ms (OsAlarm):
      OsAlarmCounterRef = SystemTimer_OsCore0
      OsAlarmAccessingApplication = OsApplication_OsCore{1..5}
      OsAlarmAccessingApplication = SystemApplication_OsCore{0..5}
      OsAlarmAction
        OsAlarmSetEvent: OsAlarmSetEventRef=Rte_Ev_Cyclic2_OsTask_Bsw_5ms_Core0_0_20ms, OsAlarmSetEventTaskRef=Os/OsTask_Bsw_5ms_Core0
    Rte_Ev_Cyclic2_OsTask_Bsw_5ms_Core0_0_20ms (OsEvent)
    EthIsr_PPS (OsIsr):
      OsIsrInterruptPriority = 130
      OsIsrCategory = CATEGORY_2
      OsIsrInterruptType = EXTERNAL
      OsIsrInterruptSource = 1412
      OsIsrStackSize = 1024
      OsIsrEnableNesting = false
      OsIsrUsesFpu = false
      OsIsrInitialEnableInterruptSource = true
    Rte_Al_TE_Cdd_Stbm_Cdd_Stbm_Runnable100ms (OsAlarm):
      OsAlarmCounterRef = SystemTimer_OsCore0
      OsAlarmAccessingApplication = OsApplication_OsCore{1..5}
      OsAlarmAccessingApplication = SystemApplication_OsCore{0..5}
      OsAlarmAction
        OsAlarmSetEvent: OsAlarmSetEventRef=Rte_Ev_Run_Cdd_Stbm_Cdd_Stbm_Runnable100ms, OsAlarmSetEventTaskRef=Os/OsTask_Asw_OsCore0
    Rte_Ev_Run_Cdd_Stbm_Cdd_Stbm_Runnable100ms (OsEvent)
    Rte_Al_TE2_OsTask_Bsw_1ms_Core0_0_1ms (OsAlarm):
      OsAlarmCounterRef = SystemTimer_OsCore0
      OsAlarmAccessingApplication = OsApplication_OsCore{1..5}
      OsAlarmAccessingApplication = SystemApplication_OsCore{0..5}
      OsAlarmAction
        OsAlarmActivateTask: OsAlarmActivateTaskRef=OsTask_Bsw_1ms_Core0
