AUTOSAR XML (schema 00048)
package /ActiveEcuC
  module config vSet: implementation-config-variant=VARIANT-PRE-COMPILE, module-description=vSet_Impl
    vSetGeneral: vSetDummyStatementKind=None
    vSetPlatform:
      vSetSizeOfROMPointer = Size32Bit
      vSetSizeOfInt = Size32Bit
      vSetBitOrder = LSB_to_MSB
      vSetCPUType = CPU32Bit
      vSetSizeOfRAMPointer = Size32Bit
      vSetByteOrder = LITTLE_ENDIAN
      vSetSizeOfEnum = Size32Bit
    vSetCalibration
