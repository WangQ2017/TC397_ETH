AUTOSAR XML (schema 00048)
package /Port
  module config Port: implementation-config-variant=VARIANT-POST-BUILD, module-description=Port_Impl
    CommonPublishedInformation:
      ArMajorVersion = 4
      ArMinorVersion = 2
      ArPatchVersion = 2
      ModuleId = 124
      Release = _TRICORE_TC397
      SwMajorVersion = 3
      SwMinorVersion = 0
      SwPatchVersion = 1
      VendorId = 17
    PortConfigSet
      17 x PortContainer:
        PortContainer_0: PortNumber=0, PortNumberOfPortPins=13
          13 x PortPin, all with PortPinControllerSelect=DISABLE, PortPinDirectionChangeable=false, PortPinEmergencyStop=false, PortPinEnableAnalogInputOnly=PORT_PIN_ANALOG_INPUT_DISABLE, PortPinInputPadLevel=PORT_INPUT_LEVEL_CMOS_AUTOMOTIVE, PortPinInputPullResistor=PORT_PIN_IN_PULL_UP, PortPinLevelValue=PORT_PIN_LEVEL_LOW, PortPinMode=PORT_PIN_MODE_ALL, PortPinModeChangeable=false, PortPinOutputPadDriveStrength=PORT_PIN_DEFAULT_DRIVER, PortPinOutputPinDriveMode=PORT_PIN_OUT_PUSHPULL:
            PortPin_0: PortPinDirection=PORT_PIN_IN, PortPinId=0, PortPinInitialMode=GPIO, PortPinSymbolicName=PORT_0_PIN_0
            PortPin_1: PortPinDirection=PORT_PIN_IN, PortPinId=1, PortPinInitialMode=GPIO, PortPinSymbolicName=PORT_0_PIN_1
            PortPin_{10..12}: PortPinDirection=PORT_PIN_IN, PortPinId={10..12}, PortPinInitialMode=GPIO, PortPinSymbolicName=PORT_0_PIN_{10..12}
            PortPin_2_CAN21_TxD: PortPinDirection=PORT_PIN_OUT, PortPinId=2, PortPinInitialMode=ALT3, PortPinSymbolicName=PORT_0_PIN_2
            PortPin_3CAN21_RxD_A: PortPinDirection=PORT_PIN_IN, PortPinId=3, PortPinInitialMode=GPIO, PortPinSymbolicName=PORT_0_PIN_3
            PortPin_4CAN11_TxD: PortPinDirection=PORT_PIN_OUT, PortPinId=4, PortPinInitialMode=ALT3, PortPinSymbolicName=PORT_0_PIN_4
            PortPin_5CAN11_RxD_B: PortPinDirection=PORT_PIN_IN, PortPinId=5, PortPinInitialMode=GPIO, PortPinSymbolicName=PORT_0_PIN_5
            PortPin_6LIN5_ARX_A: PortPinDirection=PORT_PIN_IN, PortPinId=6, PortPinInitialMode=GPIO, PortPinSymbolicName=PORT_0_PIN_6
            PortPin_7LIN5_ATX: PortPinDirection=PORT_PIN_OUT, PortPinId=7, PortPinInitialMode=ALT2, PortPinSymbolicName=PORT_0_PIN_7
            PortPin_8: PortPinDirection=PORT_PIN_IN, PortPinId=8, PortPinInitialMode=GPIO, PortPinSymbolicName=PORT_0_PIN_8
            PortPin_9LIN4_ATX: PortPinDirection=PORT_PIN_OUT, PortPinId=9, PortPinInitialMode=ALT5, PortPinSymbolicName=PORT_0_PIN_9
        PortContainer_1: PortNumber=1, PortNumberOfPortPins=5
          5 x PortPin, all with PortPinControllerSelect=DISABLE, PortPinDirection=PORT_PIN_IN, PortPinDirectionChangeable=false, PortPinEmergencyStop=false, PortPinEnableAnalogInputOnly=PORT_PIN_ANALOG_INPUT_DISABLE, PortPinInitialMode=GPIO, PortPinInputPadLevel=PORT_INPUT_LEVEL_CMOS_AUTOMOTIVE, PortPinInputPullResistor=PORT_PIN_IN_PULL_UP, PortPinLevelValue=PORT_PIN_LEVEL_LOW, PortPinMode=PORT_PIN_MODE_ALL, PortPinModeChangeable=false, PortPinOutputPadDriveStrength=PORT_PIN_DEFAULT_DRIVER, PortPinOutputPinDriveMode=PORT_PIN_OUT_PUSHPULL:
            PortPin_0: PortPinId=19, PortPinSymbolicName=PORT_1_PIN_3
            PortPin_1: PortPinId=20, PortPinSymbolicName=PORT_1_PIN_4
            PortPin_2: PortPinId=21, PortPinSymbolicName=PORT_1_PIN_5
            PortPin_3: PortPinId=22, PortPinSymbolicName=PORT_1_PIN_6
            PortPin_4: PortPinId=23, PortPinSymbolicName=PORT_1_PIN_7
        PortContainer_21: PortNumber=21, PortNumberOfPortPins=8
          3 x PortLVDS, all with PortLVDSMode=LVDSH, PortLVDSPadSupply=V3_3, PortLVDSRxEnController=PORT_CONTROLLED, PortLVDSRxPathEnable=false, PortLVDSRxTerminationMode=INTERNAL_TERMINATION, PortLVDSTxEnController=PORT_CONTROLLED, PortLVDSTxPathEnable=false, PortLVDSTxPowerDownPullDown=DISABLE:
            PortLVDS_0: PortLVDSPinPair=Pin_0_Pin_1
            PortLVDS_1: PortLVDSPinPair=Pin_2_Pin_3
            PortLVDS_2: PortLVDSPinPair=Pin_4_Pin_5
          8 x PortPin, all with PortPinControllerSelect=DISABLE, PortPinDirectionChangeable=false, PortPinEmergencyStop=false, PortPinEnableAnalogInputOnly=PORT_PIN_ANALOG_INPUT_DISABLE, PortPinInitialMode=GPIO, PortPinInputPadLevel=PORT_INPUT_LEVEL_CMOS_AUTOMOTIVE, PortPinInputPullResistor=PORT_PIN_IN_PULL_UP, PortPinMode=PORT_PIN_MODE_ALL, PortPinModeChangeable=false, PortPinOutputPadDriveStrength=PORT_PIN_DEFAULT_DRIVER, PortPinOutputPinDriveMode=PORT_PIN_OUT_PUSHPULL:
            PortPin_0: PortPinDirection=PORT_PIN_IN, PortPinId=336, PortPinLevelValue=PORT_PIN_LEVEL_LOW, PortPinSymbolicName=PORT_21_PIN_0
            PortPin_1: PortPinDirection=PORT_PIN_IN, PortPinId=337, PortPinLevelValue=PORT_PIN_LEVEL_LOW, PortPinSymbolicName=PORT_21_PIN_1
            PortPin_2: PortPinDirection=PORT_PIN_IN, PortPinId=338, PortPinLevelValue=PORT_PIN_LEVEL_LOW, PortPinSymbolicName=PORT_21_PIN_2
            PortPin_3: PortPinDirection=PORT_PIN_OUT, PortPinId=339, PortPinLevelValue=PORT_PIN_LEVEL_HIGH, PortPinSymbolicName=PORT_21_PIN_3
            PortPin_4: PortPinDirection=PORT_PIN_OUT, PortPinId=340, PortPinLevelValue=PORT_PIN_LEVEL_HIGH, PortPinSymbolicName=PORT_21_PIN_4
            PortPin_5: PortPinDirection=PORT_PIN_IN, PortPinId=341, PortPinLevelValue=PORT_PIN_LEVEL_LOW, PortPinSymbolicName=PORT_21_PIN_5
            PortPin_6: PortPinDirection=PORT_PIN_IN, PortPinId=342, PortPinLevelValue=PORT_PIN_LEVEL_LOW, PortPinSymbolicName=PORT_21_PIN_6
            PortPin_7: PortPinDirection=PORT_PIN_IN, PortPinId=343, PortPinLevelValue=PORT_PIN_LEVEL_LOW, PortPinSymbolicName=PORT_21_PIN_7
        PortContainer_22: PortNumber=22, PortNumberOfPortPins=12
          4 x PortPin, all with PortPinControllerSelect=DISABLE, PortPinDirectionChangeable=false, PortPinEmergencyStop=false, PortPinEnableAnalogInputOnly=PORT_PIN_ANALOG_INPUT_DISABLE, PortPinInputPadLevel=PORT_INPUT_LEVEL_CMOS_AUTOMOTIVE, PortPinMode=PORT_PIN_MODE_ALL, PortPinModeChangeable=false, PortPinOutputPadDriveStrength=PORT_PIN_DEFAULT_DRIVER, PortPinOutputPinDriveMode=PORT_PIN_OUT_PUSHPULL:
            PortPin_10_QSPI0_MTSR: PortPinDirection=PORT_PIN_OUT, PortPinId=362, PortPinInitialMode=ALT4, PortPinInputPullResistor=PORT_PIN_IN_PULL_UP, PortPinLevelValue=PORT_PIN_LEVEL_HIGH, PortPinSymbolicName=PORT_22_PIN_10
            PortPin_11_QSPI0_CS0: PortPinDirection=PORT_PIN_OUT, PortPinId=363, PortPinInitialMode=ALT4, PortPinInputPullResistor=PORT_PIN_IN_PULL_UP, PortPinLevelValue=PORT_PIN_LEVEL_HIGH, PortPinSymbolicName=PORT_22_PIN_11
            PortPin_7_QSPI0_SCLK: PortPinDirection=PORT_PIN_OUT, PortPinId=359, PortPinInitialMode=ALT4, PortPinInputPullResistor=PORT_PIN_IN_PULL_UP, PortPinLevelValue=PORT_PIN_LEVEL_LOW, PortPinSymbolicName=PORT_22_PIN_7
            PortPin_9_QSPI0_MRSTB: PortPinDirection=PORT_PIN_IN, PortPinId=361, PortPinInitialMode=GPIO, PortPinInputPullResistor=PORT_PIN_IN_PULL_DOWN, PortPinLevelValue=PORT_PIN_LEVEL_LOW, PortPinSymbolicName=PORT_22_PIN_9
          PortLVDS_0 (PortLVDS):
            PortLVDSMode = LVDSH
            PortLVDSPadSupply = V3_3
            PortLVDSPinPair = Pin_0_Pin_1
            PortLVDSRxEnController = PORT_CONTROLLED
            PortLVDSRxPathEnable = false
            PortLVDSRxTerminationMode = INTERNAL_TERMINATION
            PortLVDSTxEnController = PORT_CONTROLLED
            PortLVDSTxPathEnable = false
            PortLVDSTxPowerDownPullDown = DISABLE
          PortLVDS_1 (PortLVDS):
            PortLVDSMode = LVDSH
            PortLVDSPadSupply = V3_3
            PortLVDSPinPair = Pin_2_Pin_3
            PortLVDSRxEnController = PORT_CONTROLLED
            PortLVDSRxPathEnable = false
            PortLVDSRxTerminationMode = INTERNAL_TERMINATION
            PortLVDSTxEnController = PORT_CONTROLLED
            PortLVDSTxPathEnable = false
            PortLVDSTxPowerDownPullDown = DISABLE
          8 x PortPin, all with PortPinControllerSelect=DISABLE, PortPinDirection=PORT_PIN_IN, PortPinDirectionChangeable=false, PortPinEmergencyStop=false, PortPinEnableAnalogInputOnly=PORT_PIN_ANALOG_INPUT_DISABLE, PortPinInitialMode=GPIO, PortPinInputPadLevel=PORT_INPUT_LEVEL_CMOS_AUTOMOTIVE, PortPinInputPullResistor=PORT_PIN_IN_PULL_UP, PortPinLevelValue=PORT_PIN_LEVEL_LOW, PortPinMode=PORT_PIN_MODE_ALL, PortPinModeChangeable=false, PortPinOutputPadDriveStrength=PORT_PIN_DEFAULT_DRIVER, PortPinOutputPinDriveMode=PORT_PIN_OUT_PUSHPULL:
            PortPin_0: PortPinId=352, PortPinSymbolicName=PORT_22_PIN_0
            PortPin_1: PortPinId=353, PortPinSymbolicName=PORT_22_PIN_1
            PortPin_2: PortPinId=354, PortPinSymbolicName=PORT_22_PIN_2
            PortPin_3: PortPinId=355, PortPinSymbolicName=PORT_22_PIN_3
            PortPin_4: PortPinId=356, PortPinSymbolicName=PORT_22_PIN_4
            PortPin_5: PortPinId=357, PortPinSymbolicName=PORT_22_PIN_5
            PortPin_6: PortPinId=358, PortPinSymbolicName=PORT_22_PIN_6
            PortPin_8: PortPinId=360, PortPinSymbolicName=PORT_22_PIN_8
        PortContainer_23: PortNumber=23, PortNumberOfPortPins=8
          8 x PortPin, all with PortPinControllerSelect=DISABLE, PortPinDirectionChangeable=false, PortPinEmergencyStop=false, PortPinEnableAnalogInputOnly=PORT_PIN_ANALOG_INPUT_DISABLE, PortPinInputPadLevel=PORT_INPUT_LEVEL_CMOS_AUTOMOTIVE, PortPinInputPullResistor=PORT_PIN_IN_PULL_UP, PortPinLevelValue=PORT_PIN_LEVEL_LOW, PortPinMode=PORT_PIN_MODE_ALL, PortPinModeChangeable=false, PortPinOutputPadDriveStrength=PORT_PIN_DEFAULT_DRIVER, PortPinOutputPinDriveMode=PORT_PIN_OUT_PUSHPULL:
            PortPin_0CAN10_RxD_C: PortPinDirection=PORT_PIN_IN, PortPinId=368, PortPinInitialMode=GPIO, PortPinSymbolicName=PORT_23_PIN_0
            PortPin_1CAN10_TxD: PortPinDirection=PORT_PIN_IN, PortPinId=369, PortPinInitialMode=GPIO, PortPinSymbolicName=PORT_23_PIN_1
            PortPin_2CAN23_TxD: PortPinDirection=PORT_PIN_OUT, PortPinId=370, PortPinInitialMode=ALT4, PortPinSymbolicName=PORT_23_PIN_2
            PortPin_3CAN23_RxD_B: PortPinDirection=PORT_PIN_IN, PortPinId=371, PortPinInitialMode=GPIO, PortPinSymbolicName=PORT_23_PIN_3
            PortPin_4: PortPinDirection=PORT_PIN_IN, PortPinId=372, PortPinInitialMode=GPIO, PortPinSymbolicName=PORT_23_PIN_4
            PortPin_5: PortPinDirection=PORT_PIN_IN, PortPinId=373, PortPinInitialMode=GPIO, PortPinSymbolicName=PORT_23_PIN_5
            PortPin_6: PortPinDirection=PORT_PIN_IN, PortPinId=374, PortPinInitialMode=GPIO, PortPinSymbolicName=PORT_23_PIN_6
            PortPin_7: PortPinDirection=PORT_PIN_IN, PortPinId=375, PortPinInitialMode=GPIO, PortPinSymbolicName=PORT_23_PIN_7
        PortContainer_32: PortNumber=32, PortNumberOfPortPins=8
          8 x PortPin, all with PortPinControllerSelect=DISABLE, PortPinDirectionChangeable=false, PortPinEmergencyStop=false, PortPinEnableAnalogInputOnly=PORT_PIN_ANALOG_INPUT_DISABLE, PortPinInputPadLevel=PORT_INPUT_LEVEL_CMOS_AUTOMOTIVE, PortPinInputPullResistor=PORT_PIN_IN_PULL_UP, PortPinLevelValue=PORT_PIN_LEVEL_LOW, PortPinMode=PORT_PIN_MODE_ALL, PortPinModeChangeable=false, PortPinOutputPadDriveStrength=PORT_PIN_DEFAULT_DRIVER, PortPinOutputPinDriveMode=PORT_PIN_OUT_PUSHPULL:
            PortPin_0: PortPinDirection=PORT_PIN_IN, PortPinId=512, PortPinInitialMode=GPIO, PortPinSymbolicName=PORT_32_PIN_0
            PortPin_1: PortPinDirection=PORT_PIN_IN, PortPinId=513, PortPinInitialMode=GPIO, PortPinSymbolicName=PORT_32_PIN_1
            PortPin_2_CAN03_RXD: PortPinDirection=PORT_PIN_IN, PortPinId=514, PortPinInitialMode=GPIO, PortPinSymbolicName=PORT_32_PIN_2
            PortPin_3_CAN03_TXD: PortPinDirection=PORT_PIN_OUT, PortPinId=515, PortPinInitialMode=ALT5, PortPinSymbolicName=PORT_32_PIN_3
            PortPin_4: PortPinDirection=PORT_PIN_IN, PortPinId=516, PortPinInitialMode=GPIO, PortPinSymbolicName=PORT_32_PIN_4
            PortPin_5: PortPinDirection=PORT_PIN_IN, PortPinId=517, PortPinInitialMode=GPIO, PortPinSymbolicName=PORT_32_PIN_5
            PortPin_6: PortPinDirection=PORT_PIN_IN, PortPinId=518, PortPinInitialMode=GPIO, PortPinSymbolicName=PORT_32_PIN_6
            PortPin_7: PortPinDirection=PORT_PIN_IN, PortPinId=519, PortPinInitialMode=GPIO, PortPinSymbolicName=PORT_32_PIN_7
        PortContainer_33: PortNumber=33, PortNumberOfPortPins=16
          16 x PortPin, all with PortPinControllerSelect=DISABLE, PortPinDirectionChangeable=false, PortPinEmergencyStop=false, PortPinEnableAnalogInputOnly=PORT_PIN_ANALOG_INPUT_DISABLE, PortPinInputPadLevel=PORT_INPUT_LEVEL_CMOS_AUTOMOTIVE, PortPinInputPullResistor=PORT_PIN_IN_PULL_UP, PortPinMode=PORT_PIN_MODE_ALL, PortPinModeChangeable=false, PortPinOutputPadDriveStrength=PORT_PIN_DEFAULT_DRIVER, PortPinOutputPinDriveMode=PORT_PIN_OUT_PUSHPULL:
            PortPin_10CAN01_RxD_D: PortPinDirection=PORT_PIN_IN, PortPinId=538, PortPinInitialMode=GPIO, PortPinLevelValue=PORT_PIN_LEVEL_LOW, PortPinSymbolicName=PORT_33_PIN_10
            PortPin_11: PortPinDirection=PORT_PIN_IN, PortPinId=539, PortPinInitialMode=GPIO, PortPinLevelValue=PORT_PIN_LEVEL_LOW, PortPinSymbolicName=PORT_33_PIN_11
            PortPin_12: PortPinDirection=PORT_PIN_IN, PortPinId=540, PortPinInitialMode=GPIO, PortPinLevelValue=PORT_PIN_LEVEL_LOW, PortPinSymbolicName=PORT_33_PIN_12
            PortPin_13: PortPinDirection=PORT_PIN_IN, PortPinId=541, PortPinInitialMode=GPIO, PortPinLevelValue=PORT_PIN_LEVEL_LOW, PortPinSymbolicName=PORT_33_PIN_13
            PortPin_14: PortPinDirection=PORT_PIN_IN, PortPinId=542, PortPinInitialMode=GPIO, PortPinLevelValue=PORT_PIN_LEVEL_LOW, PortPinSymbolicName=PORT_33_PIN_14
            PortPin_15: PortPinDirection=PORT_PIN_IN, PortPinId=543, PortPinInitialMode=GPIO, PortPinLevelValue=PORT_PIN_LEVEL_LOW, PortPinSymbolicName=PORT_33_PIN_15
            PortPin_6: PortPinDirection=PORT_PIN_IN, PortPinId=534, PortPinInitialMode=GPIO, PortPinLevelValue=PORT_PIN_LEVEL_LOW, PortPinSymbolicName=PORT_33_PIN_6
            PortPin_7: PortPinDirection=PORT_PIN_IN, PortPinId=535, PortPinInitialMode=GPIO, PortPinLevelValue=PORT_PIN_LEVEL_LOW, PortPinSymbolicName=PORT_33_PIN_7
            PortPin_8: PortPinDirection=PORT_PIN_IN, PortPinId=536, PortPinInitialMode=GPIO, PortPinLevelValue=PORT_PIN_LEVEL_LOW, PortPinSymbolicName=PORT_33_PIN_8
            PortPin_9CAN01_TxD: PortPinDirection=PORT_PIN_OUT, PortPinId=537, PortPinInitialMode=ALT5, PortPinLevelValue=PORT_PIN_LEVEL_LOW, PortPinSymbolicName=PORT_33_PIN_9
            PortPin_0_buzzer: PortPinDirection=PORT_PIN_OUT, PortPinId=528, PortPinInitialMode=GPIO, PortPinLevelValue=PORT_PIN_LEVEL_LOW, PortPinSymbolicName=PORT_33_PIN_0
            PortPin_1_LED_0: PortPinDirection=PORT_PIN_OUT, PortPinId=529, PortPinInitialMode=GPIO, PortPinLevelValue=PORT_PIN_LEVEL_LOW, PortPinSymbolicName=PORT_33_PIN_1
            PortPin_5CAN13_RxD_B: PortPinDirection=PORT_PIN_IN, PortPinId=533, PortPinInitialMode=GPIO, PortPinLevelValue=PORT_PIN_LEVEL_LOW, PortPinSymbolicName=PORT_33_PIN_5
            PortPin_4_LED_3: PortPinDirection=PORT_PIN_OUT, PortPinId=532, PortPinInitialMode=GPIO, PortPinLevelValue=PORT_PIN_LEVEL_HIGH, PortPinSymbolicName=PORT_33_PIN_4
            PortPin_3_LED_2: PortPinDirection=PORT_PIN_OUT, PortPinId=531, PortPinInitialMode=GPIO, PortPinLevelValue=PORT_PIN_LEVEL_HIGH, PortPinSymbolicName=PORT_33_PIN_3
            PortPin_2_LED_1: PortPinDirection=PORT_PIN_OUT, PortPinId=530, PortPinInitialMode=GPIO, PortPinLevelValue=PORT_PIN_LEVEL_HIGH, PortPinSymbolicName=PORT_33_PIN_2
        PortContainer_34: PortNumber=34, PortNumberOfPortPins=5
          5 x PortPin, all with PortPinControllerSelect=DISABLE, PortPinDirection=PORT_PIN_IN, PortPinDirectionChangeable=false, PortPinEmergencyStop=false, PortPinEnableAnalogInputOnly=PORT_PIN_ANALOG_INPUT_DISABLE, PortPinInitialMode=GPIO, PortPinInputPadLevel=PORT_INPUT_LEVEL_CMOS_AUTOMOTIVE, PortPinInputPullResistor=PORT_PIN_IN_PULL_UP, PortPinLevelValue=PORT_PIN_LEVEL_LOW, PortPinMode=PORT_PIN_MODE_ALL, PortPinModeChangeable=false, PortPinOutputPadDriveStrength=PORT_PIN_DEFAULT_DRIVER, PortPinOutputPinDriveMode=PORT_PIN_OUT_PUSHPULL:
            PortPin_0: PortPinId=545, PortPinSymbolicName=PORT_34_PIN_1
            PortPin_1: PortPinId=546, PortPinSymbolicName=PORT_34_PIN_2
            PortPin_2: PortPinId=547, PortPinSymbolicName=PORT_34_PIN_3
            PortPin_3: PortPinId=548, PortPinSymbolicName=PORT_34_PIN_4
            PortPin_4: PortPinId=549, PortPinSymbolicName=PORT_34_PIN_5
        PortContainer_40: PortNumber=40, PortNumberOfPortPins=15
          15 x PortPin, all with PortPinControllerSelect=DISABLE, PortPinDirection=PORT_PIN_IN, PortPinDirectionChangeable=false, PortPinEmergencyStop=false, PortPinEnableAnalogInputOnly=PORT_PIN_ANALOG_INPUT_DISABLE, PortPinInitialMode=GPIO, PortPinInputPadLevel=PORT_INPUT_LEVEL_CMOS_AUTOMOTIVE, PortPinInputPullResistor=PORT_PIN_IN_PULL_UP, PortPinLevelValue=PORT_PIN_LEVEL_LOW, PortPinModeChangeable=false, PortPinOutputPadDriveStrength=PORT_PIN_DEFAULT_DRIVER, PortPinOutputPinDriveMode=PORT_PIN_OUT_PUSHPULL, PortPinMode=PORT_PIN_MODE_ALL:
            PortPin_0: PortPinId=640, PortPinSymbolicName=PORT_40_PIN_0
            PortPin_1: PortPinId=641, PortPinSymbolicName=PORT_40_PIN_1
            PortPin_10: PortPinId=650, PortPinSymbolicName=PORT_40_PIN_10
            PortPin_11: PortPinId=651, PortPinSymbolicName=PORT_40_PIN_11
            PortPin_12: PortPinId=652, PortPinSymbolicName=PORT_40_PIN_12
            PortPin_13: PortPinId=653, PortPinSymbolicName=PORT_40_PIN_13
            PortPin_14: PortPinId=654, PortPinSymbolicName=PORT_40_PIN_14
            PortPin_2: PortPinId=642, PortPinSymbolicName=PORT_40_PIN_2
            PortPin_3: PortPinId=643, PortPinSymbolicName=PORT_40_PIN_3
            PortPin_4: PortPinId=644, PortPinSymbolicName=PORT_40_PIN_4
            PortPin_5: PortPinId=645, PortPinSymbolicName=PORT_40_PIN_5
            PortPin_6: PortPinId=646, PortPinSymbolicName=PORT_40_PIN_6
            PortPin_7: PortPinId=647, PortPinSymbolicName=PORT_40_PIN_7
            PortPin_8: PortPinId=648, PortPinSymbolicName=PORT_40_PIN_8
            PortPin_9: PortPinId=649, PortPinSymbolicName=PORT_40_PIN_9
        PortContainer_2: PortNumber=2, PortNumberOfPortPins=12
          12 x PortPin, all with PortPinControllerSelect=DISABLE, PortPinDirectionChangeable=false, PortPinEmergencyStop=false, PortPinEnableAnalogInputOnly=PORT_PIN_ANALOG_INPUT_DISABLE, PortPinInputPadLevel=PORT_INPUT_LEVEL_CMOS_AUTOMOTIVE, PortPinInputPullResistor=PORT_PIN_IN_PULL_UP, PortPinLevelValue=PORT_PIN_LEVEL_LOW, PortPinMode=PORT_PIN_MODE_ALL, PortPinModeChangeable=false, PortPinOutputPadDriveStrength=PORT_PIN_DEFAULT_DRIVER, PortPinOutputPinDriveMode=PORT_PIN_OUT_PUSHPULL:
            PortPin_0_CAN00_TxD: PortPinDirection=PORT_PIN_OUT, PortPinId=32, PortPinInitialMode=ALT5, PortPinSymbolicName=PORT_2_PIN_0
            PortPin_1CAN00_RxD_A: PortPinDirection=PORT_PIN_IN, PortPinId=33, PortPinInitialMode=GPIO, PortPinSymbolicName=PORT_2_PIN_1
            PortPin_10: PortPinDirection=PORT_PIN_IN, PortPinId=42, PortPinInitialMode=GPIO, PortPinSymbolicName=PORT_2_PIN_10
            PortPin_11: PortPinDirection=PORT_PIN_IN, PortPinId=43, PortPinInitialMode=GPIO, PortPinSymbolicName=PORT_2_PIN_11
            PortPin_2_ASCLIN1_ATX_Uart_tx: PortPinDirection=PORT_PIN_OUT, PortPinId=34, PortPinInitialMode=ALT2, PortPinSymbolicName=PORT_2_PIN_2
            PortPin_3_ASCLIN1_ARXG_uart_rx: PortPinDirection=PORT_PIN_IN, PortPinId=35, PortPinInitialMode=GPIO, PortPinSymbolicName=PORT_2_PIN_3
            PortPin_4: PortPinDirection=PORT_PIN_IN, PortPinId=36, PortPinInitialMode=GPIO, PortPinSymbolicName=PORT_2_PIN_4
            PortPin_5: PortPinDirection=PORT_PIN_IN, PortPinId=37, PortPinInitialMode=GPIO, PortPinSymbolicName=PORT_2_PIN_5
            PortPin_6: PortPinDirection=PORT_PIN_IN, PortPinId=38, PortPinInitialMode=GPIO, PortPinSymbolicName=PORT_2_PIN_6
            PortPin_7: PortPinDirection=PORT_PIN_IN, PortPinId=39, PortPinInitialMode=GPIO, PortPinSymbolicName=PORT_2_PIN_7
            PortPin_8: PortPinDirection=PORT_PIN_IN, PortPinId=40, PortPinInitialMode=GPIO, PortPinSymbolicName=PORT_2_PIN_8
            PortPin_9: PortPinDirection=PORT_PIN_IN, PortPinId=41, PortPinInitialMode=GPIO, PortPinSymbolicName=PORT_2_PIN_9
        PortContainer_10: PortNumber=10, PortNumberOfPortPins=9
          9 x PortPin, all with PortPinControllerSelect=DISABLE, PortPinDirectionChangeable=false, PortPinEmergencyStop=false, PortPinEnableAnalogInputOnly=PORT_PIN_ANALOG_INPUT_DISABLE, PortPinInputPadLevel=PORT_INPUT_LEVEL_CMOS_AUTOMOTIVE, PortPinInputPullResistor=PORT_PIN_IN_PULL_UP, PortPinLevelValue=PORT_PIN_LEVEL_LOW, PortPinMode=PORT_PIN_MODE_ALL, PortPinModeChangeable=false, PortPinOutputPadDriveStrength=PORT_PIN_DEFAULT_DRIVER, PortPinOutputPinDriveMode=PORT_PIN_OUT_PUSHPULL:
            PortPin_0: PortPinDirection=PORT_PIN_IN, PortPinId=160, PortPinInitialMode=GPIO, PortPinSymbolicName=PORT_10_PIN_0
            PortPin_1: PortPinDirection=PORT_PIN_IN, PortPinId=161, PortPinInitialMode=GPIO, PortPinSymbolicName=PORT_10_PIN_1
            PortPin_2: PortPinDirection=PORT_PIN_IN, PortPinId=162, PortPinInitialMode=GPIO, PortPinSymbolicName=PORT_10_PIN_2
            PortPin_3_CAN02_TX: PortPinDirection=PORT_PIN_OUT, PortPinId=163, PortPinInitialMode=ALT6, PortPinSymbolicName=PORT_10_PIN_3
            PortPin_4: PortPinDirection=PORT_PIN_IN, PortPinId=164, PortPinInitialMode=GPIO, PortPinSymbolicName=PORT_10_PIN_4
            PortPin_5_LIN2_TX: PortPinDirection=PORT_PIN_OUT, PortPinId=165, PortPinInitialMode=ALT2, PortPinSymbolicName=PORT_10_PIN_5
            PortPin_6_LIN2_RX: PortPinDirection=PORT_PIN_IN, PortPinId=166, PortPinInitialMode=GPIO, PortPinSymbolicName=PORT_10_PIN_6
            PortPin_7: PortPinDirection=PORT_PIN_IN, PortPinId=167, PortPinInitialMode=GPIO, PortPinSymbolicName=PORT_10_PIN_7
            PortPin_8_ETH_MD_Interrupt: PortPinDirection=PORT_PIN_IN, PortPinId=168, PortPinInitialMode=GPIO, PortPinSymbolicName=PORT_10_PIN_8
        PortContainer_11: PortNumber=11, PortNumberOfPortPins=16
          16 x PortPin, all with PortPinDirectionChangeable=false, PortPinEmergencyStop=false, PortPinEnableAnalogInputOnly=PORT_PIN_ANALOG_INPUT_DISABLE, PortPinInputPadLevel=PORT_INPUT_LEVEL_CMOS_AUTOMOTIVE, PortPinInputPullResistor=PORT_PIN_IN_PULL_UP, PortPinMode=PORT_PIN_MODE_ALL, PortPinModeChangeable=false, PortPinOutputPadDriveStrength=PORT_PIN_DEFAULT_DRIVER, PortPinOutputPinDriveMode=PORT_PIN_OUT_PUSHPULL:
            PortPin_0_ETH_TXD3: PortPinControllerSelect=ENABLE, PortPinDirection=PORT_PIN_OUT, PortPinId=176, PortPinInitialMode=ALT6, PortPinLevelValue=PORT_PIN_LEVEL_LOW, PortPinSymbolicName=PORT_11_PIN_0
            PortPin_1_ETH_TXD2: PortPinControllerSelect=ENABLE, PortPinDirection=PORT_PIN_OUT, PortPinId=177, PortPinInitialMode=ALT6, PortPinLevelValue=PORT_PIN_LEVEL_LOW, PortPinSymbolicName=PORT_11_PIN_1
            PortPin_10_ETH_RXD0: PortPinControllerSelect=ENABLE, PortPinDirection=PORT_PIN_IN, PortPinId=186, PortPinInitialMode=GPIO, PortPinLevelValue=PORT_PIN_LEVEL_LOW, PortPinSymbolicName=PORT_11_PIN_10
            PortPin_11_ETH_CRSDVA: PortPinControllerSelect=ENABLE, PortPinDirection=PORT_PIN_IN, PortPinId=187, PortPinInitialMode=GPIO, PortPinLevelValue=PORT_PIN_LEVEL_LOW, PortPinSymbolicName=PORT_11_PIN_11
            PortPin_12_ETH_REFCLK: PortPinControllerSelect=ENABLE, PortPinDirection=PORT_PIN_IN, PortPinId=188, PortPinInitialMode=GPIO, PortPinLevelValue=PORT_PIN_LEVEL_LOW, PortPinSymbolicName=PORT_11_PIN_12
            PortPin_13_GETH_RXERA: PortPinControllerSelect=DISABLE, PortPinDirection=PORT_PIN_IN, PortPinId=189, PortPinInitialMode=GPIO, PortPinLevelValue=PORT_PIN_LEVEL_LOW, PortPinSymbolicName=PORT_11_PIN_13
            PortPin_14: PortPinControllerSelect=DISABLE, PortPinDirection=PORT_PIN_IN, PortPinId=190, PortPinInitialMode=GPIO, PortPinLevelValue=PORT_PIN_LEVEL_LOW, PortPinSymbolicName=PORT_11_PIN_14
            PortPin_15_ETH_RSTN: PortPinControllerSelect=DISABLE, PortPinDirection=PORT_PIN_IN, PortPinId=191, PortPinInitialMode=GPIO, PortPinLevelValue=PORT_PIN_LEVEL_HIGH, PortPinSymbolicName=PORT_11_PIN_15
            PortPin_2_ETH_TXD1: PortPinControllerSelect=ENABLE, PortPinDirection=PORT_PIN_OUT, PortPinId=178, PortPinInitialMode=ALT6, PortPinLevelValue=PORT_PIN_LEVEL_LOW, PortPinSymbolicName=PORT_11_PIN_2
            PortPin_3_ETH_TXD0: PortPinControllerSelect=ENABLE, PortPinDirection=PORT_PIN_OUT, PortPinId=179, PortPinInitialMode=ALT6, PortPinLevelValue=PORT_PIN_LEVEL_LOW, PortPinSymbolicName=PORT_11_PIN_3
            PortPin_4_ETH_TXER: PortPinControllerSelect=ENABLE, PortPinDirection=PORT_PIN_OUT, PortPinId=180, PortPinInitialMode=ALT6, PortPinLevelValue=PORT_PIN_LEVEL_LOW, PortPinSymbolicName=PORT_11_PIN_4
            PortPin_5_ETH_TXCLK: PortPinControllerSelect=ENABLE, PortPinDirection=PORT_PIN_IN, PortPinId=181, PortPinInitialMode=GPIO, PortPinLevelValue=PORT_PIN_LEVEL_LOW, PortPinSymbolicName=PORT_11_PIN_5
            PortPin_6_ETH_TXEN: PortPinControllerSelect=ENABLE, PortPinDirection=PORT_PIN_OUT, PortPinId=182, PortPinInitialMode=ALT6, PortPinLevelValue=PORT_PIN_LEVEL_LOW, PortPinSymbolicName=PORT_11_PIN_6
            PortPin_7_ETH_RXD3: PortPinControllerSelect=ENABLE, PortPinDirection=PORT_PIN_IN, PortPinId=183, PortPinInitialMode=GPIO, PortPinLevelValue=PORT_PIN_LEVEL_LOW, PortPinSymbolicName=PORT_11_PIN_7
            PortPin_8_ETH_RXD2: PortPinControllerSelect=ENABLE, PortPinDirection=PORT_PIN_IN, PortPinId=184, PortPinInitialMode=GPIO, PortPinLevelValue=PORT_PIN_LEVEL_LOW, PortPinSymbolicName=PORT_11_PIN_8
            PortPin_9_ETH_RXD1: PortPinControllerSelect=DISABLE, PortPinDirection=PORT_PIN_IN, PortPinId=185, PortPinInitialMode=GPIO, PortPinLevelValue=PORT_PIN_LEVEL_LOW, PortPinSymbolicName=PORT_11_PIN_9
        PortContainer_12: PortNumber=12, PortNumberOfPortPins=2
          PortPin_0_ETH_MDC (PortPin):
            PortPinControllerSelect = ENABLE
            PortPinDirection = PORT_PIN_OUT
            PortPinDirectionChangeable = false
            PortPinEmergencyStop = false
            PortPinEnableAnalogInputOnly = PORT_PIN_ANALOG_INPUT_DISABLE
            PortPinId = 192
            PortPinInitialMode = ALT6
            PortPinInputPadLevel = PORT_INPUT_LEVEL_CMOS_AUTOMOTIVE
            PortPinInputPullResistor = PORT_PIN_IN_PULL_UP
            PortPinLevelValue = PORT_PIN_LEVEL_LOW
            PortPinMode = PORT_PIN_MODE_ALL
            PortPinModeChangeable = false
            PortPinOutputPadDriveStrength = PORT_PIN_DEFAULT_DRIVER
            PortPinOutputPinDriveMode = PORT_PIN_OUT_PUSHPULL
            PortPinSymbolicName = PORT_12_PIN_0
          PortPin_1_ETH_MDIO (PortPin):
            PortPinControllerSelect = ENABLE
            PortPinDirection = PORT_PIN_OUT
            PortPinDirectionChangeable = true
            PortPinEmergencyStop = false
            PortPinEnableAnalogInputOnly = PORT_PIN_ANALOG_INPUT_DISABLE
            PortPinId = 193
            PortPinInitialMode = GPIO
            PortPinInputPadLevel = PORT_INPUT_LEVEL_CMOS_AUTOMOTIVE
            PortPinInputPullResistor = PORT_PIN_IN_PULL_UP
            PortPinLevelValue = PORT_PIN_LEVEL_LOW
            PortPinMode = PORT_PIN_MODE_ALL
            PortPinModeChangeable = true
            PortPinOutputPadDriveStrength = PORT_PIN_DEFAULT_DRIVER
            PortPinOutputPinDriveMode = PORT_PIN_OUT_PUSHPULL
            PortPinSymbolicName = PORT_12_PIN_1
        PortContainer_13: PortNumber=13, PortNumberOfPortPins=4
          PortLVDS_0 (PortLVDS):
            PortLVDSMode = LVDSH
            PortLVDSPadSupply = V3_3
            PortLVDSPinPair = Pin_0_Pin_1
            PortLVDSRxEnController = PORT_CONTROLLED
            PortLVDSRxPathEnable = false
            PortLVDSRxTerminationMode = INTERNAL_TERMINATION
            PortLVDSTxEnController = PORT_CONTROLLED
            PortLVDSTxPathEnable = false
            PortLVDSTxPowerDownPullDown = DISABLE
          PortLVDS_1 (PortLVDS):
            PortLVDSMode = LVDSH
            PortLVDSPadSupply = V3_3
            PortLVDSPinPair = Pin_2_Pin_3
            PortLVDSRxEnController = PORT_CONTROLLED
            PortLVDSRxPathEnable = false
            PortLVDSRxTerminationMode = INTERNAL_TERMINATION
            PortLVDSTxEnController = PORT_CONTROLLED
            PortLVDSTxPathEnable = false
            PortLVDSTxPowerDownPullDown = DISABLE
          4 x PortPin, all with PortPinControllerSelect=DISABLE, PortPinDirectionChangeable=false, PortPinEmergencyStop=false, PortPinEnableAnalogInputOnly=PORT_PIN_ANALOG_INPUT_DISABLE, PortPinInputPadLevel=PORT_INPUT_LEVEL_CMOS_AUTOMOTIVE, PortPinInputPullResistor=PORT_PIN_IN_PULL_UP, PortPinMode=PORT_PIN_MODE_ALL, PortPinModeChangeable=false, PortPinOutputPadDriveStrength=PORT_PIN_DEFAULT_DRIVER, PortPinOutputPinDriveMode=PORT_PIN_OUT_PUSHPULL:
            PortPin_0_CAN10_TXD: PortPinDirection=PORT_PIN_OUT, PortPinId=208, PortPinInitialMode=ALT7, PortPinLevelValue=PORT_PIN_LEVEL_LOW, PortPinSymbolicName=PORT_13_PIN_0
            PortPin_1_CAN10_RXD_D: PortPinDirection=PORT_PIN_IN, PortPinId=209, PortPinInitialMode=GPIO, PortPinLevelValue=PORT_PIN_LEVEL_LOW, PortPinSymbolicName=PORT_13_PIN_1
            PortPin_2_ETH_EN: PortPinDirection=PORT_PIN_IN, PortPinId=210, PortPinInitialMode=GPIO, PortPinLevelValue=PORT_PIN_LEVEL_HIGH, PortPinSymbolicName=PORT_13_PIN_2
            PortPin_3: PortPinDirection=PORT_PIN_OUT, PortPinId=211, PortPinInitialMode=GPIO, PortPinLevelValue=PORT_PIN_LEVEL_LOW, PortPinSymbolicName=PORT_13_PIN_3
        PortContainer_14: PortNumber=14, PortNumberOfPortPins=11
          PortPin_2_QSPI2_SlSO1 (PortPin):
            PortPinControllerSelect = DISABLE
            PortPinDirection = PORT_PIN_OUT
            PortPinDirectionChangeable = false
            PortPinEmergencyStop = false
            PortPinEnableAnalogInputOnly = PORT_PIN_ANALOG_INPUT_DISABLE
            PortPinId = 226
            PortPinInitialMode = ALT3
            PortPinInputPadLevel = PORT_INPUT_LEVEL_CMOS_AUTOMOTIVE
            PortPinInputPullResistor = PORT_PIN_IN_PULL_UP
            PortPinLevelValue = PORT_PIN_LEVEL_LOW
            PortPinMode = PORT_PIN_MODE_ALL
            PortPinModeChangeable = false
            PortPinOutputPadDriveStrength = PORT_PIN_DEFAULT_DRIVER
            PortPinOutputPinDriveMode = PORT_PIN_OUT_PUSHPULL
            PortPinSymbolicName = PORT_14_PIN_2
          PortLVDS_0 (PortLVDS):
            PortLVDSMode = LVDSH
            PortLVDSPadSupply = V3_3
            PortLVDSPinPair = Pin_10_Pin_9
            PortLVDSRxEnController = PORT_CONTROLLED
            PortLVDSRxPathEnable = false
            PortLVDSRxTerminationMode = INTERNAL_TERMINATION
            PortLVDSTxEnController = PORT_CONTROLLED
            PortLVDSTxPathEnable = false
            PortLVDSTxPowerDownPullDown = DISABLE
          10 x PortPin, all with PortPinControllerSelect=DISABLE, PortPinDirectionChangeable=false, PortPinEmergencyStop=false, PortPinEnableAnalogInputOnly=PORT_PIN_ANALOG_INPUT_DISABLE, PortPinInputPadLevel=PORT_INPUT_LEVEL_CMOS_AUTOMOTIVE, PortPinLevelValue=PORT_PIN_LEVEL_LOW, PortPinMode=PORT_PIN_MODE_ALL, PortPinModeChangeable=false, PortPinOutputPinDriveMode=PORT_PIN_OUT_PUSHPULL:
            PortPin_0_UART_TX: PortPinDirection=PORT_PIN_OUT, PortPinId=224, PortPinInitialMode=ALT2, PortPinInputPullResistor=PORT_PIN_IN_PULL_UP, PortPinOutputPadDriveStrength=PORT_PIN_DEFAULT_DRIVER, PortPinSymbolicName=PORT_14_PIN_0
            PortPin_1_UART_RX: PortPinDirection=PORT_PIN_IN, PortPinId=225, PortPinInitialMode=GPIO, PortPinInputPullResistor=PORT_PIN_IN_NO_PULL, PortPinOutputPadDriveStrength=PORT_PIN_DEFAULT_DRIVER, PortPinSymbolicName=PORT_14_PIN_1
            PortPin_10: PortPinDirection=PORT_PIN_IN, PortPinId=234, PortPinInitialMode=GPIO, PortPinInputPullResistor=PORT_PIN_IN_PULL_UP, PortPinOutputPadDriveStrength=PORT_PIN_DEFAULT_DRIVER, PortPinSymbolicName=PORT_14_PIN_10
            PortPin_3: PortPinDirection=PORT_PIN_IN, PortPinId=227, PortPinInitialMode=GPIO, PortPinInputPullResistor=PORT_PIN_IN_PULL_UP, PortPinOutputPadDriveStrength=PORT_PIN_DEFAULT_DRIVER, PortPinSymbolicName=PORT_14_PIN_3
            PortPin_4_MCU_PPS: PortPinDirection=PORT_PIN_OUT, PortPinId=228, PortPinInitialMode=ALT6, PortPinInputPullResistor=PORT_PIN_IN_PULL_UP, PortPinOutputPadDriveStrength=PORT_PIN_MEDIUM_DRIVER_SHARP_EDGE, PortPinSymbolicName=PORT_14_PIN_4
            PortPin_5: PortPinDirection=PORT_PIN_IN, PortPinId=229, PortPinInitialMode=GPIO, PortPinInputPullResistor=PORT_PIN_IN_PULL_UP, PortPinOutputPadDriveStrength=PORT_PIN_DEFAULT_DRIVER, PortPinSymbolicName=PORT_14_PIN_5
            PortPin_6: PortPinDirection=PORT_PIN_IN, PortPinId=230, PortPinInitialMode=GPIO, PortPinInputPullResistor=PORT_PIN_IN_PULL_UP, PortPinOutputPadDriveStrength=PORT_PIN_DEFAULT_DRIVER, PortPinSymbolicName=PORT_14_PIN_6
            PortPin_7: PortPinDirection=PORT_PIN_IN, PortPinId=231, PortPinInitialMode=GPIO, PortPinInputPullResistor=PORT_PIN_IN_PULL_UP, PortPinOutputPadDriveStrength=PORT_PIN_DEFAULT_DRIVER, PortPinSymbolicName=PORT_14_PIN_7
            PortPin_8: PortPinDirection=PORT_PIN_IN, PortPinId=232, PortPinInitialMode=GPIO, PortPinInputPullResistor=PORT_PIN_IN_PULL_UP, PortPinOutputPadDriveStrength=PORT_PIN_DEFAULT_DRIVER, PortPinSymbolicName=PORT_14_PIN_8
            PortPin_9: PortPinDirection=PORT_PIN_IN, PortPinId=233, PortPinInitialMode=GPIO, PortPinInputPullResistor=PORT_PIN_IN_PULL_UP, PortPinOutputPadDriveStrength=PORT_PIN_STRONG_DRIVER_MEDIUM_EDGE, PortPinSymbolicName=PORT_14_PIN_9
        PortContainer_15: PortNumber=15, PortNumberOfPortPins=9
          9 x PortPin, all with PortPinControllerSelect=DISABLE, PortPinDirectionChangeable=false, PortPinEmergencyStop=false, PortPinEnableAnalogInputOnly=PORT_PIN_ANALOG_INPUT_DISABLE, PortPinInputPadLevel=PORT_INPUT_LEVEL_CMOS_AUTOMOTIVE, PortPinMode=PORT_PIN_MODE_ALL, PortPinModeChangeable=false, PortPinOutputPadDriveStrength=PORT_PIN_DEFAULT_DRIVER:
            PortPin_6_QSPI2_MTSR: PortPinDirection=PORT_PIN_OUT, PortPinId=246, PortPinInitialMode=ALT3, PortPinInputPullResistor=PORT_PIN_IN_PULL_UP, PortPinLevelValue=PORT_PIN_LEVEL_HIGH, PortPinOutputPinDriveMode=PORT_PIN_OUT_PUSHPULL, PortPinSymbolicName=PORT_15_PIN_6
            PortPin_7_QSPI2_MRSTB: PortPinDirection=PORT_PIN_IN, PortPinId=247, PortPinInitialMode=GPIO, PortPinInputPullResistor=PORT_PIN_IN_PULL_DOWN, PortPinLevelValue=PORT_PIN_LEVEL_LOW, PortPinOutputPinDriveMode=PORT_PIN_OUT_PUSHPULL, PortPinSymbolicName=PORT_15_PIN_7
            PortPin_8_QSPI2_SCLK: PortPinDirection=PORT_PIN_OUT, PortPinId=248, PortPinInitialMode=ALT3, PortPinInputPullResistor=PORT_PIN_IN_PULL_UP, PortPinLevelValue=PORT_PIN_LEVEL_LOW, PortPinOutputPinDriveMode=PORT_PIN_OUT_PUSHPULL, PortPinSymbolicName=PORT_15_PIN_8
            PortPin_0: PortPinDirection=PORT_PIN_IN, PortPinId=240, PortPinInitialMode=GPIO, PortPinInputPullResistor=PORT_PIN_IN_PULL_UP, PortPinLevelValue=PORT_PIN_LEVEL_LOW, PortPinOutputPinDriveMode=PORT_PIN_OUT_PUSHPULL, PortPinSymbolicName=PORT_15_PIN_0
            PortPin_1: PortPinDirection=PORT_PIN_IN, PortPinId=241, PortPinInitialMode=GPIO, PortPinInputPullResistor=PORT_PIN_IN_PULL_UP, PortPinLevelValue=PORT_PIN_LEVEL_LOW, PortPinOutputPinDriveMode=PORT_PIN_OUT_PUSHPULL, PortPinSymbolicName=PORT_15_PIN_1
            PortPin_2LIN0_ATX: PortPinDirection=PORT_PIN_OUT, PortPinId=242, PortPinInitialMode=ALT2, PortPinInputPullResistor=PORT_PIN_IN_PULL_UP, PortPinLevelValue=PORT_PIN_LEVEL_LOW, PortPinOutputPinDriveMode=PORT_PIN_OUT_PUSHPULL, PortPinSymbolicName=PORT_15_PIN_2
            PortPin_3LIN0_ARX_B: PortPinDirection=PORT_PIN_IN, PortPinId=243, PortPinInitialMode=GPIO, PortPinInputPullResistor=PORT_PIN_IN_PULL_UP, PortPinLevelValue=PORT_PIN_LEVEL_LOW, PortPinOutputPinDriveMode=PORT_PIN_OUT_PUSHPULL, PortPinSymbolicName=PORT_15_PIN_3
            PortPin_I2C0_SCL: PortPinId=244, PortPinSymbolicName=PORT_15_PIN_4, PortPinDirection=PORT_PIN_OUT, PortPinInitialMode=ALT6, PortPinLevelValue=PORT_PIN_LEVEL_HIGH, PortPinInputPullResistor=PORT_PIN_IN_PULL_UP, PortPinOutputPinDriveMode=PORT_PIN_OUT_PUSHPULL
            PortPin_I2C0_SDA: PortPinId=245, PortPinSymbolicName=PORT_15_PIN_5, PortPinDirection=PORT_PIN_OUT, PortPinInitialMode=ALT6, PortPinLevelValue=PORT_PIN_LEVEL_HIGH, PortPinInputPullResistor=PORT_PIN_IN_PULL_UP, PortPinOutputPinDriveMode=PORT_PIN_OUT_OPENDRAIN
        PortContainer_20: PortNumber=20, PortNumberOfPortPins=13
          13 x PortPin, all with PortPinControllerSelect=DISABLE, PortPinDirectionChangeable=false, PortPinEmergencyStop=false, PortPinEnableAnalogInputOnly=PORT_PIN_ANALOG_INPUT_DISABLE, PortPinInputPadLevel=PORT_INPUT_LEVEL_CMOS_AUTOMOTIVE, PortPinInputPullResistor=PORT_PIN_IN_PULL_UP, PortPinMode=PORT_PIN_MODE_ALL, PortPinModeChangeable=false, PortPinOutputPadDriveStrength=PORT_PIN_DEFAULT_DRIVER, PortPinOutputPinDriveMode=PORT_PIN_OUT_PUSHPULL:
            PortPin_0: PortPinDirection=PORT_PIN_IN, PortPinId=320, PortPinInitialMode=GPIO, PortPinLevelValue=PORT_PIN_LEVEL_LOW, PortPinSymbolicName=PORT_20_PIN_0
            PortPin_1: PortPinDirection=PORT_PIN_IN, PortPinId=321, PortPinInitialMode=GPIO, PortPinLevelValue=PORT_PIN_LEVEL_LOW, PortPinSymbolicName=PORT_20_PIN_1
            PortPin_12_LED_5: PortPinDirection=PORT_PIN_OUT, PortPinId=332, PortPinInitialMode=GPIO, PortPinLevelValue=PORT_PIN_LEVEL_HIGH, PortPinSymbolicName=PORT_20_PIN_12
            PortPin_13: PortPinDirection=PORT_PIN_OUT, PortPinId=333, PortPinInitialMode=GPIO, PortPinLevelValue=PORT_PIN_LEVEL_LOW, PortPinSymbolicName=PORT_20_PIN_13
            PortPin_14: PortPinDirection=PORT_PIN_OUT, PortPinId=334, PortPinInitialMode=GPIO, PortPinLevelValue=PORT_PIN_LEVEL_LOW, PortPinSymbolicName=PORT_20_PIN_14
            PortPin_2: PortPinDirection=PORT_PIN_IN, PortPinId=322, PortPinInitialMode=GPIO, PortPinLevelValue=PORT_PIN_LEVEL_LOW, PortPinSymbolicName=PORT_20_PIN_2
            PortPin_3: PortPinDirection=PORT_PIN_IN, PortPinId=323, PortPinInitialMode=GPIO, PortPinLevelValue=PORT_PIN_LEVEL_LOW, PortPinSymbolicName=PORT_20_PIN_3
            PortPin_6: PortPinDirection=PORT_PIN_IN, PortPinId=326, PortPinInitialMode=GPIO, PortPinLevelValue=PORT_PIN_LEVEL_LOW, PortPinSymbolicName=PORT_20_PIN_6
            PortPin_7_CAN00_RXD: PortPinDirection=PORT_PIN_IN, PortPinId=327, PortPinInitialMode=GPIO, PortPinLevelValue=PORT_PIN_LEVEL_LOW, PortPinSymbolicName=PORT_20_PIN_7
            PortPin_9: PortPinDirection=PORT_PIN_IN, PortPinId=329, PortPinInitialMode=GPIO, PortPinLevelValue=PORT_PIN_LEVEL_LOW, PortPinSymbolicName=PORT_20_PIN_9
            PortPin_10: PortPinDirection=PORT_PIN_IN, PortPinId=330, PortPinInitialMode=GPIO, PortPinLevelValue=PORT_PIN_LEVEL_LOW, PortPinSymbolicName=PORT_20_PIN_10
            PortPin_11_LED_4: PortPinDirection=PORT_PIN_OUT, PortPinId=331, PortPinInitialMode=GPIO, PortPinLevelValue=PORT_PIN_LEVEL_HIGH, PortPinSymbolicName=PORT_20_PIN_11
            PortPin_8_CAN0TXD: PortPinDirection=PORT_PIN_OUT, PortPinId=328, PortPinInitialMode=ALT5, PortPinLevelValue=PORT_PIN_LEVEL_LOW, PortPinSymbolicName=PORT_20_PIN_8
    PortGeneral:
      PortDevErrorDetect = true
      PortInitApiMode = PORT_MCAL_SUPERVISOR
      PortInitCheckApi = false
      PortSafetyEnable = false
      PortSetPinDirectionApi = true
      PortSetPinModeApi = true
      PortVersionInfoApi = false
