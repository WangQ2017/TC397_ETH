AUTOSAR XML (schema 00048)
package /Port
  module config Port: implementation-config-variant=VARIANT-POST-BUILD, module-description=Port_Impl
    CommonPublishedInformation:
      ArMajorVersion = 4
      ArMinorVersion = 4
      ArPatchVersion = 0
      ModuleId = 124
      Release = _TRICORE_TC397
      SwMajorVersion = 20
      SwMinorVersion = 10
      SwPatchVersion = 0
      VendorId = 17
    PortConfigSet
      17 x PortContainer:
        PortContainer_0: PortNumber=0, PortNumberOfPortPins=13
          13 x PortPin, all with PortPinControllerSelect=DISABLE, PortPinDirection=PORT_PIN_IN, PortPinDirectionChangeable=false, PortPinEmergencyStop=false, PortPinEnableAnalogInputOnly=PORT_PIN_ANALOG_INPUT_DISABLE, PortPinInitialMode=GPIO, PortPinInputPadLevel=PORT_INPUT_LEVEL_CMOS_AUTOMOTIVE, PortPinInputPullResistor=PORT_PIN_IN_PULL_UP, PortPinLevelValue=PORT_PIN_LEVEL_LOW, PortPinMode=PORT_PIN_MODE_ALL, PortPinModeChangeable=false, PortPinOutputPadDriveStrength=PORT_PIN_DEFAULT_DRIVER, PortPinOutputPinDriveMode=PORT_PIN_OUT_PUSHPULL:
            PortPin_0: PortPinId=0, PortPinSymbolicName=PORT_0_PIN_0
            PortPin_1: PortPinId=1, PortPinSymbolicName=PORT_0_PIN_1
            PortPin_{10..12}: PortPinId={10..12}, PortPinSymbolicName=PORT_0_PIN_{10..12}
            PortPin_{2..9}: PortPinId={2..9}, PortPinSymbolicName=PORT_0_PIN_{2..9}
        PortContainer_1: PortNumber=1, PortNumberOfPortPins=5
          5 x PortPin, all with PortPinControllerSelect=DISABLE, PortPinDirection=PORT_PIN_IN, PortPinDirectionChangeable=false, PortPinEmergencyStop=false, PortPinEnableAnalogInputOnly=PORT_PIN_ANALOG_INPUT_DISABLE, PortPinInitialMode=GPIO, PortPinInputPadLevel=PORT_INPUT_LEVEL_CMOS_AUTOMOTIVE, PortPinInputPullResistor=PORT_PIN_IN_PULL_UP, PortPinLevelValue=PORT_PIN_LEVEL_LOW, PortPinMode=PORT_PIN_MODE_ALL, PortPinModeChangeable=false, PortPinOutputPadDriveStrength=PORT_PIN_DEFAULT_DRIVER, PortPinOutputPinDriveMode=PORT_PIN_OUT_PUSHPULL:
            PortPin_0: PortPinId=19, PortPinSymbolicName=PORT_1_PIN_3
            PortPin_1: PortPinId=20, PortPinSymbolicName=PORT_1_PIN_4
            PortPin_2: PortPinId=21, PortPinSymbolicName=PORT_1_PIN_5
            PortPin_3: PortPinId=22, PortPinSymbolicName=PORT_1_PIN_6
            PortPin_4: PortPinId=23, PortPinSymbolicName=PORT_1_PIN_7
        PortContainer_21: PortNumber=21, PortNumberOfPortPins=8
          3 x PortLVDS, all with PortLVDSMode=LVDSH, PortLVDSPadSupply=V3_3, PortLVDSRxEnController=PORT_CONTROLLED, PortLVDSRxPathEnable=false, PortLVDSRxTerminationMode=INTERNAL_TERMINATION, PortLVDSTxEnController=PORT_CONTROLLED, PortLVDSTxPathEnable=false, PortLVDSTxPowerDownPullDown=DISABLE:
            PortLVDS_0: PortLVDSPinPair=Pin_0_Pin_1
            PortLVDS_1: PortLVDSPinPair=Pin_2_Pin_3
            PortLVDS_2: PortLVDSPinPair=Pin_4_Pin_5
          8 x PortPin, all with PortPinControllerSelect=DISABLE, PortPinDirection=PORT_PIN_IN, PortPinDirectionChangeable=false, PortPinEmergencyStop=false, PortPinEnableAnalogInputOnly=PORT_PIN_ANALOG_INPUT_DISABLE, PortPinInitialMode=GPIO, PortPinInputPadLevel=PORT_INPUT_LEVEL_CMOS_AUTOMOTIVE, PortPinInputPullResistor=PORT_PIN_IN_PULL_UP, PortPinLevelValue=PORT_PIN_LEVEL_LOW, PortPinMode=PORT_PIN_MODE_ALL, PortPinModeChangeable=false, PortPinOutputPadDriveStrength=PORT_PIN_DEFAULT_DRIVER, PortPinOutputPinDriveMode=PORT_PIN_OUT_PUSHPULL:
            PortPin_0: PortPinId=336, PortPinSymbolicName=PORT_21_PIN_0
            PortPin_1: PortPinId=337, PortPinSymbolicName=PORT_21_PIN_1
            PortPin_2: PortPinId=338, PortPinSymbolicName=PORT_21_PIN_2
            PortPin_3: PortPinId=339, PortPinSymbolicName=PORT_21_PIN_3
            PortPin_4: PortPinId=340, PortPinSymbolicName=PORT_21_PIN_4
            PortPin_5: PortPinId=341, PortPinSymbolicName=PORT_21_PIN_5
            PortPin_6: PortPinId=342, PortPinSymbolicName=PORT_21_PIN_6
            PortPin_7: PortPinId=343, PortPinSymbolicName=PORT_21_PIN_7
        PortContainer_22: PortNumber=22, PortNumberOfPortPins=12
          PortLVDS_0 (PortLVDS):
            PortLVDSMode = LVDSH
            PortLVDSPadSupply = V3_3
            PortLVDSPinPair = Pin_0_Pin_1
            PortLVDSRxEnController = PORT_CONTROLLED
            PortLVDSRxPathEnable = false
            PortLVDSRxTerminationMode = INTERNAL_TERMINATION
            PortLVDSTxEnController = PORT_CONTROLLED
            PortLVDSTxPathEnable = false
            PortLVDSTxPowerDownPullDown = DISABLE
          PortLVDS_1 (PortLVDS):
            PortLVDSMode = LVDSH
            PortLVDSPadSupply = V3_3
            PortLVDSPinPair = Pin_2_Pin_3
            PortLVDSRxEnController = PORT_CONTROLLED
            PortLVDSRxPathEnable = false
            PortLVDSRxTerminationMode = INTERNAL_TERMINATION
            PortLVDSTxEnController = PORT_CONTROLLED
            PortLVDSTxPathEnable = false
            PortLVDSTxPowerDownPullDown = DISABLE
          12 x PortPin, all with PortPinControllerSelect=DISABLE, PortPinDirection=PORT_PIN_IN, PortPinDirectionChangeable=false, PortPinEmergencyStop=false, PortPinEnableAnalogInputOnly=PORT_PIN_ANALOG_INPUT_DISABLE, PortPinInputPadLevel=PORT_INPUT_LEVEL_CMOS_AUTOMOTIVE, PortPinInputPullResistor=PORT_PIN_IN_PULL_UP, PortPinLevelValue=PORT_PIN_LEVEL_LOW, PortPinMode=PORT_PIN_MODE_ALL, PortPinModeChangeable=false, PortPinOutputPadDriveStrength=PORT_PIN_DEFAULT_DRIVER, PortPinOutputPinDriveMode=PORT_PIN_OUT_PUSHPULL:
            PortPin_0: PortPinId=352, PortPinInitialMode=ALT6, PortPinSymbolicName=PORT_22_PIN_0
            PortPin_1: PortPinId=353, PortPinInitialMode=GPIO, PortPinSymbolicName=PORT_22_PIN_1
            PortPin_10: PortPinId=362, PortPinInitialMode=GPIO, PortPinSymbolicName=PORT_22_PIN_10
            PortPin_11: PortPinId=363, PortPinInitialMode=GPIO, PortPinSymbolicName=PORT_22_PIN_11
            PortPin_2: PortPinId=354, PortPinInitialMode=GPIO, PortPinSymbolicName=PORT_22_PIN_2
            PortPin_3: PortPinId=355, PortPinInitialMode=GPIO, PortPinSymbolicName=PORT_22_PIN_3
            PortPin_4: PortPinId=356, PortPinInitialMode=GPIO, PortPinSymbolicName=PORT_22_PIN_4
            PortPin_5: PortPinId=357, PortPinInitialMode=GPIO, PortPinSymbolicName=PORT_22_PIN_5
            PortPin_6: PortPinId=358, PortPinInitialMode=GPIO, PortPinSymbolicName=PORT_22_PIN_6
            PortPin_7: PortPinId=359, PortPinInitialMode=GPIO, PortPinSymbolicName=PORT_22_PIN_7
            PortPin_8: PortPinId=360, PortPinInitialMode=GPIO, PortPinSymbolicName=PORT_22_PIN_8
            PortPin_9: PortPinId=361, PortPinInitialMode=GPIO, PortPinSymbolicName=PORT_22_PIN_9
        PortContainer_23: PortNumber=23, PortNumberOfPortPins=8
          8 x PortPin, all with PortPinControllerSelect=DISABLE, PortPinDirection=PORT_PIN_IN, PortPinDirectionChangeable=false, PortPinEmergencyStop=false, PortPinEnableAnalogInputOnly=PORT_PIN_ANALOG_INPUT_DISABLE, PortPinInitialMode=GPIO, PortPinInputPadLevel=PORT_INPUT_LEVEL_CMOS_AUTOMOTIVE, PortPinInputPullResistor=PORT_PIN_IN_PULL_UP, PortPinLevelValue=PORT_PIN_LEVEL_LOW, PortPinMode=PORT_PIN_MODE_ALL, PortPinModeChangeable=false, PortPinOutputPadDriveStrength=PORT_PIN_DEFAULT_DRIVER, PortPinOutputPinDriveMode=PORT_PIN_OUT_PUSHPULL:
            PortPin_0: PortPinId=368, PortPinSymbolicName=PORT_23_PIN_0
            PortPin_1: PortPinId=369, PortPinSymbolicName=PORT_23_PIN_1
            PortPin_2: PortPinId=370, PortPinSymbolicName=PORT_23_PIN_2
            PortPin_3: PortPinId=371, PortPinSymbolicName=PORT_23_PIN_3
            PortPin_4: PortPinId=372, PortPinSymbolicName=PORT_23_PIN_4
            PortPin_5: PortPinId=373, PortPinSymbolicName=PORT_23_PIN_5
            PortPin_6: PortPinId=374, PortPinSymbolicName=PORT_23_PIN_6
            PortPin_7: PortPinId=375, PortPinSymbolicName=PORT_23_PIN_7
        PortContainer_32: PortNumber=32, PortNumberOfPortPins=8
          8 x PortPin, all with PortPinControllerSelect=DISABLE, PortPinDirection=PORT_PIN_IN, PortPinDirectionChangeable=false, PortPinEmergencyStop=false, PortPinEnableAnalogInputOnly=PORT_PIN_ANALOG_INPUT_DISABLE, PortPinInitialMode=GPIO, PortPinInputPadLevel=PORT_INPUT_LEVEL_CMOS_AUTOMOTIVE, PortPinInputPullResistor=PORT_PIN_IN_PULL_UP, PortPinLevelValue=PORT_PIN_LEVEL_LOW, PortPinMode=PORT_PIN_MODE_ALL, PortPinModeChangeable=false, PortPinOutputPadDriveStrength=PORT_PIN_DEFAULT_DRIVER, PortPinOutputPinDriveMode=PORT_PIN_OUT_PUSHPULL:
            PortPin_0: PortPinId=512, PortPinSymbolicName=PORT_32_PIN_0
            PortPin_1: PortPinId=513, PortPinSymbolicName=PORT_32_PIN_1
            PortPin_2: PortPinId=514, PortPinSymbolicName=PORT_32_PIN_2
            PortPin_3: PortPinId=515, PortPinSymbolicName=PORT_32_PIN_3
            PortPin_4: PortPinId=516, PortPinSymbolicName=PORT_32_PIN_4
            PortPin_5: PortPinId=517, PortPinSymbolicName=PORT_32_PIN_5
            PortPin_6: PortPinId=518, PortPinSymbolicName=PORT_32_PIN_6
            PortPin_7: PortPinId=519, PortPinSymbolicName=PORT_32_PIN_7
        PortContainer_33: PortNumber=33, PortNumberOfPortPins=16
          16 x PortPin, all with PortPinControllerSelect=DISABLE, PortPinDirectionChangeable=false, PortPinEmergencyStop=false, PortPinEnableAnalogInputOnly=PORT_PIN_ANALOG_INPUT_DISABLE, PortPinInitialMode=GPIO, PortPinInputPadLevel=PORT_INPUT_LEVEL_CMOS_AUTOMOTIVE, PortPinInputPullResistor=PORT_PIN_IN_PULL_UP, PortPinLevelValue=PORT_PIN_LEVEL_LOW, PortPinMode=PORT_PIN_MODE_ALL, PortPinModeChangeable=false, PortPinOutputPadDriveStrength=PORT_PIN_DEFAULT_DRIVER, PortPinOutputPinDriveMode=PORT_PIN_OUT_PUSHPULL:
            PortPin_0: PortPinDirection=PORT_PIN_IN, PortPinId=528, PortPinSymbolicName=PORT_33_PIN_0
            PortPin_10: PortPinDirection=PORT_PIN_IN, PortPinId=538, PortPinSymbolicName=PORT_33_PIN_10
            PortPin_11: PortPinDirection=PORT_PIN_IN, PortPinId=539, PortPinSymbolicName=PORT_33_PIN_11
            PortPin_12: PortPinDirection=PORT_PIN_IN, PortPinId=540, PortPinSymbolicName=PORT_33_PIN_12
            PortPin_13: PortPinDirection=PORT_PIN_IN, PortPinId=541, PortPinSymbolicName=PORT_33_PIN_13
            PortPin_14: PortPinDirection=PORT_PIN_IN, PortPinId=542, PortPinSymbolicName=PORT_33_PIN_14
            PortPin_15: PortPinDirection=PORT_PIN_IN, PortPinId=543, PortPinSymbolicName=PORT_33_PIN_15
            PortPin_5: PortPinDirection=PORT_PIN_IN, PortPinId=533, PortPinSymbolicName=PORT_33_PIN_5
            PortPin_6: PortPinDirection=PORT_PIN_IN, PortPinId=534, PortPinSymbolicName=PORT_33_PIN_6
            PortPin_7: PortPinDirection=PORT_PIN_IN, PortPinId=535, PortPinSymbolicName=PORT_33_PIN_7
            PortPin_8: PortPinDirection=PORT_PIN_IN, PortPinId=536, PortPinSymbolicName=PORT_33_PIN_8
            PortPin_9: PortPinDirection=PORT_PIN_IN, PortPinId=537, PortPinSymbolicName=PORT_33_PIN_9
            PortPin_LED0: PortPinDirection=PORT_PIN_OUT, PortPinId=529, PortPinSymbolicName=PORT_33_PIN_1
            PortPin_LED1: PortPinDirection=PORT_PIN_OUT, PortPinId=530, PortPinSymbolicName=PORT_33_PIN_2
            PortPin_LED2: PortPinDirection=PORT_PIN_OUT, PortPinId=531, PortPinSymbolicName=PORT_33_PIN_3
            PortPin_LED3: PortPinDirection=PORT_PIN_OUT, PortPinId=532, PortPinSymbolicName=PORT_33_PIN_4
        PortContainer_34: PortNumber=34, PortNumberOfPortPins=5
          5 x PortPin, all with PortPinControllerSelect=DISABLE, PortPinDirection=PORT_PIN_IN, PortPinDirectionChangeable=false, PortPinEmergencyStop=false, PortPinEnableAnalogInputOnly=PORT_PIN_ANALOG_INPUT_DISABLE, PortPinInitialMode=GPIO, PortPinInputPadLevel=PORT_INPUT_LEVEL_CMOS_AUTOMOTIVE, PortPinInputPullResistor=PORT_PIN_IN_PULL_UP, PortPinLevelValue=PORT_PIN_LEVEL_LOW, PortPinMode=PORT_PIN_MODE_ALL, PortPinModeChangeable=false, PortPinOutputPadDriveStrength=PORT_PIN_DEFAULT_DRIVER, PortPinOutputPinDriveMode=PORT_PIN_OUT_PUSHPULL:
            PortPin_0: PortPinId=545, PortPinSymbolicName=PORT_34_PIN_1
            PortPin_1: PortPinId=546, PortPinSymbolicName=PORT_34_PIN_2
            PortPin_2: PortPinId=547, PortPinSymbolicName=PORT_34_PIN_3
            PortPin_3: PortPinId=548, PortPinSymbolicName=PORT_34_PIN_4
            PortPin_4: PortPinId=549, PortPinSymbolicName=PORT_34_PIN_5
        PortContainer_40: PortNumber=40, PortNumberOfPortPins=15
          15 x PortPin, all with PortPinControllerSelect=DISABLE, PortPinDirection=PORT_PIN_IN, PortPinDirectionChangeable=false, PortPinEmergencyStop=false, PortPinEnableAnalogInputOnly=PORT_PIN_ANALOG_INPUT_DISABLE, PortPinInitialMode=GPIO, PortPinInputPadLevel=PORT_INPUT_LEVEL_CMOS_AUTOMOTIVE, PortPinInputPullResistor=PORT_PIN_IN_PULL_UP, PortPinLevelValue=PORT_PIN_LEVEL_LOW, PortPinMode=PORT_PIN_MODE_ALL, PortPinModeChangeable=false, PortPinOutputPadDriveStrength=PORT_PIN_DEFAULT_DRIVER, PortPinOutputPinDriveMode=PORT_PIN_OUT_PUSHPULL:
            PortPin_0: PortPinId=640, PortPinSymbolicName=PORT_40_PIN_0
            PortPin_1: PortPinId=641, PortPinSymbolicName=PORT_40_PIN_1
            PortPin_10: PortPinId=650, PortPinSymbolicName=PORT_40_PIN_10
            PortPin_11: PortPinId=651, PortPinSymbolicName=PORT_40_PIN_11
            PortPin_12: PortPinId=652, PortPinSymbolicName=PORT_40_PIN_12
            PortPin_13: PortPinId=653, PortPinSymbolicName=PORT_40_PIN_13
            PortPin_14: PortPinId=654, PortPinSymbolicName=PORT_40_PIN_14
            PortPin_2: PortPinId=642, PortPinSymbolicName=PORT_40_PIN_2
            PortPin_3: PortPinId=643, PortPinSymbolicName=PORT_40_PIN_3
            PortPin_4: PortPinId=644, PortPinSymbolicName=PORT_40_PIN_4
            PortPin_5: PortPinId=645, PortPinSymbolicName=PORT_40_PIN_5
            PortPin_6: PortPinId=646, PortPinSymbolicName=PORT_40_PIN_6
            PortPin_7: PortPinId=647, PortPinSymbolicName=PORT_40_PIN_7
            PortPin_8: PortPinId=648, PortPinSymbolicName=PORT_40_PIN_8
            PortPin_9: PortPinId=649, PortPinSymbolicName=PORT_40_PIN_9
        PortContainer_2: PortNumber=2, PortNumberOfPortPins=12
          12 x PortPin, all with PortPinControllerSelect=DISABLE, PortPinDirection=PORT_PIN_IN, PortPinDirectionChangeable=false, PortPinEmergencyStop=false, PortPinEnableAnalogInputOnly=PORT_PIN_ANALOG_INPUT_DISABLE, PortPinInitialMode=GPIO, PortPinInputPadLevel=PORT_INPUT_LEVEL_CMOS_AUTOMOTIVE, PortPinInputPullResistor=PORT_PIN_IN_PULL_UP, PortPinLevelValue=PORT_PIN_LEVEL_LOW, PortPinMode=PORT_PIN_MODE_ALL, PortPinModeChangeable=false, PortPinOutputPadDriveStrength=PORT_PIN_DEFAULT_DRIVER, PortPinOutputPinDriveMode=PORT_PIN_OUT_PUSHPULL:
            PortPin_0: PortPinId=32, PortPinSymbolicName=PORT_2_PIN_0
            PortPin_1: PortPinId=33, PortPinSymbolicName=PORT_2_PIN_1
            PortPin_10: PortPinId=42, PortPinSymbolicName=PORT_2_PIN_10
            PortPin_11: PortPinId=43, PortPinSymbolicName=PORT_2_PIN_11
            PortPin_2: PortPinId=34, PortPinSymbolicName=PORT_2_PIN_2
            PortPin_3: PortPinId=35, PortPinSymbolicName=PORT_2_PIN_3
            PortPin_4: PortPinId=36, PortPinSymbolicName=PORT_2_PIN_4
            PortPin_5: PortPinId=37, PortPinSymbolicName=PORT_2_PIN_5
            PortPin_6: PortPinId=38, PortPinSymbolicName=PORT_2_PIN_6
            PortPin_7: PortPinId=39, PortPinSymbolicName=PORT_2_PIN_7
            PortPin_8: PortPinId=40, PortPinSymbolicName=PORT_2_PIN_8
            PortPin_9: PortPinId=41, PortPinSymbolicName=PORT_2_PIN_9
        PortContainer_10: PortNumber=10, PortNumberOfPortPins=9
          9 x PortPin, all with PortPinControllerSelect=DISABLE, PortPinDirection=PORT_PIN_IN, PortPinDirectionChangeable=false, PortPinEmergencyStop=false, PortPinEnableAnalogInputOnly=PORT_PIN_ANALOG_INPUT_DISABLE, PortPinInitialMode=GPIO, PortPinInputPadLevel=PORT_INPUT_LEVEL_CMOS_AUTOMOTIVE, PortPinInputPullResistor=PORT_PIN_IN_PULL_UP, PortPinLevelValue=PORT_PIN_LEVEL_LOW, PortPinMode=PORT_PIN_MODE_ALL, PortPinModeChangeable=false, PortPinOutputPadDriveStrength=PORT_PIN_DEFAULT_DRIVER, PortPinOutputPinDriveMode=PORT_PIN_OUT_PUSHPULL:
            PortPin_0: PortPinId=160, PortPinSymbolicName=PORT_10_PIN_0
            PortPin_1: PortPinId=161, PortPinSymbolicName=PORT_10_PIN_1
            PortPin_2: PortPinId=162, PortPinSymbolicName=PORT_10_PIN_2
            PortPin_3: PortPinId=163, PortPinSymbolicName=PORT_10_PIN_3
            PortPin_4: PortPinId=164, PortPinSymbolicName=PORT_10_PIN_4
            PortPin_5: PortPinId=165, PortPinSymbolicName=PORT_10_PIN_5
            PortPin_6: PortPinId=166, PortPinSymbolicName=PORT_10_PIN_6
            PortPin_7: PortPinId=167, PortPinSymbolicName=PORT_10_PIN_7
            PortPin_8: PortPinId=168, PortPinSymbolicName=PORT_10_PIN_8
        PortContainer_11: PortNumber=11, PortNumberOfPortPins=16
          16 x PortPin, all with PortPinControllerSelect=DISABLE, PortPinDirectionChangeable=false, PortPinEmergencyStop=false, PortPinEnableAnalogInputOnly=PORT_PIN_ANALOG_INPUT_DISABLE, PortPinInputPadLevel=PORT_INPUT_LEVEL_CMOS_AUTOMOTIVE, PortPinMode=PORT_PIN_MODE_ALL, PortPinModeChangeable=false, PortPinOutputPinDriveMode=PORT_PIN_OUT_PUSHPULL:
            PortPin_0: PortPinDirection=PORT_PIN_IN, PortPinId=176, PortPinInitialMode=GPIO, PortPinInputPullResistor=PORT_PIN_IN_PULL_UP, PortPinLevelValue=PORT_PIN_LEVEL_LOW, PortPinOutputPadDriveStrength=PORT_PIN_DEFAULT_DRIVER, PortPinSymbolicName=PORT_11_PIN_0
            PortPin_1: PortPinDirection=PORT_PIN_IN, PortPinId=177, PortPinInitialMode=GPIO, PortPinInputPullResistor=PORT_PIN_IN_PULL_UP, PortPinLevelValue=PORT_PIN_LEVEL_LOW, PortPinOutputPadDriveStrength=PORT_PIN_DEFAULT_DRIVER, PortPinSymbolicName=PORT_11_PIN_1
            PortPin_10: PortPinDirection=PORT_PIN_IN, PortPinId=186, PortPinInitialMode=GPIO, PortPinInputPullResistor=PORT_PIN_IN_PULL_UP, PortPinLevelValue=PORT_PIN_LEVEL_LOW, PortPinOutputPadDriveStrength=PORT_PIN_DEFAULT_DRIVER, PortPinSymbolicName=PORT_11_PIN_10_GETH_RXD0
            PortPin_11: PortPinDirection=PORT_PIN_IN, PortPinId=187, PortPinInitialMode=GPIO, PortPinInputPullResistor=PORT_PIN_IN_PULL_UP, PortPinLevelValue=PORT_PIN_LEVEL_LOW, PortPinOutputPadDriveStrength=PORT_PIN_DEFAULT_DRIVER, PortPinSymbolicName=PORT_11_PIN_11_GETH_RXDVA
            PortPin_12: PortPinDirection=PORT_PIN_IN, PortPinId=188, PortPinInitialMode=GPIO, PortPinInputPullResistor=PORT_PIN_IN_PULL_UP, PortPinLevelValue=PORT_PIN_LEVEL_LOW, PortPinOutputPadDriveStrength=PORT_PIN_DEFAULT_DRIVER, PortPinSymbolicName=PORT_11_PIN_12_GETH_REFCLK
            PortPin_13: PortPinDirection=PORT_PIN_IN, PortPinId=189, PortPinInitialMode=GPIO, PortPinInputPullResistor=PORT_PIN_IN_PULL_UP, PortPinLevelValue=PORT_PIN_LEVEL_LOW, PortPinOutputPadDriveStrength=PORT_PIN_DEFAULT_DRIVER, PortPinSymbolicName=PORT_11_PIN_13
            PortPin_14: PortPinDirection=PORT_PIN_IN, PortPinId=190, PortPinInitialMode=GPIO, PortPinInputPullResistor=PORT_PIN_IN_PULL_UP, PortPinLevelValue=PORT_PIN_LEVEL_LOW, PortPinOutputPadDriveStrength=PORT_PIN_DEFAULT_DRIVER, PortPinSymbolicName=PORT_11_PIN_14
            PortPin_15: PortPinDirection=PORT_PIN_OUT, PortPinId=191, PortPinInitialMode=GPIO, PortPinInputPullResistor=PORT_PIN_IN_PULL_UP, PortPinLevelValue=PORT_PIN_LEVEL_HIGH, PortPinOutputPadDriveStrength=PORT_PIN_DEFAULT_DRIVER, PortPinSymbolicName=PORT_11_PIN_15_PHY_WAKE
            PortPin_2: PortPinDirection=PORT_PIN_OUT, PortPinId=178, PortPinInitialMode=ALT6, PortPinInputPullResistor=PORT_PIN_IN_NO_PULL, PortPinLevelValue=PORT_PIN_LEVEL_LOW, PortPinOutputPadDriveStrength=PORT_PIN_RGMII_DRIVER, PortPinSymbolicName=PORT_11_PIN_2_GETH_TXD1
            PortPin_3: PortPinDirection=PORT_PIN_OUT, PortPinId=179, PortPinInitialMode=ALT6, PortPinInputPullResistor=PORT_PIN_IN_NO_PULL, PortPinLevelValue=PORT_PIN_LEVEL_LOW, PortPinOutputPadDriveStrength=PORT_PIN_RGMII_DRIVER, PortPinSymbolicName=PORT_11_PIN_3_GETH_TXD0
            PortPin_4: PortPinDirection=PORT_PIN_IN, PortPinId=180, PortPinInitialMode=GPIO, PortPinInputPullResistor=PORT_PIN_IN_PULL_UP, PortPinLevelValue=PORT_PIN_LEVEL_LOW, PortPinOutputPadDriveStrength=PORT_PIN_DEFAULT_DRIVER, PortPinSymbolicName=PORT_11_PIN_4
            PortPin_5: PortPinDirection=PORT_PIN_IN, PortPinId=181, PortPinInitialMode=GPIO, PortPinInputPullResistor=PORT_PIN_IN_PULL_UP, PortPinLevelValue=PORT_PIN_LEVEL_LOW, PortPinOutputPadDriveStrength=PORT_PIN_DEFAULT_DRIVER, PortPinSymbolicName=PORT_11_PIN_5
            PortPin_6: PortPinDirection=PORT_PIN_OUT, PortPinId=182, PortPinInitialMode=ALT6, PortPinInputPullResistor=PORT_PIN_IN_NO_PULL, PortPinLevelValue=PORT_PIN_LEVEL_LOW, PortPinOutputPadDriveStrength=PORT_PIN_RGMII_DRIVER, PortPinSymbolicName=PORT_11_PIN_6_GETH_TXEN
            PortPin_7: PortPinDirection=PORT_PIN_IN, PortPinId=183, PortPinInitialMode=GPIO, PortPinInputPullResistor=PORT_PIN_IN_PULL_UP, PortPinLevelValue=PORT_PIN_LEVEL_LOW, PortPinOutputPadDriveStrength=PORT_PIN_DEFAULT_DRIVER, PortPinSymbolicName=PORT_11_PIN_7
            PortPin_8: PortPinDirection=PORT_PIN_IN, PortPinId=184, PortPinInitialMode=GPIO, PortPinInputPullResistor=PORT_PIN_IN_PULL_UP, PortPinLevelValue=PORT_PIN_LEVEL_LOW, PortPinOutputPadDriveStrength=PORT_PIN_DEFAULT_DRIVER, PortPinSymbolicName=PORT_11_PIN_8
            PortPin_9: PortPinDirection=PORT_PIN_IN, PortPinId=185, PortPinInitialMode=GPIO, PortPinInputPullResistor=PORT_PIN_IN_PULL_UP, PortPinLevelValue=PORT_PIN_LEVEL_LOW, PortPinOutputPadDriveStrength=PORT_PIN_DEFAULT_DRIVER, PortPinSymbolicName=PORT_11_PIN_9_GETH_RXD1
        PortContainer_12: PortNumber=12, PortNumberOfPortPins=2
          PortPin_0 (PortPin):
            PortPinControllerSelect = DISABLE
            PortPinDirection = PORT_PIN_OUT
            PortPinDirectionChangeable = false
            PortPinEmergencyStop = false
            PortPinEnableAnalogInputOnly = PORT_PIN_ANALOG_INPUT_DISABLE
            PortPinId = 192
            PortPinInitialMode = ALT6
            PortPinInputPadLevel = PORT_INPUT_LEVEL_CMOS_AUTOMOTIVE
            PortPinInputPullResistor = PORT_PIN_IN_PULL_UP
            PortPinLevelValue = PORT_PIN_LEVEL_LOW
            PortPinMode = PORT_PIN_MODE_ALL
            PortPinModeChangeable = false
            PortPinOutputPadDriveStrength = PORT_PIN_MEDIUM_DRIVER
            PortPinOutputPinDriveMode = PORT_PIN_OUT_PUSHPULL
            PortPinSymbolicName = PORT_12_PIN_0_GETH_MDC
          PortPin_1 (PortPin):
            PortPinControllerSelect = DISABLE
            PortPinDirection = PORT_PIN_OUT
            PortPinDirectionChangeable = false
            PortPinEmergencyStop = false
            PortPinEnableAnalogInputOnly = PORT_PIN_ANALOG_INPUT_DISABLE
            PortPinId = 193
            PortPinInitialMode = GPIO
            PortPinInputPadLevel = PORT_INPUT_LEVEL_CMOS_AUTOMOTIVE
            PortPinInputPullResistor = PORT_PIN_IN_PULL_UP
            PortPinLevelValue = PORT_PIN_LEVEL_HIGH
            PortPinMode = PORT_PIN_MODE_ALL
            PortPinModeChangeable = false
            PortPinOutputPadDriveStrength = PORT_PIN_DEFAULT_DRIVER
            PortPinOutputPinDriveMode = PORT_PIN_OUT_PUSHPULL
            PortPinSymbolicName = PORT_12_PIN_1_GETH_MDIO
        PortContainer_13: PortNumber=13, PortNumberOfPortPins=4
          PortLVDS_0 (PortLVDS):
            PortLVDSMode = LVDSH
            PortLVDSPadSupply = V3_3
            PortLVDSPinPair = Pin_0_Pin_1
            PortLVDSRxEnController = PORT_CONTROLLED
            PortLVDSRxPathEnable = false
            PortLVDSRxTerminationMode = INTERNAL_TERMINATION
            PortLVDSTxEnController = PORT_CONTROLLED
            PortLVDSTxPathEnable = false
            PortLVDSTxPowerDownPullDown = DISABLE
          PortLVDS_1 (PortLVDS):
            PortLVDSMode = LVDSH
            PortLVDSPadSupply = V3_3
            PortLVDSPinPair = Pin_2_Pin_3
            PortLVDSRxEnController = PORT_CONTROLLED
            PortLVDSRxPathEnable = false
            PortLVDSRxTerminationMode = INTERNAL_TERMINATION
            PortLVDSTxEnController = PORT_CONTROLLED
            PortLVDSTxPathEnable = false
            PortLVDSTxPowerDownPullDown = DISABLE
          4 x PortPin, all with PortPinControllerSelect=DISABLE, PortPinDirection=PORT_PIN_IN, PortPinDirectionChangeable=false, PortPinEmergencyStop=false, PortPinEnableAnalogInputOnly=PORT_PIN_ANALOG_INPUT_DISABLE, PortPinInitialMode=GPIO, PortPinInputPadLevel=PORT_INPUT_LEVEL_CMOS_AUTOMOTIVE, PortPinInputPullResistor=PORT_PIN_IN_PULL_UP, PortPinLevelValue=PORT_PIN_LEVEL_LOW, PortPinMode=PORT_PIN_MODE_ALL, PortPinModeChangeable=false, PortPinOutputPadDriveStrength=PORT_PIN_DEFAULT_DRIVER, PortPinOutputPinDriveMode=PORT_PIN_OUT_PUSHPULL:
            PortPin_0: PortPinId=208, PortPinSymbolicName=PORT_13_PIN_0
            PortPin_1: PortPinId=209, PortPinSymbolicName=PORT_13_PIN_1
            PortPin_2: PortPinId=210, PortPinSymbolicName=PORT_13_PIN_2
            PortPin_3: PortPinId=211, PortPinSymbolicName=PORT_13_PIN_3
        PortContainer_14: PortNumber=14, PortNumberOfPortPins=11
          PortLVDS_0 (PortLVDS):
            PortLVDSMode = LVDSH
            PortLVDSPadSupply = V3_3
            PortLVDSPinPair = Pin_10_Pin_9
            PortLVDSRxEnController = PORT_CONTROLLED
            PortLVDSRxPathEnable = false
            PortLVDSRxTerminationMode = INTERNAL_TERMINATION
            PortLVDSTxEnController = PORT_CONTROLLED
            PortLVDSTxPathEnable = false
            PortLVDSTxPowerDownPullDown = DISABLE
          11 x PortPin, all with PortPinControllerSelect=DISABLE, PortPinDirectionChangeable=false, PortPinEmergencyStop=false, PortPinEnableAnalogInputOnly=PORT_PIN_ANALOG_INPUT_DISABLE, PortPinInputPadLevel=PORT_INPUT_LEVEL_CMOS_AUTOMOTIVE, PortPinLevelValue=PORT_PIN_LEVEL_LOW, PortPinMode=PORT_PIN_MODE_ALL, PortPinModeChangeable=false, PortPinOutputPinDriveMode=PORT_PIN_OUT_PUSHPULL:
            PortPin_0: PortPinDirection=PORT_PIN_OUT, PortPinId=224, PortPinInitialMode=ALT2, PortPinInputPullResistor=PORT_PIN_IN_PULL_UP, PortPinOutputPadDriveStrength=PORT_PIN_MEDIUM_DRIVER, PortPinSymbolicName=PORT_14_PIN_UART_TX
            PortPin_1: PortPinDirection=PORT_PIN_IN, PortPinId=225, PortPinInitialMode=GPIO, PortPinInputPullResistor=PORT_PIN_IN_NO_PULL, PortPinOutputPadDriveStrength=PORT_PIN_DEFAULT_DRIVER, PortPinSymbolicName=PORT_14_PIN_1_UART_RX
            PortPin_10: PortPinDirection=PORT_PIN_IN, PortPinId=234, PortPinInitialMode=GPIO, PortPinInputPullResistor=PORT_PIN_IN_PULL_UP, PortPinOutputPadDriveStrength=PORT_PIN_DEFAULT_DRIVER, PortPinSymbolicName=PORT_14_PIN_10
            PortPin_2: PortPinDirection=PORT_PIN_IN, PortPinId=226, PortPinInitialMode=GPIO, PortPinInputPullResistor=PORT_PIN_IN_PULL_UP, PortPinOutputPadDriveStrength=PORT_PIN_DEFAULT_DRIVER, PortPinSymbolicName=PORT_14_PIN_2
            PortPin_3: PortPinDirection=PORT_PIN_IN, PortPinId=227, PortPinInitialMode=GPIO, PortPinInputPullResistor=PORT_PIN_IN_PULL_UP, PortPinOutputPadDriveStrength=PORT_PIN_DEFAULT_DRIVER, PortPinSymbolicName=PORT_14_PIN_3
            PortPin_4: PortPinDirection=PORT_PIN_IN, PortPinId=228, PortPinInitialMode=GPIO, PortPinInputPullResistor=PORT_PIN_IN_PULL_UP, PortPinOutputPadDriveStrength=PORT_PIN_DEFAULT_DRIVER, PortPinSymbolicName=PORT_14_PIN_4
            PortPin_5: PortPinDirection=PORT_PIN_IN, PortPinId=229, PortPinInitialMode=GPIO, PortPinInputPullResistor=PORT_PIN_IN_PULL_UP, PortPinOutputPadDriveStrength=PORT_PIN_DEFAULT_DRIVER, PortPinSymbolicName=PORT_14_PIN_5
            PortPin_6: PortPinDirection=PORT_PIN_IN, PortPinId=230, PortPinInitialMode=GPIO, PortPinInputPullResistor=PORT_PIN_IN_PULL_UP, PortPinOutputPadDriveStrength=PORT_PIN_DEFAULT_DRIVER, PortPinSymbolicName=PORT_14_PIN_6
            PortPin_7: PortPinDirection=PORT_PIN_IN, PortPinId=231, PortPinInitialMode=GPIO, PortPinInputPullResistor=PORT_PIN_IN_PULL_UP, PortPinOutputPadDriveStrength=PORT_PIN_DEFAULT_DRIVER, PortPinSymbolicName=PORT_14_PIN_7
            PortPin_8: PortPinDirection=PORT_PIN_IN, PortPinId=232, PortPinInitialMode=GPIO, PortPinInputPullResistor=PORT_PIN_IN_PULL_UP, PortPinOutputPadDriveStrength=PORT_PIN_DEFAULT_DRIVER, PortPinSymbolicName=PORT_14_PIN_8
            PortPin_9: PortPinDirection=PORT_PIN_IN, PortPinId=233, PortPinInitialMode=GPIO, PortPinInputPullResistor=PORT_PIN_IN_PULL_UP, PortPinOutputPadDriveStrength=PORT_PIN_DEFAULT_DRIVER, PortPinSymbolicName=PORT_14_PIN_9
        PortContainer_15: PortNumber=15, PortNumberOfPortPins=9
          9 x PortPin, all with PortPinControllerSelect=DISABLE, PortPinDirection=PORT_PIN_IN, PortPinDirectionChangeable=false, PortPinEmergencyStop=false, PortPinEnableAnalogInputOnly=PORT_PIN_ANALOG_INPUT_DISABLE, PortPinInitialMode=GPIO, PortPinInputPadLevel=PORT_INPUT_LEVEL_CMOS_AUTOMOTIVE, PortPinInputPullResistor=PORT_PIN_IN_PULL_UP, PortPinLevelValue=PORT_PIN_LEVEL_LOW, PortPinMode=PORT_PIN_MODE_ALL, PortPinModeChangeable=false, PortPinOutputPadDriveStrength=PORT_PIN_DEFAULT_DRIVER, PortPinOutputPinDriveMode=PORT_PIN_OUT_PUSHPULL:
            PortPin_0: PortPinId=240, PortPinSymbolicName=PORT_15_PIN_0
            PortPin_1: PortPinId=241, PortPinSymbolicName=PORT_15_PIN_1
            PortPin_2: PortPinId=242, PortPinSymbolicName=PORT_15_PIN_2
            PortPin_3: PortPinId=243, PortPinSymbolicName=PORT_15_PIN_3
            PortPin_4: PortPinId=244, PortPinSymbolicName=PORT_15_PIN_4
            PortPin_5: PortPinId=245, PortPinSymbolicName=PORT_15_PIN_5
            PortPin_6: PortPinId=246, PortPinSymbolicName=PORT_15_PIN_6
            PortPin_7: PortPinId=247, PortPinSymbolicName=PORT_15_PIN_7
            PortPin_8: PortPinId=248, PortPinSymbolicName=PORT_15_PIN_8
        PortContainer_20: PortNumber=20, PortNumberOfPortPins=13
          13 x PortPin, all with PortPinControllerSelect=DISABLE, PortPinDirectionChangeable=false, PortPinEmergencyStop=false, PortPinEnableAnalogInputOnly=PORT_PIN_ANALOG_INPUT_DISABLE, PortPinInitialMode=GPIO, PortPinInputPadLevel=PORT_INPUT_LEVEL_CMOS_AUTOMOTIVE, PortPinInputPullResistor=PORT_PIN_IN_PULL_UP, PortPinLevelValue=PORT_PIN_LEVEL_LOW, PortPinMode=PORT_PIN_MODE_ALL, PortPinModeChangeable=false, PortPinOutputPadDriveStrength=PORT_PIN_DEFAULT_DRIVER, PortPinOutputPinDriveMode=PORT_PIN_OUT_PUSHPULL:
            PortPin_0: PortPinDirection=PORT_PIN_IN, PortPinId=320, PortPinSymbolicName=PORT_20_PIN_0
            PortPin_1: PortPinDirection=PORT_PIN_IN, PortPinId=321, PortPinSymbolicName=PORT_20_PIN_1
            PortPin_11: PortPinDirection=PORT_PIN_IN, PortPinId=333, PortPinSymbolicName=PORT_20_PIN_13
            PortPin_12: PortPinDirection=PORT_PIN_IN, PortPinId=334, PortPinSymbolicName=PORT_20_PIN_14
            PortPin_2: PortPinDirection=PORT_PIN_IN, PortPinId=322, PortPinSymbolicName=PORT_20_PIN_2
            PortPin_3: PortPinDirection=PORT_PIN_IN, PortPinId=323, PortPinSymbolicName=PORT_20_PIN_3
            PortPin_4: PortPinDirection=PORT_PIN_IN, PortPinId=326, PortPinSymbolicName=PORT_20_PIN_6
            PortPin_5: PortPinDirection=PORT_PIN_IN, PortPinId=327, PortPinSymbolicName=PORT_20_PIN_7
            PortPin_6: PortPinDirection=PORT_PIN_IN, PortPinId=328, PortPinSymbolicName=PORT_20_PIN_8
            PortPin_7: PortPinDirection=PORT_PIN_IN, PortPinId=329, PortPinSymbolicName=PORT_20_PIN_9
            PortPin_8: PortPinDirection=PORT_PIN_IN, PortPinId=330, PortPinSymbolicName=PORT_20_PIN_10
            PortPin_LED4: PortPinDirection=PORT_PIN_OUT, PortPinId=331, PortPinSymbolicName=PORT_20_PIN_11
            PortPin_LED5: PortPinDirection=PORT_PIN_OUT, PortPinId=332, PortPinSymbolicName=PORT_20_PIN_12
    PortGeneral:
      PortDevErrorDetect = false
      PortInitApiMode = PORT_MCAL_SUPERVISOR
      PortInitCheckApi = false
      PortSafetyEnable = true
      PortSetPinDirectionApi = false
      PortSetPinModeApi = false
      PortVersionInfoApi = false
