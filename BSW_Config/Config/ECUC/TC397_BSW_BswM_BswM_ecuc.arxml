AUTOSAR XML (schema 00048)
package /ActiveEcuC
  module config BswM: implementation-config-variant=VARIANT-PRE-COMPILE, module-description=BswM_Impl
    BswMGeneral:
      BswMMainFunctionPeriod = 0.01
      BswMVersionInfoApi = false
      BswMDevErrorDetect = false
      BswMCanSMEnabled = false
      BswMComMEnabled = true
      BswMDcmEnabled = false
      BswMEcuMEnabled = true
      BswMEthIfEnabled = true
      BswMEthSMEnabled = true
      BswMFrSMEnabled = false
      BswMGenericRequestEnabled = true
      BswMJ1939DcmEnabled = false
      BswMJ1939NmEnabled = false
      BswMLinSMEnabled = false
      BswMLinTPEnabled = false
      BswMNmEnabled = true
      BswMNvMEnabled = false
      BswMPduREnabled = false
      BswMRuleControlEnabled = false
      BswMSdEnabled = true
      BswMWdgMEnabled = false
      BswMModeCheck = true
      BswMActionListQueueSearchAlgorithm = LINEAR_SEARCH
      BswMSafeBswChecks = false
      BswMCommonData
      BswMGeneration:
        BswMOutOfBoundsWriteSanitizer = false
        BswMOutOfBoundsReadSanitizer = false
        BswMReduceConstantData2Define = true
        BswMBoolDataInArrayOfStructStrategy = BITMASKING
        BswMInterfacesForDeactivatedData = false
    BswMConfig
      BswMArbitration
        ESH_RunToPostRun (BswMRule):
          BswMNestedExecutionOnly = false
          BswMRuleId = 5
          BswMRuleInitState = BSWM_FALSE
          BswMRuleExpressionRef = ESH_LE_RunToPostRunTransition
          BswMRuleTrueActionList = ESH_AL_RunToPostRun
        ESH_LE_RunToPostRunTransition (BswMLogicalExpression): BswMLogicalOperator=BSWM_AND, BswMArgumentRef=ESH_LE_RunReached, BswMArgumentRef=ESH_LE_NoRunAndNoKillAllRequest
        ESH_LE_RunReached (BswMLogicalExpression): BswMLogicalOperator=BSWM_AND, BswMArgumentRef=ESH_Cond_StateIsRun, BswMArgumentRef=ESH_Cond_ModeIsRun
        ESH_Cond_StateIsRun (BswMModeCondition): BswMConditionType=BSWM_EQUALS, BswMConditionMode=ESH_State
          BswMConditionValue
            BswMBswMode: BswMBswRequestedMode=ESH_RUN
        ESH_State (BswMModeRequestPort): BswMArbitrateOnInit=true, BswMRequestProcessing=BSWM_IMMEDIATE
          BswMModeRequestSource
            BswMGenericRequest: BswMModeRequesterId=230, BswMRequestedModeMax=7
              7 x BswMGenericRequestMode:
                ESH_INIT: BswMGenericRequestModeValue=0
                ESH_RUN: BswMGenericRequestModeValue=1
                ESH_POST_RUN: BswMGenericRequestModeValue=2
                ESH_PREP_SHUTDOWN: BswMGenericRequestModeValue=3
                ESH_WAIT_FOR_NVM: BswMGenericRequestModeValue=4
                ESH_SHUTDOWN: BswMGenericRequestModeValue=5
                ESH_WAKEUP: BswMGenericRequestModeValue=6
          BswMModeInitValue
            BswMBswModeInitValue: BswMBswModeInitValueMode=ESH_INIT
        ESH_Cond_ModeIsRun (BswMModeCondition): BswMConditionType=BSWM_EQUALS, BswMConditionMode=ESH_ModeNotification
          BswMConditionValue
            BswMModeDeclaration: BswMModeValueRef=RUN
        ESH_ModeNotification (BswMModeRequestPort): BswMArbitrateOnInit=false, BswMRequestProcessing=BSWM_DEFERRED
          BswMModeRequestSource
            BswMSwcModeNotification: BswMSwcModeNotificationModeDeclarationGroupPrototypeRef=BswM_MDGP_ESH_Mode
          BswMModeInitValue
            BswMSwcModeInitValue: BswMSwcModeInitValueRef=STARTUP
        3 x BswMLogicalExpression:
          ESH_LE_NoRunAndNoKillAllRequest: BswMLogicalOperator=BSWM_OR, BswMArgumentRef=ESH_LE_NoRunReasons
          ESH_LE_NoRunReasons: BswMLogicalOperator=BSWM_AND, BswMArgumentRef=ESH_LE_RunReleased, BswMArgumentRef=ESH_Cond_SelfRunReqTimerExpired
          ESH_LE_RunReleased: BswMLogicalOperator=BSWM_AND, BswMArgumentRef=ESH_Cond_RunRequest0IsReleased, BswMArgumentRef=ESH_Cond_RunRequest1IsReleased
        ESH_Cond_RunRequest0IsReleased (BswMModeCondition): BswMConditionType=BSWM_EQUALS, BswMConditionMode=ESH_RunRequest_0
          BswMConditionValue
            BswMModeDeclaration: BswMModeValueRef=RELEASED
        ESH_RunRequest_0 (BswMModeRequestPort): BswMArbitrateOnInit=false, BswMRequestProcessing=BSWM_DEFERRED
          BswMModeRequestSource
            BswMSwcModeRequest: BswMModeRequestDataElementPrototypeName=requestedMode, BswMSwcModeRequestModeDeclarationGroupPrototypeRef=BswM_MDGP_ESH_RunRequest
          BswMModeInitValue
            BswMSwcModeInitValue: BswMSwcModeInitValueRef=RELEASED
        ESH_Cond_RunRequest1IsReleased (BswMModeCondition): BswMConditionType=BSWM_EQUALS, BswMConditionMode=ESH_RunRequest_1
          BswMConditionValue
            BswMModeDeclaration: BswMModeValueRef=RELEASED
        ESH_RunRequest_1 (BswMModeRequestPort): BswMArbitrateOnInit=false, BswMRequestProcessing=BSWM_DEFERRED
          BswMModeRequestSource
            BswMSwcModeRequest: BswMModeRequestDataElementPrototypeName=requestedMode, BswMSwcModeRequestModeDeclarationGroupPrototypeRef=BswM_MDGP_ESH_RunRequest
          BswMModeInitValue
            BswMSwcModeInitValue: BswMSwcModeInitValueRef=RELEASED
        ESH_Cond_SelfRunReqTimerExpired (BswMModeCondition): BswMConditionType=BSWM_EQUALS, BswMConditionMode=ESH_SelfRunRequestTimer
          BswMConditionValue
            BswMBswMode: BswMBswRequestedMode=BSWM_TIMER_EXPIRED
        ESH_SelfRunRequestTimer (BswMModeRequestPort): BswMArbitrateOnInit=false, BswMRequestProcessing=BSWM_DEFERRED
          BswMModeRequestSource
            BswMTimer
          BswMModeInitValue
            BswMBswModeInitValue: BswMBswModeInitValueMode=BSWM_TIMER_STOPPED
        ESH_WaitToShutdown (BswMRule):
          BswMNestedExecutionOnly = false
          BswMRuleId = 6
          BswMRuleInitState = BSWM_FALSE
          BswMRuleExpressionRef = ESH_LE_WaitForNvMToShutdown
          BswMRuleTrueActionList = ESH_AL_WaitForNvMToShutdown
        ESH_LE_WaitForNvMToShutdown (BswMLogicalExpression): BswMLogicalOperator=BSWM_AND, BswMArgumentRef=ESH_Cond_StateIsWaitForNvm, BswMArgumentRef=ESH_LE_NoWakeupOrKillAll
        ESH_Cond_StateIsWaitForNvm (BswMModeCondition): BswMConditionType=BSWM_EQUALS, BswMConditionMode=ESH_State
          BswMConditionValue
            BswMBswMode: BswMBswRequestedMode=ESH_WAIT_FOR_NVM
        ESH_LE_NoWakeupOrKillAll (BswMLogicalExpression): BswMLogicalOperator=BSWM_OR, BswMArgumentRef=ESH_LE_NoWakeup
        ESH_LE_NoWakeup (BswMLogicalExpression): BswMLogicalOperator=BSWM_AND, BswMArgumentRef=ESH_Cond_NoValidatedWakeups
        ESH_Cond_NoValidatedWakeups (BswMModeCondition): BswMConditionType=BSWM_EQUALS, BswMConditionMode=ESH_EcuM_GetValidatedWakeupEvents
          BswMConditionValue
            BswMBswMode: BswMBswRequestedMode=0
        ESH_EcuM_GetValidatedWakeupEvents (BswMModeRequestPort): BswMArbitrateOnInit=false, BswMRequestProcessing=BSWM_DEFERRED
          BswMModeRequestSource
            BswMUserConditionRequest: BswMUserCondition=EcuM_GetValidatedWakeupEvents()
        ESH_WakeupToPrep (BswMRule):
          BswMNestedExecutionOnly = false
          BswMRuleId = 8
          BswMRuleInitState = BSWM_FALSE
          BswMRuleExpressionRef = ESH_LE_WakeupToPrepShutdown
          BswMRuleTrueActionList = ESH_AL_WakeupToPrep
        ESH_LE_WakeupToPrepShutdown (BswMLogicalExpression):
          BswMLogicalOperator = BSWM_AND
          BswMArgumentRef = ESH_Cond_StateIsWakeup
          BswMArgumentRef = ESH_Cond_NoPendingWakeups
          BswMArgumentRef = ESH_LE_NoWakeup
          BswMArgumentRef = ESH_Cond_ModeIsWakeup
        ESH_Cond_StateIsWakeup (BswMModeCondition): BswMConditionType=BSWM_EQUALS, BswMConditionMode=ESH_State
          BswMConditionValue
            BswMBswMode: BswMBswRequestedMode=ESH_WAKEUP
        ESH_Cond_NoPendingWakeups (BswMModeCondition): BswMConditionType=BSWM_EQUALS, BswMConditionMode=ESH_EcuM_GetPendingWakeupEvents
          BswMConditionValue
            BswMBswMode: BswMBswRequestedMode=0
        ESH_EcuM_GetPendingWakeupEvents (BswMModeRequestPort): BswMArbitrateOnInit=false, BswMRequestProcessing=BSWM_DEFERRED
          BswMModeRequestSource
            BswMUserConditionRequest: BswMUserCondition=EcuM_GetPendingWakeupEvents()
        ESH_Cond_ModeIsWakeup (BswMModeCondition): BswMConditionType=BSWM_EQUALS, BswMConditionMode=ESH_ModeNotification
          BswMConditionValue
            BswMModeDeclaration: BswMModeValueRef=WAKEUP
        ESH_WaitToWakeup (BswMRule):
          BswMNestedExecutionOnly = false
          BswMRuleId = 7
          BswMRuleInitState = BSWM_FALSE
          BswMRuleExpressionRef = ESH_LE_WaitForNvMToWakeup
          BswMRuleTrueActionList = ESH_AL_WaitForNvMWakeup
        ESH_LE_WaitForNvMToWakeup (BswMLogicalExpression): BswMLogicalOperator=BSWM_AND, BswMArgumentRef=ESH_Cond_StateIsWaitForNvm, BswMArgumentRef=ESH_LE_ValidWakeup
        ESH_LE_ValidWakeup (BswMLogicalExpression): BswMLogicalOperator=BSWM_OR, BswMArgumentRef=ESH_Cond_ValidatedWakeups
        ESH_Cond_ValidatedWakeups (BswMModeCondition): BswMConditionType=BSWM_EQUALS_NOT, BswMConditionMode=ESH_EcuM_GetValidatedWakeupEvents
          BswMConditionValue
            BswMBswMode: BswMBswRequestedMode=0
        ESH_WakeupToRun (BswMRule):
          BswMNestedExecutionOnly = false
          BswMRuleId = 9
          BswMRuleInitState = BSWM_FALSE
          BswMRuleExpressionRef = ESH_LE_WakeupToRun
          BswMRuleTrueActionList = ESH_AL_WakeupToRun
        ESH_LE_WakeupToRun (BswMLogicalExpression): BswMLogicalOperator=BSWM_AND, BswMArgumentRef=ESH_Cond_StateIsWakeup, BswMArgumentRef=ESH_LE_ValidWakeup, BswMArgumentRef=ESH_Cond_ModeIsWakeup
        ESH_InitToWakeup (BswMRule):
          BswMNestedExecutionOnly = false
          BswMRuleId = 0
          BswMRuleInitState = BSWM_FALSE
          BswMRuleExpressionRef = ESH_LE_InitToWakeup
          BswMRuleTrueActionList = ESH_AL_InitToWakeup
        ESH_LE_InitToWakeup (BswMLogicalExpression): BswMLogicalOperator=BSWM_AND, BswMArgumentRef=ESH_Cond_StateIsInit
        ESH_Cond_StateIsInit (BswMModeCondition): BswMConditionType=BSWM_EQUALS, BswMConditionMode=ESH_State
          BswMConditionValue
            BswMBswMode: BswMBswRequestedMode=ESH_INIT
        ESH_PostRunToPrepNested (BswMRule):
          BswMNestedExecutionOnly = true
          BswMRuleId = 3
          BswMRuleInitState = BSWM_FALSE
          BswMRuleExpressionRef = ESH_LE_Dem_PostRunRequested
          BswMRuleTrueActionList = ESH_AL_PostRunToPrepShutdown
        3 x BswMLogicalExpression:
          ESH_LE_Dem_PostRunRequested: BswMLogicalOperator=BSWM_AND, BswMArgumentRef=ESH_LE_PostRunToPrep
          ESH_LE_PostRunToPrep: BswMLogicalOperator=BSWM_OR, BswMArgumentRef=ESH_LE_PostRunReleased
          ESH_LE_PostRunReleased: BswMLogicalOperator=BSWM_AND, BswMArgumentRef=ESH_Cond_PostRunRequest0IsReleased, BswMArgumentRef=ESH_Cond_PostRunRequest1IsReleased
        ESH_Cond_PostRunRequest0IsReleased (BswMModeCondition): BswMConditionType=BSWM_EQUALS, BswMConditionMode=ESH_PostRunRequest_0
          BswMConditionValue
            BswMModeDeclaration: BswMModeValueRef=RELEASED
        ESH_PostRunRequest_0 (BswMModeRequestPort): BswMArbitrateOnInit=false, BswMRequestProcessing=BSWM_DEFERRED
          BswMModeRequestSource
            BswMSwcModeRequest: BswMModeRequestDataElementPrototypeName=requestedMode, BswMSwcModeRequestModeDeclarationGroupPrototypeRef=BswM_MDGP_ESH_RunRequest
          BswMModeInitValue
            BswMSwcModeInitValue: BswMSwcModeInitValueRef=RELEASED
        ESH_Cond_PostRunRequest1IsReleased (BswMModeCondition): BswMConditionType=BSWM_EQUALS, BswMConditionMode=ESH_PostRunRequest_1
          BswMConditionValue
            BswMModeDeclaration: BswMModeValueRef=RELEASED
        ESH_PostRunRequest_1 (BswMModeRequestPort): BswMArbitrateOnInit=false, BswMRequestProcessing=BSWM_DEFERRED
          BswMModeRequestSource
            BswMSwcModeRequest: BswMModeRequestDataElementPrototypeName=requestedMode, BswMSwcModeRequestModeDeclarationGroupPrototypeRef=BswM_MDGP_ESH_RunRequest
          BswMModeInitValue
            BswMSwcModeInitValue: BswMSwcModeInitValueRef=RELEASED
        ESH_PostRunNested (BswMRule):
          BswMNestedExecutionOnly = true
          BswMRuleId = 2
          BswMRuleInitState = BSWM_FALSE
          BswMRuleExpressionRef = ESH_LE_PostRunToRun
          BswMRuleFalseActionList = ESH_AL_ESH_PostRunToPrepCheck
          BswMRuleTrueActionList = ESH_AL_PostRunToRun
        3 x BswMLogicalExpression:
          ESH_LE_PostRunToRun: BswMLogicalOperator=BSWM_AND, BswMArgumentRef=ESH_LE_RunRequestsOrWakeup
          ESH_LE_RunRequestsOrWakeup: BswMLogicalOperator=BSWM_OR, BswMArgumentRef=ESH_LE_RunRequested, BswMArgumentRef=ESH_LE_ValidWakeup
          ESH_LE_RunRequested: BswMLogicalOperator=BSWM_OR, BswMArgumentRef=ESH_Cond_RunRequest0IsRequested, BswMArgumentRef=ESH_Cond_RunRequest1IsRequested
        ESH_Cond_RunRequest0IsRequested (BswMModeCondition): BswMConditionType=BSWM_EQUALS, BswMConditionMode=ESH_RunRequest_0
          BswMConditionValue
            BswMModeDeclaration: BswMModeValueRef=REQUESTED
        ESH_Cond_RunRequest1IsRequested (BswMModeCondition): BswMConditionType=BSWM_EQUALS, BswMConditionMode=ESH_RunRequest_1
          BswMConditionValue
            BswMModeDeclaration: BswMModeValueRef=REQUESTED
        ESH_PostRun (BswMRule):
          BswMNestedExecutionOnly = false
          BswMRuleId = 1
          BswMRuleInitState = BSWM_FALSE
          BswMRuleExpressionRef = ESH_LE_PostRun
          BswMRuleTrueActionList = ESH_AL_ExitPostRun
        ESH_LE_PostRun (BswMLogicalExpression): BswMLogicalOperator=BSWM_AND, BswMArgumentRef=ESH_Cond_StateIsPostRun, BswMArgumentRef=ESH_Cond_ModeIsPostRun
        ESH_Cond_StateIsPostRun (BswMModeCondition): BswMConditionType=BSWM_EQUALS, BswMConditionMode=ESH_State
          BswMConditionValue
            BswMBswMode: BswMBswRequestedMode=ESH_POST_RUN
        ESH_Cond_ModeIsPostRun (BswMModeCondition): BswMConditionType=BSWM_EQUALS, BswMConditionMode=ESH_ModeNotification
          BswMConditionValue
            BswMModeDeclaration: BswMModeValueRef=POSTRUN
        ESH_PrepToWait (BswMRule):
          BswMNestedExecutionOnly = false
          BswMRuleId = 4
          BswMRuleInitState = BSWM_FALSE
          BswMRuleExpressionRef = ESH_LE_PrepShutdownToWaitForNvM
          BswMRuleTrueActionList = ESH_AL_PrepShutdownToWaitForNvM
        ESH_LE_PrepShutdownToWaitForNvM (BswMLogicalExpression): BswMLogicalOperator=BSWM_AND, BswMArgumentRef=ESH_Cond_StateIsPrepShutdown, BswMArgumentRef=ESH_Cond_ModeIsShutdown
        ESH_Cond_StateIsPrepShutdown (BswMModeCondition): BswMConditionType=BSWM_EQUALS, BswMConditionMode=ESH_State
          BswMConditionValue
            BswMBswMode: BswMBswRequestedMode=ESH_PREP_SHUTDOWN
        ESH_Cond_ModeIsShutdown (BswMModeCondition): BswMConditionType=BSWM_EQUALS, BswMConditionMode=ESH_ModeNotification
          BswMConditionValue
            BswMModeDeclaration: BswMModeValueRef=SHUTDOWN
      BswMModeControl: BswMInitActionListRef=INIT_AL_Initialize
        ESH_AL_RunToPostRun (BswMActionList): BswMActionListExecution=BSWM_CONDITION
          7 x BswMActionListItem, all with BswMAbortOnFail=false:
            ESH_Action_EcuMClearValidatedWakeupEvents: BswMActionListItemIndex=0, BswMActionListItemRef=BswMModeControl/ESH_Action_EcuMClearValidatedWakeupEvents
            ESH_Action_OnEnterPostRun: BswMActionListItemIndex=4, BswMActionListItemRef=BswMModeControl/ESH_Action_OnEnterPostRun
            ESH_Action_SwitchPostRun: BswMActionListItemIndex=5, BswMActionListItemRef=BswMModeControl/ESH_Action_SwitchPostRun
            ESH_Action_ESH_PostRun: BswMActionListItemIndex=6, BswMActionListItemRef=BswMModeControl/ESH_Action_ESH_PostRun
            ESH_Action_ComMDisallow_ComMChannel_Vlan10: BswMActionListItemIndex=1, BswMActionListItemRef=BswMModeControl/ESH_Action_ComMDisallow_ComMChannel_Vlan10
            ESH_Action_ComMDisallow_ComMChannel_Vlan23: BswMActionListItemIndex=2, BswMActionListItemRef=BswMModeControl/ESH_Action_ComMDisallow_ComMChannel_Vlan23
            ESH_Action_ComMDisallow_ComMChannel_Vlan1: BswMActionListItemIndex=3, BswMActionListItemRef=BswMModeControl/ESH_Action_ComMDisallow_ComMChannel_Vlan1
        3 x BswMAction:
          ESH_Action_EcuMClearValidatedWakeupEvents
            BswMAvailableActions
              BswMUserCallout: BswMUserCalloutFunction=EcuM_ClearValidatedWakeupEvent(ECUM_WKSOURCE_ALL_SOURCES), BswMCreateCallout=false, BswMUserIncludeFile=EcuM.h
          ESH_Action_OnEnterPostRun
            BswMAvailableActions
              BswMUserCallout: BswMUserCalloutFunction=BswM_ESH_OnEnterPostRun(), BswMCreateCallout=true
          ESH_Action_SwitchPostRun
            BswMAvailableActions
              BswMRteSwitch: BswMSwitchedMode=POSTRUN, BswMRteSwitchPortRef=ESH_ModeSwitch
        ESH_ModeSwitch (BswMSwitchPort): BswMModeSwitchInterfaceRef=BswM_MSI_ESH_Mode
        ESH_Action_ESH_PostRun (BswMAction)
          BswMAvailableActions
            BswMGenericModeSwitch: BswMGenericRequestRef=ESH_State, BswMGenericRequestModeRef=ESH_POST_RUN
        ESH_AL_WaitForNvMToShutdown (BswMActionList): BswMActionListExecution=BSWM_CONDITION
          ESH_Action_OnEnterShutdown (BswMActionListItem): BswMAbortOnFail=false, BswMActionListItemIndex=0, BswMActionListItemRef=BswMModeControl/ESH_Action_OnEnterShutdown
          ESH_Action_EcuMGoToSelectedShutdownTarget (BswMActionListItem): BswMAbortOnFail=false, BswMActionListItemIndex=1, BswMActionListItemRef=BswMModeControl/ESH_Action_EcuMGoToSelectedShutdownTarget
        ESH_Action_OnEnterShutdown (BswMAction)
          BswMAvailableActions
            BswMUserCallout: BswMUserCalloutFunction=BswM_ESH_OnEnterShutdown(), BswMCreateCallout=true
        ESH_Action_EcuMGoToSelectedShutdownTarget (BswMAction)
          BswMAvailableActions
            BswMUserCallout: BswMUserCalloutFunction=(void)EcuM_GoToSelectedShutdownTarget(), BswMCreateCallout=false, BswMUserIncludeFile=EcuM.h
        ESH_AL_WakeupToPrep (BswMActionList): BswMActionListExecution=BSWM_CONDITION
          3 x BswMActionListItem, all with BswMAbortOnFail=false:
            ESH_Action_OnEnterPrepShutdown: BswMActionListItemIndex=0, BswMActionListItemRef=BswMModeControl/ESH_Action_OnEnterPrepShutdown
            ESH_Action_SwitchShutdown: BswMActionListItemIndex=1, BswMActionListItemRef=BswMModeControl/ESH_Action_SwitchShutdown
            ESH_Action_ESH_PrepShutdown: BswMActionListItemIndex=2, BswMActionListItemRef=BswMModeControl/ESH_Action_ESH_PrepShutdown
        3 x BswMAction:
          ESH_Action_OnEnterPrepShutdown
            BswMAvailableActions
              BswMUserCallout: BswMUserCalloutFunction=BswM_ESH_OnEnterPrepShutdown(), BswMCreateCallout=true
          ESH_Action_SwitchShutdown
            BswMAvailableActions
              BswMRteSwitch: BswMSwitchedMode=SHUTDOWN, BswMRteSwitchPortRef=ESH_ModeSwitch
          ESH_Action_ESH_PrepShutdown
            BswMAvailableActions
              BswMGenericModeSwitch: BswMGenericRequestRef=ESH_State, BswMGenericRequestModeRef=ESH_PREP_SHUTDOWN
        ESH_AL_WaitForNvMWakeup (BswMActionList): BswMActionListExecution=BSWM_CONDITION
          3 x BswMActionListItem, all with BswMAbortOnFail=false:
            ESH_Action_OnEnterWakeup: BswMActionListItemIndex=0, BswMActionListItemRef=BswMModeControl/ESH_Action_OnEnterWakeup
            ESH_Action_SwitchWakeup: BswMActionListItemIndex=1, BswMActionListItemRef=BswMModeControl/ESH_Action_SwitchWakeup
            ESH_Action_ESH_Wakeup: BswMActionListItemIndex=2, BswMActionListItemRef=BswMModeControl/ESH_Action_ESH_Wakeup
        3 x BswMAction:
          ESH_Action_OnEnterWakeup
            BswMAvailableActions
              BswMUserCallout: BswMUserCalloutFunction=BswM_ESH_OnEnterWakeup(), BswMCreateCallout=true
          ESH_Action_SwitchWakeup
            BswMAvailableActions
              BswMRteSwitch: BswMSwitchedMode=WAKEUP, BswMRteSwitchPortRef=ESH_ModeSwitch
          ESH_Action_ESH_Wakeup
            BswMAvailableActions
              BswMGenericModeSwitch: BswMGenericRequestRef=ESH_State, BswMGenericRequestModeRef=ESH_WAKEUP
        ESH_AL_WakeupToRun (BswMActionList): BswMActionListExecution=BSWM_CONDITION
          7 x BswMActionListItem, all with BswMAbortOnFail=false:
            ESH_Action_SelfRunRequestTimer_Start: BswMActionListItemIndex=0, BswMActionListItemRef=BswMModeControl/ESH_Action_SelfRunRequestTimer_Start
            ESH_Action_OnEnterRun: BswMActionListItemIndex=4, BswMActionListItemRef=BswMModeControl/ESH_Action_OnEnterRun
            ESH_Action_SwitchRun: BswMActionListItemIndex=5, BswMActionListItemRef=BswMModeControl/ESH_Action_SwitchRun
            ESH_Action_ESH_Run: BswMActionListItemIndex=6, BswMActionListItemRef=BswMModeControl/ESH_Action_ESH_Run
            ESH_Action_ComMAllow_ComMChannel_Vlan10: BswMActionListItemIndex=1, BswMActionListItemRef=BswMModeControl/ESH_Action_ComMAllow_ComMChannel_Vlan10
            ESH_Action_ComMAllow_ComMChannel_Vlan23: BswMActionListItemIndex=2, BswMActionListItemRef=BswMModeControl/ESH_Action_ComMAllow_ComMChannel_Vlan23
            ESH_Action_ComMAllow_ComMChannel_Vlan1: BswMActionListItemIndex=3, BswMActionListItemRef=BswMModeControl/ESH_Action_ComMAllow_ComMChannel_Vlan1
        4 x BswMAction:
          ESH_Action_SelfRunRequestTimer_Start
            BswMAvailableActions
              BswMTimerControl: BswMTimerAction=BSWM_TIMER_START, BswMTimerValue=0.1, BswMTimerRef=ESH_SelfRunRequestTimer
          ESH_Action_OnEnterRun
            BswMAvailableActions
              BswMUserCallout: BswMUserCalloutFunction=BswM_ESH_OnEnterRun(), BswMCreateCallout=true
          ESH_Action_SwitchRun
            BswMAvailableActions
              BswMRteSwitch: BswMSwitchedMode=RUN, BswMRteSwitchPortRef=ESH_ModeSwitch
          ESH_Action_ESH_Run
            BswMAvailableActions
              BswMGenericModeSwitch: BswMGenericRequestRef=ESH_State, BswMGenericRequestModeRef=ESH_RUN
        6 x BswMActionList, all with BswMActionListExecution=BSWM_CONDITION:
          ESH_AL_InitToWakeup
            3 x BswMActionListItem, all with BswMAbortOnFail=false:
              ESH_Action_OnEnterWakeup: BswMActionListItemIndex=0, BswMActionListItemRef=BswMModeControl/ESH_Action_OnEnterWakeup
              ESH_Action_SwitchWakeup: BswMActionListItemIndex=1, BswMActionListItemRef=BswMModeControl/ESH_Action_SwitchWakeup
              ESH_Action_ESH_Wakeup: BswMActionListItemIndex=2, BswMActionListItemRef=BswMModeControl/ESH_Action_ESH_Wakeup
          ESH_AL_PostRunToPrepShutdown
            3 x BswMActionListItem, all with BswMAbortOnFail=false:
              ESH_Action_OnEnterPrepShutdown: BswMActionListItemIndex=0, BswMActionListItemRef=BswMModeControl/ESH_Action_OnEnterPrepShutdown
              ESH_Action_SwitchShutdown: BswMActionListItemIndex=1, BswMActionListItemRef=BswMModeControl/ESH_Action_SwitchShutdown
              ESH_Action_ESH_PrepShutdown: BswMActionListItemIndex=2, BswMActionListItemRef=BswMModeControl/ESH_Action_ESH_PrepShutdown
          ESH_AL_ESH_PostRunToPrepCheck
            ESH_PostRunToPrepNested (BswMActionListItem): BswMAbortOnFail=false, BswMActionListItemIndex=0, BswMActionListItemRef=BswMArbitration/ESH_PostRunToPrepNested
          ESH_AL_PostRunToRun
            5 x BswMActionListItem, all with BswMAbortOnFail=false:
              ESH_Action_SelfRunRequestTimer_Start: BswMActionListItemIndex=0, BswMActionListItemRef=BswMModeControl/ESH_Action_SelfRunRequestTimer_Start
              ESH_Action_OnEnterRun: BswMActionListItemIndex=2, BswMActionListItemRef=BswMModeControl/ESH_Action_OnEnterRun
              ESH_Action_SwitchRun: BswMActionListItemIndex=3, BswMActionListItemRef=BswMModeControl/ESH_Action_SwitchRun
              ESH_Action_ESH_Run: BswMActionListItemIndex=4, BswMActionListItemRef=BswMModeControl/ESH_Action_ESH_Run
              ESH_Action_ComMAllow_ComMChannel_Vlan10: BswMActionListItemIndex=1, BswMActionListItemRef=BswMModeControl/ESH_Action_ComMAllow_ComMChannel_Vlan10
          ESH_AL_ExitPostRun
            ESH_PostRunNested (BswMActionListItem): BswMAbortOnFail=false, BswMActionListItemIndex=0, BswMActionListItemRef=BswMArbitration/ESH_PostRunNested
          ESH_AL_PrepShutdownToWaitForNvM
            ESH_Action_OnEnterWaitForNvm (BswMActionListItem): BswMAbortOnFail=false, BswMActionListItemIndex=0, BswMActionListItemRef=BswMModeControl/ESH_Action_OnEnterWaitForNvm
            ESH_Action_ESH_WaitForNvm (BswMActionListItem): BswMAbortOnFail=false, BswMActionListItemIndex=1, BswMActionListItemRef=BswMModeControl/ESH_Action_ESH_WaitForNvm
        ESH_Action_OnEnterWaitForNvm (BswMAction)
          BswMAvailableActions
            BswMUserCallout: BswMUserCalloutFunction=BswM_ESH_OnEnterWaitForNvm(), BswMCreateCallout=true
        ESH_Action_ESH_WaitForNvm (BswMAction)
          BswMAvailableActions
            BswMGenericModeSwitch: BswMGenericRequestRef=ESH_State, BswMGenericRequestModeRef=ESH_WAIT_FOR_NVM
        INIT_AL_Initialize (BswMActionList): BswMActionListExecution=BSWM_CONDITION
          19 x BswMActionListItem, all with BswMAbortOnFail=false:
            INIT_Action_EnableInterrupts: BswMActionListItemIndex=15, BswMActionListItemRef=BswMModeControl/INIT_Action_EnableInterrupts
            INIT_Action_Rte_Start: BswMActionListItemIndex=16, BswMActionListItemRef=BswMModeControl/INIT_Action_Rte_Start
            INIT_Action_EthTrcv_30_Tja1100_Init: BswMActionListItemIndex=1, BswMActionListItemRef=BswMModeControl/INIT_Action_EthTrcv_30_Tja1100_Init
            INIT_Action_Eth_30_Tc3xx_init: BswMActionListItemIndex=2, BswMActionListItemRef=BswMModeControl/INIT_Action_Eth_30_Tc3xx_init
            INIT_Action_Com_Init: BswMActionListItemIndex=5, BswMActionListItemRef=BswMModeControl/INIT_Action_Com_Init
            INIT_Action_ComM_Init: BswMActionListItemIndex=17, BswMActionListItemRef=BswMModeControl/INIT_Action_ComM_Init
            INIT_Action_EthIf_Init: BswMActionListItemIndex=3, BswMActionListItemRef=BswMModeControl/INIT_Action_EthIf_Init
            INIT_Action_EthSM_Init: BswMActionListItemIndex=8, BswMActionListItemRef=BswMModeControl/INIT_Action_EthSM_Init
            INIT_Action_EthTsyn_Init: BswMActionListItemIndex=12, BswMActionListItemRef=BswMModeControl/INIT_Action_EthTsyn_Init
            INIT_Action_Nm_Init: BswMActionListItemIndex=9, BswMActionListItemRef=BswMModeControl/INIT_Action_Nm_Init
            INIT_Action_Pdur_Init: BswMActionListItemIndex=7, BswMActionListItemRef=BswMModeControl/INIT_Action_Pdur_Init
            INIT_Action_SoAd_Init: BswMActionListItemIndex=4, BswMActionListItemRef=BswMModeControl/INIT_Action_SoAd_Init
            INIT_Action_StbM_Init: BswMActionListItemIndex=14, BswMActionListItemRef=BswMModeControl/INIT_Action_StbM_Init
            INIT_Action_TcpIp_Init: BswMActionListItemIndex=11, BswMActionListItemRef=BswMModeControl/INIT_Action_TcpIp_Init
            INIT_Action_UdpNm_Init: BswMActionListItemIndex=10, BswMActionListItemRef=BswMModeControl/INIT_Action_UdpNm_Init
            INIT_Action_Det_Start: BswMActionListItemIndex=0, BswMActionListItemRef=BswMModeControl/INIT_Action_Det_Start
            INIT_Action_Debug: BswMActionListItemIndex=18, BswMActionListItemRef=BswMModeControl/INIT_Action_Debug
            INIT_Action_Sd_Init: BswMActionListItemIndex=13, BswMActionListItemRef=BswMModeControl/INIT_Action_Sd_Init
            INIT_Action_LdCom_Init: BswMActionListItemIndex=6, BswMActionListItemRef=BswMModeControl/INIT_Action_LdCom_Init
        25 x BswMAction:
          INIT_Action_EnableInterrupts
            BswMAvailableActions
              BswMUserCallout: BswMUserCalloutFunction=BswM_AL_SetProgrammableInterrupts(), BswMCreateCallout=true
          INIT_Action_Rte_Start
            BswMAvailableActions
              BswMUserCallout: BswMUserCalloutFunction=Rte_Start(), BswMCreateCallout=false, BswMUserIncludeFile=Rte_Main.h
          INIT_Action_EthTrcv_30_Tja1100_Init
            BswMAvailableActions
              BswMUserCallout:
                BswMUserCalloutFunction = EthTrcv_30_Tja1100_Init(EthTrcv_30_Tja1100_Config_Ptr)
                BswMCreateCallout = false
                BswMUserIncludeFile = EthTrcv_30_Tja1100.h
          INIT_Action_Eth_30_Tc3xx_init
            BswMAvailableActions
              BswMUserCallout: BswMUserCalloutFunction=Eth_30_Tc3xx_Init(Eth_30_Tc3xx_Config_Ptr), BswMCreateCallout=false, BswMUserIncludeFile=Eth_30_Tc3xx.h
          INIT_Action_SoAd_Init
            BswMAvailableActions
              BswMUserCallout: BswMUserCalloutFunction=SoAd_Init(SoAd_Config_Ptr), BswMCreateCallout=false, BswMUserIncludeFile=SoAd.h
          INIT_Action_EthIf_Init
            BswMAvailableActions
              BswMUserCallout: BswMUserCalloutFunction=EthIf_Init(EthIf_Config_Ptr), BswMCreateCallout=false, BswMUserIncludeFile=EthIf.h
          INIT_Action_Com_Init
            BswMAvailableActions
              BswMUserCallout: BswMUserCalloutFunction=Com_Init(Com_Config_Ptr), BswMCreateCallout=false, BswMUserIncludeFile=Com.h
          INIT_Action_Pdur_Init
            BswMAvailableActions
              BswMUserCallout: BswMUserCalloutFunction=PduR_Init(PduR_Config_Ptr), BswMCreateCallout=false, BswMUserIncludeFile=PduR.h
          INIT_Action_EthSM_Init
            BswMAvailableActions
              BswMUserCallout: BswMUserCalloutFunction=EthSM_Init(EthSM_Config_Ptr), BswMCreateCallout=false, BswMUserIncludeFile=EthSM.h
          INIT_Action_Nm_Init
            BswMAvailableActions
              BswMUserCallout: BswMUserCalloutFunction=Nm_Init(Nm_Config_Ptr), BswMCreateCallout=false, BswMUserIncludeFile=Nm.h
          INIT_Action_UdpNm_Init
            BswMAvailableActions
              BswMUserCallout: BswMUserCalloutFunction=UdpNm_Init(UdpNm_Config_Ptr), BswMCreateCallout=false, BswMUserIncludeFile=UdpNm.h
          INIT_Action_TcpIp_Init
            BswMAvailableActions
              BswMUserCallout: BswMUserCalloutFunction=TcpIp_Init(TcpIp_Config_Ptr), BswMCreateCallout=false, BswMUserIncludeFile=TcpIp.h
          INIT_Action_EthTsyn_Init
            BswMAvailableActions
              BswMUserCallout: BswMUserCalloutFunction=EthTSyn_Init(EthTSyn_Config_Ptr), BswMCreateCallout=false, BswMUserIncludeFile=EthTSyn.h
          INIT_Action_StbM_Init
            BswMAvailableActions
              BswMUserCallout: BswMUserCalloutFunction=StbM_Init(StbM_Config_Ptr), BswMCreateCallout=false, BswMUserIncludeFile=StbM.h
          INIT_Action_ComM_Init
            BswMAvailableActions
              BswMUserCallout: BswMUserCalloutFunction=ComM_Init(), BswMCreateCallout=false, BswMUserIncludeFile=ComM.h
          INIT_Action_Det_Start
            BswMAvailableActions
              BswMUserCallout: BswMUserCalloutFunction=Det_Start(), BswMCreateCallout=false, BswMUserIncludeFile=Det.h
          ESH_Action_ComMDisallow_ComMChannel_Vlan10
            BswMAvailableActions
              BswMComMAllowCom: BswMComAllowed=false, BswMComMAllowChannelRef=ComMChannel_Vlan10
          ESH_Action_ComMAllow_ComMChannel_Vlan10
            BswMAvailableActions
              BswMComMAllowCom: BswMComAllowed=true, BswMComMAllowChannelRef=ComMChannel_Vlan10
          INIT_Action_Debug
            BswMAvailableActions
              BswMUserCallout: BswMUserCalloutFunction=BswM_Action_EthTrcvDebug(), BswMCreateCallout=true, BswMUserIncludeFile=EthTrcv_30_Tja1100_Hw_Int.h
          INIT_Action_Sd_Init
            BswMAvailableActions
              BswMUserCallout: BswMUserCalloutFunction=Sd_Init(Sd_Config_Ptr), BswMCreateCallout=false, BswMUserIncludeFile=Sd.h
          INIT_Action_LdCom_Init
            BswMAvailableActions
              BswMUserCallout: BswMUserCalloutFunction=LdCom_Init(LdCom_Config_Ptr), BswMCreateCallout=false, BswMUserIncludeFile=LdCom.h
          ESH_Action_ComMDisallow_ComMChannel_Vlan23
            BswMAvailableActions
              BswMComMAllowCom: BswMComAllowed=false, BswMComMAllowChannelRef=ComMChannel_Vlan23
          ESH_Action_ComMAllow_ComMChannel_Vlan23
            BswMAvailableActions
              BswMComMAllowCom: BswMComAllowed=true, BswMComMAllowChannelRef=ComMChannel_Vlan23
          ESH_Action_ComMAllow_ComMChannel_Vlan1
            BswMAvailableActions
              BswMComMAllowCom: BswMComAllowed=true, BswMComMAllowChannelRef=ComMChannel_Vlan1
          ESH_Action_ComMDisallow_ComMChannel_Vlan1
            BswMAvailableActions
              BswMComMAllowCom: BswMComAllowed=false, BswMComMAllowChannelRef=ComMChannel_Vlan1
      ESH_Mode (BswMRteModeDclGroup): BswMInitMode=STARTUP
        5 x BswMRteMode:
          STARTUP: BswMModePhysicalValue=0
          RUN: BswMModePhysicalValue=1
          POSTRUN: BswMModePhysicalValue=2
          WAKEUP: BswMModePhysicalValue=3
          SHUTDOWN: BswMModePhysicalValue=4
      ESH_RunRequest (BswMRteModeDclGroup): BswMInitMode=RELEASED
        RELEASED (BswMRteMode): BswMModePhysicalValue=0
        REQUESTED (BswMRteMode): BswMModePhysicalValue=1
      BswMDataTypeMappingSets: BswMDataTypeMappingSetRef=BswMMappingSet
