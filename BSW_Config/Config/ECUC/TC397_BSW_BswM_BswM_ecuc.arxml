AUTOSAR XML (schema 00048)
package /ActiveEcuC
  module config BswM: implementation-config-variant=VARIANT-PRE-COMPILE, module-description=BswM_Impl
    BswMGeneral:
      BswMMainFunctionPeriod = 0.01
      BswMVersionInfoApi = false
      BswMDevErrorDetect = false
      BswMCanSMEnabled = false
      BswMComMEnabled = true
      BswMDcmEnabled = true
      BswMEcuMEnabled = true
      BswMEthIfEnabled = true
      BswMEthSMEnabled = true
      BswMFrSMEnabled = false
      BswMGenericRequestEnabled = true
      BswMJ1939DcmEnabled = false
      BswMJ1939NmEnabled = false
      BswMLinSMEnabled = false
      BswMLinTPEnabled = false
      BswMNmEnabled = false
      BswMNvMEnabled = false
      BswMPduREnabled = false
      BswMRuleControlEnabled = false
      BswMSdEnabled = true
      BswMWdgMEnabled = false
      BswMModeCheck = true
      BswMActionListQueueSearchAlgorithm = LINEAR_SEARCH
      BswMSafeBswChecks = false
      BswMCommonData
      BswMGeneration:
        BswMOutOfBoundsWriteSanitizer = false
        BswMOutOfBoundsReadSanitizer = false
        BswMReduceConstantData2Define = true
        BswMBoolDataInArrayOfStructStrategy = BITMASKING
        BswMInterfacesForDeactivatedData = false
    BswMConfig
      BswMArbitration
        ESH_RunToPostRun (BswMRule):
          BswMNestedExecutionOnly = false
          BswMRuleId = 5
          BswMRuleInitState = BSWM_FALSE
          BswMRuleExpressionRef = ESH_LE_RunToPostRunTransition
          BswMRuleTrueActionList = ESH_AL_ExitRun
        ESH_LE_RunToPostRunTransition (BswMLogicalExpression): BswMLogicalOperator=BSWM_AND, BswMArgumentRef=ESH_LE_RunReached, BswMArgumentRef=ESH_LE_NoRunAndNoKillAllRequest
        ESH_LE_RunReached (BswMLogicalExpression): BswMLogicalOperator=BSWM_AND, BswMArgumentRef=ESH_Cond_StateIsRun, BswMArgumentRef=ESH_Cond_ModeIsRun
        ESH_Cond_StateIsRun (BswMModeCondition): BswMConditionType=BSWM_EQUALS, BswMConditionMode=ESH_State
          BswMConditionValue
            BswMBswMode: BswMBswRequestedMode=ESH_RUN
        ESH_State (BswMModeRequestPort): BswMArbitrateOnInit=true, BswMRequestProcessing=BSWM_IMMEDIATE
          BswMModeRequestSource
            BswMGenericRequest: BswMModeRequesterId=230, BswMRequestedModeMax=7
              7 x BswMGenericRequestMode:
                ESH_INIT: BswMGenericRequestModeValue=0
                ESH_RUN: BswMGenericRequestModeValue=1
                ESH_POST_RUN: BswMGenericRequestModeValue=2
                ESH_PREP_SHUTDOWN: BswMGenericRequestModeValue=3
                ESH_WAIT_FOR_NVM: BswMGenericRequestModeValue=4
                ESH_SHUTDOWN: BswMGenericRequestModeValue=5
                ESH_WAKEUP: BswMGenericRequestModeValue=6
          BswMModeInitValue
            BswMBswModeInitValue: BswMBswModeInitValueMode=ESH_INIT
        ESH_Cond_ModeIsRun (BswMModeCondition): BswMConditionType=BSWM_EQUALS, BswMConditionMode=ESH_ModeNotification
          BswMConditionValue
            BswMModeDeclaration: BswMModeValueRef=RUN
        ESH_ModeNotification (BswMModeRequestPort): BswMArbitrateOnInit=false, BswMRequestProcessing=BSWM_DEFERRED
          BswMModeRequestSource
            BswMSwcModeNotification: BswMSwcModeNotificationModeDeclarationGroupPrototypeRef=BswM_MDGP_ESH_Mode
          BswMModeInitValue
            BswMSwcModeInitValue: BswMSwcModeInitValueRef=STARTUP
        3 x BswMLogicalExpression:
          ESH_LE_NoRunAndNoKillAllRequest: BswMLogicalOperator=BSWM_OR, BswMArgumentRef=ESH_LE_NoRunReasons
          ESH_LE_NoRunReasons: BswMLogicalOperator=BSWM_AND, BswMArgumentRef=ESH_LE_AllChannelsNoCom, BswMArgumentRef=ESH_LE_RunReleased, BswMArgumentRef=ESH_Cond_SelfRunReqTimerExpired
          ESH_LE_RunReleased: BswMLogicalOperator=BSWM_AND, BswMArgumentRef=ESH_Cond_RunRequest0IsReleased, BswMArgumentRef=ESH_Cond_RunRequest1IsReleased
        ESH_Cond_RunRequest0IsReleased (BswMModeCondition): BswMConditionType=BSWM_EQUALS, BswMConditionMode=ESH_RunRequest_0
          BswMConditionValue
            BswMModeDeclaration: BswMModeValueRef=RELEASED
        ESH_RunRequest_0 (BswMModeRequestPort): BswMArbitrateOnInit=false, BswMRequestProcessing=BSWM_DEFERRED
          BswMModeRequestSource
            BswMSwcModeRequest: BswMModeRequestDataElementPrototypeName=requestedMode, BswMSwcModeRequestModeDeclarationGroupPrototypeRef=BswM_MDGP_ESH_RunRequest
          BswMModeInitValue
            BswMSwcModeInitValue: BswMSwcModeInitValueRef=RELEASED
        ESH_Cond_RunRequest1IsReleased (BswMModeCondition): BswMConditionType=BSWM_EQUALS, BswMConditionMode=ESH_RunRequest_1
          BswMConditionValue
            BswMModeDeclaration: BswMModeValueRef=RELEASED
        ESH_RunRequest_1 (BswMModeRequestPort): BswMArbitrateOnInit=false, BswMRequestProcessing=BSWM_DEFERRED
          BswMModeRequestSource
            BswMSwcModeRequest: BswMModeRequestDataElementPrototypeName=requestedMode, BswMSwcModeRequestModeDeclarationGroupPrototypeRef=BswM_MDGP_ESH_RunRequest
          BswMModeInitValue
            BswMSwcModeInitValue: BswMSwcModeInitValueRef=RELEASED
        ESH_Cond_SelfRunReqTimerExpired (BswMModeCondition): BswMConditionType=BSWM_EQUALS, BswMConditionMode=ESH_SelfRunRequestTimer
          BswMConditionValue
            BswMBswMode: BswMBswRequestedMode=BSWM_TIMER_EXPIRED
        ESH_SelfRunRequestTimer (BswMModeRequestPort): BswMArbitrateOnInit=false, BswMRequestProcessing=BSWM_DEFERRED
          BswMModeRequestSource
            BswMTimer
          BswMModeInitValue
            BswMBswModeInitValue: BswMBswModeInitValueMode=BSWM_TIMER_STOPPED
        ESH_WaitToShutdown (BswMRule):
          BswMNestedExecutionOnly = false
          BswMRuleId = 7
          BswMRuleInitState = BSWM_FALSE
          BswMRuleExpressionRef = ESH_LE_WaitForNvMToShutdown
          BswMRuleTrueActionList = ESH_AL_WaitForNvMToShutdown
        ESH_LE_WaitForNvMToShutdown (BswMLogicalExpression): BswMLogicalOperator=BSWM_AND, BswMArgumentRef=ESH_Cond_StateIsWaitForNvm, BswMArgumentRef=ESH_LE_NoWakeupOrKillAll
        ESH_Cond_StateIsWaitForNvm (BswMModeCondition): BswMConditionType=BSWM_EQUALS, BswMConditionMode=ESH_State
          BswMConditionValue
            BswMBswMode: BswMBswRequestedMode=ESH_WAIT_FOR_NVM
        ESH_LE_NoWakeupOrKillAll (BswMLogicalExpression): BswMLogicalOperator=BSWM_OR, BswMArgumentRef=ESH_LE_NoWakeup
        ESH_LE_NoWakeup (BswMLogicalExpression): BswMLogicalOperator=BSWM_AND, BswMArgumentRef=ESH_Cond_NoValidatedWakeups, BswMArgumentRef=ESH_Cond_ComMNoPendingRequests
        ESH_Cond_NoValidatedWakeups (BswMModeCondition): BswMConditionType=BSWM_EQUALS, BswMConditionMode=ESH_EcuM_GetValidatedWakeupEvents
          BswMConditionValue
            BswMBswMode: BswMBswRequestedMode=0
        ESH_EcuM_GetValidatedWakeupEvents (BswMModeRequestPort): BswMArbitrateOnInit=false, BswMRequestProcessing=BSWM_DEFERRED
          BswMModeRequestSource
            BswMUserConditionRequest: BswMUserCondition=EcuM_GetValidatedWakeupEvents()
        ESH_WakeupToPrep (BswMRule):
          BswMNestedExecutionOnly = false
          BswMRuleId = 9
          BswMRuleInitState = BSWM_FALSE
          BswMRuleExpressionRef = ESH_LE_WakeupToPrepShutdown
          BswMRuleTrueActionList = ESH_AL_WakeupToPrep
        ESH_LE_WakeupToPrepShutdown (BswMLogicalExpression):
          BswMLogicalOperator = BSWM_AND
          BswMArgumentRef = ESH_Cond_StateIsWakeup
          BswMArgumentRef = ESH_Cond_NoPendingWakeups
          BswMArgumentRef = ESH_LE_NoWakeup
          BswMArgumentRef = ESH_Cond_ModeIsWakeup
        ESH_Cond_StateIsWakeup (BswMModeCondition): BswMConditionType=BSWM_EQUALS, BswMConditionMode=ESH_State
          BswMConditionValue
            BswMBswMode: BswMBswRequestedMode=ESH_WAKEUP
        ESH_Cond_NoPendingWakeups (BswMModeCondition): BswMConditionType=BSWM_EQUALS, BswMConditionMode=ESH_EcuM_GetPendingWakeupEvents
          BswMConditionValue
            BswMBswMode: BswMBswRequestedMode=0
        ESH_EcuM_GetPendingWakeupEvents (BswMModeRequestPort): BswMArbitrateOnInit=false, BswMRequestProcessing=BSWM_DEFERRED
          BswMModeRequestSource
            BswMUserConditionRequest: BswMUserCondition=EcuM_GetPendingWakeupEvents()
        ESH_Cond_ModeIsWakeup (BswMModeCondition): BswMConditionType=BSWM_EQUALS, BswMConditionMode=ESH_ModeNotification
          BswMConditionValue
            BswMModeDeclaration: BswMModeValueRef=WAKEUP
        ESH_WaitToWakeup (BswMRule):
          BswMNestedExecutionOnly = false
          BswMRuleId = 8
          BswMRuleInitState = BSWM_FALSE
          BswMRuleExpressionRef = ESH_LE_WaitForNvMToWakeup
          BswMRuleTrueActionList = ESH_AL_WaitForNvMWakeup
        ESH_LE_WaitForNvMToWakeup (BswMLogicalExpression): BswMLogicalOperator=BSWM_AND, BswMArgumentRef=ESH_Cond_StateIsWaitForNvm, BswMArgumentRef=ESH_LE_ValidWakeup
        ESH_LE_ValidWakeup (BswMLogicalExpression): BswMLogicalOperator=BSWM_OR, BswMArgumentRef=ESH_Cond_ValidatedWakeups, BswMArgumentRef=ESH_Cond_ComMPendingRequests
        ESH_Cond_ValidatedWakeups (BswMModeCondition): BswMConditionType=BSWM_EQUALS_NOT, BswMConditionMode=ESH_EcuM_GetValidatedWakeupEvents
          BswMConditionValue
            BswMBswMode: BswMBswRequestedMode=0
        ESH_WakeupToRun (BswMRule):
          BswMNestedExecutionOnly = false
          BswMRuleId = 10
          BswMRuleInitState = BSWM_FALSE
          BswMRuleExpressionRef = ESH_LE_WakeupToRun
          BswMRuleTrueActionList = ESH_AL_WakeupToRun
        ESH_LE_WakeupToRun (BswMLogicalExpression): BswMLogicalOperator=BSWM_AND, BswMArgumentRef=ESH_Cond_StateIsWakeup, BswMArgumentRef=ESH_LE_ValidWakeup, BswMArgumentRef=ESH_Cond_ModeIsWakeup
        ESH_InitToWakeup (BswMRule):
          BswMNestedExecutionOnly = false
          BswMRuleId = 0
          BswMRuleInitState = BSWM_FALSE
          BswMRuleExpressionRef = ESH_LE_InitToWakeup
          BswMRuleTrueActionList = ESH_AL_InitToWakeup
        ESH_LE_InitToWakeup (BswMLogicalExpression): BswMLogicalOperator=BSWM_AND, BswMArgumentRef=ESH_Cond_StateIsInit
        ESH_Cond_StateIsInit (BswMModeCondition): BswMConditionType=BSWM_EQUALS, BswMConditionMode=ESH_State
          BswMConditionValue
            BswMBswMode: BswMBswRequestedMode=ESH_INIT
        ESH_PostRunToPrepNested (BswMRule):
          BswMNestedExecutionOnly = true
          BswMRuleId = 3
          BswMRuleInitState = BSWM_FALSE
          BswMRuleExpressionRef = ESH_LE_Dem_PostRunRequested
          BswMRuleTrueActionList = ESH_AL_PostRunToPrepShutdown
        3 x BswMLogicalExpression:
          ESH_LE_Dem_PostRunRequested: BswMLogicalOperator=BSWM_AND, BswMArgumentRef=ESH_LE_PostRunToPrep
          ESH_LE_PostRunToPrep: BswMLogicalOperator=BSWM_OR, BswMArgumentRef=ESH_LE_PostRunReleased
          ESH_LE_PostRunReleased: BswMLogicalOperator=BSWM_AND, BswMArgumentRef=ESH_Cond_PostRunRequest0IsReleased, BswMArgumentRef=ESH_Cond_PostRunRequest1IsReleased
        ESH_Cond_PostRunRequest0IsReleased (BswMModeCondition): BswMConditionType=BSWM_EQUALS, BswMConditionMode=ESH_PostRunRequest_0
          BswMConditionValue
            BswMModeDeclaration: BswMModeValueRef=RELEASED
        ESH_PostRunRequest_0 (BswMModeRequestPort): BswMArbitrateOnInit=false, BswMRequestProcessing=BSWM_DEFERRED
          BswMModeRequestSource
            BswMSwcModeRequest: BswMModeRequestDataElementPrototypeName=requestedMode, BswMSwcModeRequestModeDeclarationGroupPrototypeRef=BswM_MDGP_ESH_RunRequest
          BswMModeInitValue
            BswMSwcModeInitValue: BswMSwcModeInitValueRef=RELEASED
        ESH_Cond_PostRunRequest1IsReleased (BswMModeCondition): BswMConditionType=BSWM_EQUALS, BswMConditionMode=ESH_PostRunRequest_1
          BswMConditionValue
            BswMModeDeclaration: BswMModeValueRef=RELEASED
        ESH_PostRunRequest_1 (BswMModeRequestPort): BswMArbitrateOnInit=false, BswMRequestProcessing=BSWM_DEFERRED
          BswMModeRequestSource
            BswMSwcModeRequest: BswMModeRequestDataElementPrototypeName=requestedMode, BswMSwcModeRequestModeDeclarationGroupPrototypeRef=BswM_MDGP_ESH_RunRequest
          BswMModeInitValue
            BswMSwcModeInitValue: BswMSwcModeInitValueRef=RELEASED
        ESH_PostRunNested (BswMRule):
          BswMNestedExecutionOnly = true
          BswMRuleId = 2
          BswMRuleInitState = BSWM_FALSE
          BswMRuleExpressionRef = ESH_LE_PostRunToRun
          BswMRuleFalseActionList = ESH_AL_ESH_PostRunToPrepCheck
          BswMRuleTrueActionList = ESH_AL_PostRunToRun
        3 x BswMLogicalExpression:
          ESH_LE_PostRunToRun: BswMLogicalOperator=BSWM_AND, BswMArgumentRef=ESH_LE_RunRequestsOrWakeup
          ESH_LE_RunRequestsOrWakeup: BswMLogicalOperator=BSWM_OR, BswMArgumentRef=ESH_LE_RunRequested, BswMArgumentRef=ESH_LE_ValidWakeup
          ESH_LE_RunRequested: BswMLogicalOperator=BSWM_OR, BswMArgumentRef=ESH_Cond_RunRequest0IsRequested, BswMArgumentRef=ESH_Cond_RunRequest1IsRequested
        ESH_Cond_RunRequest0IsRequested (BswMModeCondition): BswMConditionType=BSWM_EQUALS, BswMConditionMode=ESH_RunRequest_0
          BswMConditionValue
            BswMModeDeclaration: BswMModeValueRef=REQUESTED
        ESH_Cond_RunRequest1IsRequested (BswMModeCondition): BswMConditionType=BSWM_EQUALS, BswMConditionMode=ESH_RunRequest_1
          BswMConditionValue
            BswMModeDeclaration: BswMModeValueRef=REQUESTED
        ESH_PostRun (BswMRule):
          BswMNestedExecutionOnly = false
          BswMRuleId = 1
          BswMRuleInitState = BSWM_FALSE
          BswMRuleExpressionRef = ESH_LE_PostRun
          BswMRuleTrueActionList = ESH_AL_ExitPostRun
        ESH_LE_PostRun (BswMLogicalExpression): BswMLogicalOperator=BSWM_AND, BswMArgumentRef=ESH_Cond_StateIsPostRun, BswMArgumentRef=ESH_Cond_ModeIsPostRun
        ESH_Cond_StateIsPostRun (BswMModeCondition): BswMConditionType=BSWM_EQUALS, BswMConditionMode=ESH_State
          BswMConditionValue
            BswMBswMode: BswMBswRequestedMode=ESH_POST_RUN
        ESH_Cond_ModeIsPostRun (BswMModeCondition): BswMConditionType=BSWM_EQUALS, BswMConditionMode=ESH_ModeNotification
          BswMConditionValue
            BswMModeDeclaration: BswMModeValueRef=POSTRUN
        ESH_PrepToWait (BswMRule):
          BswMNestedExecutionOnly = false
          BswMRuleId = 4
          BswMRuleInitState = BSWM_FALSE
          BswMRuleExpressionRef = ESH_LE_PrepShutdownToWaitForNvM
          BswMRuleTrueActionList = ESH_AL_PrepShutdownToWaitForNvM
        ESH_LE_PrepShutdownToWaitForNvM (BswMLogicalExpression): BswMLogicalOperator=BSWM_AND, BswMArgumentRef=ESH_Cond_StateIsPrepShutdown, BswMArgumentRef=ESH_Cond_ModeIsShutdown
        ESH_Cond_StateIsPrepShutdown (BswMModeCondition): BswMConditionType=BSWM_EQUALS, BswMConditionMode=ESH_State
          BswMConditionValue
            BswMBswMode: BswMBswRequestedMode=ESH_PREP_SHUTDOWN
        ESH_Cond_ModeIsShutdown (BswMModeCondition): BswMConditionType=BSWM_EQUALS, BswMConditionMode=ESH_ModeNotification
          BswMConditionValue
            BswMModeDeclaration: BswMModeValueRef=SHUTDOWN
        ESH_LE_AllChannelsNoCom (BswMLogicalExpression):
          BswMLogicalOperator = BSWM_AND
          BswMArgumentRef = ESH_Cond_NoComOn_ComMChannel_untagged
          BswMArgumentRef = ESH_Cond_NoComOn_ComMChannel_Vlan1
          BswMArgumentRef = ESH_Cond_NoComOn_ComMChannel_Vlan23
        ESH_Cond_NoComOn_ComMChannel_untagged (BswMModeCondition): BswMConditionType=BSWM_EQUALS, BswMConditionMode=ESH_ComMIndication_ComMChannel_untagged
          BswMConditionValue
            BswMBswMode: BswMBswRequestedMode=COMM_NO_COMMUNICATION
        ESH_ComMIndication_ComMChannel_untagged (BswMModeRequestPort): BswMArbitrateOnInit=false, BswMRequestProcessing=BSWM_DEFERRED
          BswMModeRequestSource
            BswMComMIndication: BswMComMChannelRef=ComMChannel_untagged
          BswMModeInitValue
            BswMBswModeInitValue: BswMBswModeInitValueMode=COMM_NO_COMMUNICATION
        ESH_Cond_NoComOn_ComMChannel_Vlan1 (BswMModeCondition): BswMConditionType=BSWM_EQUALS, BswMConditionMode=ESH_ComMIndication_ComMChannel_Vlan1
          BswMConditionValue
            BswMBswMode: BswMBswRequestedMode=COMM_NO_COMMUNICATION
        ESH_ComMIndication_ComMChannel_Vlan1 (BswMModeRequestPort): BswMArbitrateOnInit=false, BswMRequestProcessing=BSWM_DEFERRED
          BswMModeRequestSource
            BswMComMIndication: BswMComMChannelRef=ComMChannel_Vlan1
          BswMModeInitValue
            BswMBswModeInitValue: BswMBswModeInitValueMode=COMM_NO_COMMUNICATION
        ESH_RunToPostRunNested (BswMRule):
          BswMNestedExecutionOnly = true
          BswMRuleId = 6
          BswMRuleInitState = BSWM_FALSE
          BswMRuleExpressionRef = ESH_LE_ComMNoPendingRequests
          BswMRuleTrueActionList = ESH_AL_RunToPostRun
        ESH_LE_ComMNoPendingRequests (BswMLogicalExpression): BswMLogicalOperator=BSWM_OR, BswMArgumentRef=ESH_Cond_ComMNoPendingRequests
        ESH_Cond_ComMNoPendingRequests (BswMModeCondition): BswMConditionType=BSWM_EQUALS, BswMConditionMode=ESH_ComMPendingRequests
          BswMConditionValue
            BswMBswMode: BswMBswRequestedMode=ESH_COMM_NO_REQUEST
        ESH_ComMPendingRequests (BswMModeRequestPort): BswMArbitrateOnInit=false, BswMRequestProcessing=BSWM_DEFERRED
          BswMModeRequestSource
            BswMGenericRequest: BswMModeRequesterId=232, BswMRequestedModeMax=2
              ESH_COMM_NO_REQUEST (BswMGenericRequestMode): BswMGenericRequestModeValue=0
              ESH_COMM_PENDING_REQUEST (BswMGenericRequestMode): BswMGenericRequestModeValue=1
          BswMModeInitValue
            BswMBswModeInitValue: BswMBswModeInitValueMode=ESH_COMM_NO_REQUEST
        ESH_Cond_ComMPendingRequests (BswMModeCondition): BswMConditionType=BSWM_EQUALS, BswMConditionMode=ESH_ComMPendingRequests
          BswMConditionValue
            BswMBswMode: BswMBswRequestedMode=ESH_COMM_PENDING_REQUEST
        ESH_Cond_NoComOn_ComMChannel_Vlan23 (BswMModeCondition): BswMConditionType=BSWM_EQUALS, BswMConditionMode=ESH_ComMIndication_ComMChannel_Vlan23
          BswMConditionValue
            BswMBswMode: BswMBswRequestedMode=COMM_NO_COMMUNICATION
        ESH_ComMIndication_ComMChannel_Vlan23 (BswMModeRequestPort): BswMArbitrateOnInit=false, BswMRequestProcessing=BSWM_DEFERRED
          BswMModeRequestSource
            BswMComMIndication: BswMComMChannelRef=ComMChannel_Vlan23
          BswMModeInitValue
            BswMBswModeInitValue: BswMBswModeInitValueMode=COMM_NO_COMMUNICATION
        SDC_SdStateChange_S_SdServerService_0xC3C1_SenState_EH_SdEventHandler_0xC3C1_SenState (BswMRule):
          BswMNestedExecutionOnly = false
          BswMRuleId = 27
          BswMRuleInitState = BSWM_FALSE
          BswMRuleExpressionRef = SDC_S_SdServerService_0xC3C1_SenState_EH_SdEventHandler_0xC3C1_SenStateIsRequested
          BswMRuleFalseActionList = SDC_AL_SdRelease_S_SdServerService_0xC3C1_SenState_EH_SdEventHandler_0xC3C1_SenState
          BswMRuleTrueActionList = SDC_AL_SdRequest_S_SdServerService_0xC3C1_SenState_EH_SdEventHandler_0xC3C1_SenState
        SDC_S_SdServerService_0xC3C1_SenState_EH_SdEventHandler_0xC3C1_SenStateIsRequested (BswMLogicalExpression):
          BswMLogicalOperator = BSWM_AND
          BswMArgumentRef = SDC_Cond_SdEHState_S_SdServerService_0xC3C1_SenState_EH_SdEventHandler_0xC3C1_SenState_EQ_SD_EVENT_HANDLER_REQUESTED
        SDC_Cond_SdEHState_S_SdServerService_0xC3C1_SenState_EH_SdEventHandler_0xC3C1_SenState_EQ_SD_EVENT_HANDLER_REQUESTED (BswMModeCondition): BswMConditionType=BSWM_EQUALS, BswMConditionMode=SDC_SdEHState_S_SdServerService_0xC3C1_SenState_EH_SdEventHandler_0xC3C1_SenState
          BswMConditionValue
            BswMBswMode: BswMBswRequestedMode=SD_EVENT_HANDLER_REQUESTED
        SDC_SdEHState_S_SdServerService_0xC3C1_SenState_EH_SdEventHandler_0xC3C1_SenState (BswMModeRequestPort): BswMArbitrateOnInit=false, BswMRequestProcessing=BSWM_DEFERRED
          BswMModeRequestSource
            BswMSdEventHandlerCurrentState: BswMSdEventHandlerRef=SdEventHandler_0xC3C1_SenState
          BswMModeInitValue
            BswMBswModeInitValue: BswMBswModeInitValueMode=SD_EVENT_HANDLER_RELEASED
        SDC_ApplRequest_C_SdClientService_0xC3CB_VechicleSpeed (BswMRule):
          BswMNestedExecutionOnly = false
          BswMRuleId = 11
          BswMRuleInitState = BSWM_TRUE
          BswMRuleExpressionRef = SDC_LE_ApplRequest_C_SdClientService_0xC3CB_VechicleSpeed
          BswMRuleFalseActionList = SDC_AL_ApplRelease_C_SdClientService_0xC3CB_VechicleSpeed
          BswMRuleTrueActionList = SDC_AL_ApplRequest_C_SdClientService_0xC3CB_VechicleSpeed
        SDC_LE_ApplRequest_C_SdClientService_0xC3CB_VechicleSpeed (BswMLogicalExpression): BswMLogicalOperator=BSWM_AND, BswMArgumentRef=SDC_Cond_C_SdClientService_0xC3CB_VechicleSpeed_EQ_SDC_CLIENT_REQUESTED
        SDC_Cond_C_SdClientService_0xC3CB_VechicleSpeed_EQ_SDC_CLIENT_REQUESTED (BswMModeCondition): BswMConditionType=BSWM_EQUALS, BswMConditionMode=SDC_C_SdClientService_0xC3CB_VechicleSpeed
          BswMConditionValue
            BswMModeDeclaration: BswMModeValueRef=SDC_CLIENT_REQUESTED
        SDC_C_SdClientService_0xC3CB_VechicleSpeed (BswMModeRequestPort): BswMArbitrateOnInit=false, BswMRequestProcessing=BSWM_DEFERRED
          BswMModeRequestSource
            BswMSwcModeRequest: BswMModeRequestDataElementPrototypeName=requestedMode, BswMSwcModeRequestModeDeclarationGroupPrototypeRef=BswM_MDGP_SDC_SdClientServiceRequest
          BswMModeInitValue
            BswMSwcModeInitValue: BswMSwcModeInitValueRef=SDC_CLIENT_REQUESTED
        SDC_SdStateChange_C_SdClientService_0xC3CD_VechicleInfo (BswMRule):
          BswMNestedExecutionOnly = false
          BswMRuleId = 24
          BswMRuleInitState = BSWM_FALSE
          BswMRuleExpressionRef = SDC_C_SdClientService_0xC3CD_VechicleInfoIsAvailable
          BswMRuleFalseActionList = SDC_AL_SdDown_C_SdClientService_0xC3CD_VechicleInfo_DOWN
          BswMRuleTrueActionList = SDC_AL_SdAvailable_C_SdClientService_0xC3CD_VechicleInfo_AVAILABLE
        SDC_C_SdClientService_0xC3CD_VechicleInfoIsAvailable (BswMLogicalExpression): BswMLogicalOperator=BSWM_AND, BswMArgumentRef=SDC_Cond_SdClientState_C_SdClientService_0xC3CD_VechicleInfo_EQ_SD_CLIENT_SERVICE_AVAILABLE
        SDC_Cond_SdClientState_C_SdClientService_0xC3CD_VechicleInfo_EQ_SD_CLIENT_SERVICE_AVAILABLE (BswMModeCondition): BswMConditionType=BSWM_EQUALS, BswMConditionMode=SDC_SdClientState_C_SdClientService_0xC3CD_VechicleInfo
          BswMConditionValue
            BswMBswMode: BswMBswRequestedMode=SD_CLIENT_SERVICE_AVAILABLE
        SDC_SdClientState_C_SdClientService_0xC3CD_VechicleInfo (BswMModeRequestPort): BswMArbitrateOnInit=false, BswMRequestProcessing=BSWM_DEFERRED
          BswMModeRequestSource
            BswMSdClientServiceCurrentState: BswMSdClientMethodsRef=SdClientService_0xC3CD_VechicleInfo
          BswMModeInitValue
            BswMBswModeInitValue: BswMBswModeInitValueMode=SD_CLIENT_SERVICE_DOWN
        SDC_SdStateChange_C_SdClientService_0xC3CB_VechicleSpeed (BswMRule):
          BswMNestedExecutionOnly = false
          BswMRuleId = 20
          BswMRuleInitState = BSWM_FALSE
          BswMRuleExpressionRef = SDC_C_SdClientService_0xC3CB_VechicleSpeedIsAvailable
          BswMRuleFalseActionList = SDC_AL_SdDown_C_SdClientService_0xC3CB_VechicleSpeed_DOWN
          BswMRuleTrueActionList = SDC_AL_SdAvailable_C_SdClientService_0xC3CB_VechicleSpeed_AVAILABLE
        SDC_C_SdClientService_0xC3CB_VechicleSpeedIsAvailable (BswMLogicalExpression): BswMLogicalOperator=BSWM_AND, BswMArgumentRef=SDC_Cond_SdClientState_C_SdClientService_0xC3CB_VechicleSpeed_EQ_SD_CLIENT_SERVICE_AVAILABLE
        SDC_Cond_SdClientState_C_SdClientService_0xC3CB_VechicleSpeed_EQ_SD_CLIENT_SERVICE_AVAILABLE (BswMModeCondition): BswMConditionType=BSWM_EQUALS, BswMConditionMode=SDC_SdClientState_C_SdClientService_0xC3CB_VechicleSpeed
          BswMConditionValue
            BswMBswMode: BswMBswRequestedMode=SD_CLIENT_SERVICE_AVAILABLE
        SDC_SdClientState_C_SdClientService_0xC3CB_VechicleSpeed (BswMModeRequestPort): BswMArbitrateOnInit=false, BswMRequestProcessing=BSWM_DEFERRED
          BswMModeRequestSource
            BswMSdClientServiceCurrentState: BswMSdClientMethodsRef=SdClientService_0xC3CB_VechicleSpeed
          BswMModeInitValue
            BswMBswModeInitValue: BswMBswModeInitValueMode=SD_CLIENT_SERVICE_DOWN
        SDC_SdStateChange_C_SdClientService_0xC3CC_VechicleStatus_CEG_SdConsumedEventGroup_0xC3CC_VechicleStatus (BswMRule):
          BswMNestedExecutionOnly = false
          BswMRuleId = 23
          BswMRuleInitState = BSWM_FALSE
          BswMRuleExpressionRef = SDC_C_SdClientService_0xC3CC_VechicleStatus_CEG_SdConsumedEventGroup_0xC3CC_VechicleStatusIsAvailable
          BswMRuleFalseActionList = SDC_AL_SdDown_C_SdClientService_0xC3CC_VechicleStatus_CEG_SdConsumedEventGroup_0xC3CC_VechicleStatus_DOWN
          BswMRuleTrueActionList = SDC_AL_SdAvailable_C_SdClientService_0xC3CC_VechicleStatus_CEG_SdConsumedEventGroup_0xC3CC_VechicleStatus_AVAILABLE
        SDC_C_SdClientService_0xC3CC_VechicleStatus_CEG_SdConsumedEventGroup_0xC3CC_VechicleStatusIsAvailable (BswMLogicalExpression):
          BswMLogicalOperator = BSWM_AND
          BswMArgumentRef = SDC_Cond_SdCEGState_C_SdClientService_0xC3CC_VechicleStatus_CEG_SdConsumedEventGroup_0xC3CC_VechicleStatus_EQ_SD_CONSUM_5f002936
        SDC_Cond_SdCEGState_C_SdClientService_0xC3CC_VechicleStatus_CEG_SdConsumedEventGroup_0xC3CC_VechicleStatus_EQ_SD_CONSUM_5f002936 (BswMModeCondition):
          BswMConditionType = BSWM_EQUALS
          BswMConditionMode = SDC_SdCEGState_C_SdClientService_0xC3CC_VechicleStatus_CEG_SdConsumedEventGroup_0xC3CC_VechicleStatus
          BswMConditionValue
            BswMBswMode: BswMBswRequestedMode=SD_CONSUMED_EVENTGROUP_AVAILABLE
        SDC_SdCEGState_C_SdClientService_0xC3CC_VechicleStatus_CEG_SdConsumedEventGroup_0xC3CC_VechicleStatus (BswMModeRequestPort): BswMArbitrateOnInit=false, BswMRequestProcessing=BSWM_DEFERRED
          BswMModeRequestSource
            BswMSdConsumedEventGroupCurrentState: BswMSdConsumedEventGroupRef=SdConsumedEventGroup_0xC3CC_VechicleStatus
          BswMModeInitValue
            BswMBswModeInitValue: BswMBswModeInitValueMode=SD_CONSUMED_EVENTGROUP_DOWN
        SDC_SdStateChange_C_SdClientService_0xC3CB_VechicleSpeed_CEG_SdConsumedEventGroup_0xC3CB_VechicleSpeed (BswMRule):
          BswMNestedExecutionOnly = false
          BswMRuleId = 21
          BswMRuleInitState = BSWM_FALSE
          BswMRuleExpressionRef = SDC_C_SdClientService_0xC3CB_VechicleSpeed_CEG_SdConsumedEventGroup_0xC3CB_VechicleSpeedIsAvailable
          BswMRuleFalseActionList = SDC_AL_SdDown_C_SdClientService_0xC3CB_VechicleSpeed_CEG_SdConsumedEventGroup_0xC3CB_VechicleSpeed_DOWN
          BswMRuleTrueActionList = SDC_AL_SdAvailable_C_SdClientService_0xC3CB_VechicleSpeed_CEG_SdConsumedEventGroup_0xC3CB_VechicleSpeed_AVAILABLE
        SDC_C_SdClientService_0xC3CB_VechicleSpeed_CEG_SdConsumedEventGroup_0xC3CB_VechicleSpeedIsAvailable (BswMLogicalExpression):
          BswMLogicalOperator = BSWM_AND
          BswMArgumentRef = SDC_Cond_SdCEGState_C_SdClientService_0xC3CB_VechicleSpeed_CEG_SdConsumedEventGroup_0xC3CB_VechicleSpeed_EQ_SD_CONSUMED_cbb5a314
        SDC_Cond_SdCEGState_C_SdClientService_0xC3CB_VechicleSpeed_CEG_SdConsumedEventGroup_0xC3CB_VechicleSpeed_EQ_SD_CONSUMED_cbb5a314 (BswMModeCondition):
          BswMConditionType = BSWM_EQUALS
          BswMConditionMode = SDC_SdCEGState_C_SdClientService_0xC3CB_VechicleSpeed_CEG_SdConsumedEventGroup_0xC3CB_VechicleSpeed
          BswMConditionValue
            BswMBswMode: BswMBswRequestedMode=SD_CONSUMED_EVENTGROUP_AVAILABLE
        SDC_SdCEGState_C_SdClientService_0xC3CB_VechicleSpeed_CEG_SdConsumedEventGroup_0xC3CB_VechicleSpeed (BswMModeRequestPort): BswMArbitrateOnInit=false, BswMRequestProcessing=BSWM_DEFERRED
          BswMModeRequestSource
            BswMSdConsumedEventGroupCurrentState: BswMSdConsumedEventGroupRef=SdConsumedEventGroup_0xC3CB_VechicleSpeed
          BswMModeInitValue
            BswMBswModeInitValue: BswMBswModeInitValueMode=SD_CONSUMED_EVENTGROUP_DOWN
        SDC_ApplRequest_C_SdClientService_0xC3CB_VechicleSpeed_CEG_SdConsumedEventGroup_0xC3CB_VechicleSpeed (BswMRule):
          BswMNestedExecutionOnly = false
          BswMRuleId = 12
          BswMRuleInitState = BSWM_TRUE
          BswMRuleExpressionRef = SDC_LE_ApplRequest_C_SdClientService_0xC3CB_VechicleSpeed_CEG_SdConsumedEventGroup_0xC3CB_VechicleSpeed
          BswMRuleFalseActionList = SDC_AL_ApplRelease_C_SdClientService_0xC3CB_VechicleSpeed_CEG_SdConsumedEventGroup_0xC3CB_VechicleSpeed
          BswMRuleTrueActionList = SDC_AL_ApplRequest_C_SdClientService_0xC3CB_VechicleSpeed_CEG_SdConsumedEventGroup_0xC3CB_VechicleSpeed
        SDC_LE_ApplRequest_C_SdClientService_0xC3CB_VechicleSpeed_CEG_SdConsumedEventGroup_0xC3CB_VechicleSpeed (BswMLogicalExpression):
          BswMLogicalOperator = BSWM_AND
          BswMArgumentRef = SDC_Cond_C_SdClientService_0xC3CB_VechicleSpeed_CEG_SdConsumedEventGroup_0xC3CB_VechicleSpeed_EQ_SDC_CEG_REQUESTED
        SDC_Cond_C_SdClientService_0xC3CB_VechicleSpeed_CEG_SdConsumedEventGroup_0xC3CB_VechicleSpeed_EQ_SDC_CEG_REQUESTED (BswMModeCondition): BswMConditionType=BSWM_EQUALS, BswMConditionMode=SDC_C_SdClientService_0xC3CB_VechicleSpeed_CEG_SdConsumedEventGroup_0xC3CB_VechicleSpeed
          BswMConditionValue
            BswMModeDeclaration: BswMModeValueRef=SDC_CEG_REQUESTED
        SDC_C_SdClientService_0xC3CB_VechicleSpeed_CEG_SdConsumedEventGroup_0xC3CB_VechicleSpeed (BswMModeRequestPort): BswMArbitrateOnInit=false, BswMRequestProcessing=BSWM_DEFERRED
          BswMModeRequestSource
            BswMSwcModeRequest:
              BswMModeRequestDataElementPrototypeName = requestedMode
              BswMSwcModeRequestModeDeclarationGroupPrototypeRef = BswM_MDGP_SDC_SdConsumedEventGroupRequest
          BswMModeInitValue
            BswMSwcModeInitValue: BswMSwcModeInitValueRef=SDC_CEG_REQUESTED
        SDC_SdStateChange_S_SdServerService_0xC3C0_FaultInfo_EH_SdEventHandler_0xC3C0_FaultInfo (BswMRule):
          BswMNestedExecutionOnly = false
          BswMRuleId = 26
          BswMRuleInitState = BSWM_FALSE
          BswMRuleExpressionRef = SDC_S_SdServerService_0xC3C0_FaultInfo_EH_SdEventHandler_0xC3C0_FaultInfoIsRequested
          BswMRuleFalseActionList = SDC_AL_SdRelease_S_SdServerService_0xC3C0_FaultInfo_EH_SdEventHandler_0xC3C0_FaultInfo
          BswMRuleTrueActionList = SDC_AL_SdRequest_S_SdServerService_0xC3C0_FaultInfo_EH_SdEventHandler_0xC3C0_FaultInfo
        SDC_S_SdServerService_0xC3C0_FaultInfo_EH_SdEventHandler_0xC3C0_FaultInfoIsRequested (BswMLogicalExpression):
          BswMLogicalOperator = BSWM_AND
          BswMArgumentRef = SDC_Cond_SdEHState_S_SdServerService_0xC3C0_FaultInfo_EH_SdEventHandler_0xC3C0_FaultInfo_EQ_SD_EVENT_HANDLER_REQUESTED
        SDC_Cond_SdEHState_S_SdServerService_0xC3C0_FaultInfo_EH_SdEventHandler_0xC3C0_FaultInfo_EQ_SD_EVENT_HANDLER_REQUESTED (BswMModeCondition): BswMConditionType=BSWM_EQUALS, BswMConditionMode=SDC_SdEHState_S_SdServerService_0xC3C0_FaultInfo_EH_SdEventHandler_0xC3C0_FaultInfo
          BswMConditionValue
            BswMBswMode: BswMBswRequestedMode=SD_EVENT_HANDLER_REQUESTED
        SDC_SdEHState_S_SdServerService_0xC3C0_FaultInfo_EH_SdEventHandler_0xC3C0_FaultInfo (BswMModeRequestPort): BswMArbitrateOnInit=false, BswMRequestProcessing=BSWM_DEFERRED
          BswMModeRequestSource
            BswMSdEventHandlerCurrentState: BswMSdEventHandlerRef=SdEventHandler_0xC3C0_FaultInfo
          BswMModeInitValue
            BswMBswModeInitValue: BswMBswModeInitValueMode=SD_EVENT_HANDLER_RELEASED
        SDC_ApplRequest_C_SdClientService_0xC3CC_VechicleStatus (BswMRule):
          BswMNestedExecutionOnly = false
          BswMRuleId = 13
          BswMRuleInitState = BSWM_TRUE
          BswMRuleExpressionRef = SDC_LE_ApplRequest_C_SdClientService_0xC3CC_VechicleStatus
          BswMRuleFalseActionList = SDC_AL_ApplRelease_C_SdClientService_0xC3CC_VechicleStatus
          BswMRuleTrueActionList = SDC_AL_ApplRequest_C_SdClientService_0xC3CC_VechicleStatus
        SDC_LE_ApplRequest_C_SdClientService_0xC3CC_VechicleStatus (BswMLogicalExpression): BswMLogicalOperator=BSWM_AND, BswMArgumentRef=SDC_Cond_C_SdClientService_0xC3CC_VechicleStatus_EQ_SDC_CLIENT_REQUESTED
        SDC_Cond_C_SdClientService_0xC3CC_VechicleStatus_EQ_SDC_CLIENT_REQUESTED (BswMModeCondition): BswMConditionType=BSWM_EQUALS, BswMConditionMode=SDC_C_SdClientService_0xC3CC_VechicleStatus
          BswMConditionValue
            BswMModeDeclaration: BswMModeValueRef=SDC_CLIENT_REQUESTED
        SDC_C_SdClientService_0xC3CC_VechicleStatus (BswMModeRequestPort): BswMArbitrateOnInit=false, BswMRequestProcessing=BSWM_DEFERRED
          BswMModeRequestSource
            BswMSwcModeRequest: BswMModeRequestDataElementPrototypeName=requestedMode, BswMSwcModeRequestModeDeclarationGroupPrototypeRef=BswM_MDGP_SDC_SdClientServiceRequest
          BswMModeInitValue
            BswMSwcModeInitValue: BswMSwcModeInitValueRef=SDC_CLIENT_REQUESTED
        SDC_ApplRequest_S_SdServerService_0xC3C0_FaultInfo (BswMRule):
          BswMNestedExecutionOnly = false
          BswMRuleId = 17
          BswMRuleInitState = BSWM_TRUE
          BswMRuleExpressionRef = SDC_LE_ApplRequest_S_SdServerService_0xC3C0_FaultInfo
          BswMRuleFalseActionList = SDC_AL_ApplRelease_S_SdServerService_0xC3C0_FaultInfo
          BswMRuleTrueActionList = SDC_AL_ApplRequest_S_SdServerService_0xC3C0_FaultInfo
        SDC_LE_ApplRequest_S_SdServerService_0xC3C0_FaultInfo (BswMLogicalExpression): BswMLogicalOperator=BSWM_AND, BswMArgumentRef=SDC_Cond_S_SdServerService_0xC3C0_FaultInfo_EQ_SDC_SERVER_AVAILABE
        SDC_Cond_S_SdServerService_0xC3C0_FaultInfo_EQ_SDC_SERVER_AVAILABE (BswMModeCondition): BswMConditionType=BSWM_EQUALS, BswMConditionMode=SDC_S_SdServerService_0xC3C0_FaultInfo
          BswMConditionValue
            BswMModeDeclaration: BswMModeValueRef=SDC_SERVER_AVAILABE
        SDC_S_SdServerService_0xC3C0_FaultInfo (BswMModeRequestPort): BswMArbitrateOnInit=false, BswMRequestProcessing=BSWM_DEFERRED
          BswMModeRequestSource
            BswMSwcModeRequest: BswMModeRequestDataElementPrototypeName=requestedMode, BswMSwcModeRequestModeDeclarationGroupPrototypeRef=BswM_MDGP_SDC_SdServerServiceRequest
          BswMModeInitValue
            BswMSwcModeInitValue: BswMSwcModeInitValueRef=SDC_SERVER_AVAILABE
        SDC_ApplRequest_S_SdServerService_0xC3C1_SenState (BswMRule):
          BswMNestedExecutionOnly = false
          BswMRuleId = 18
          BswMRuleInitState = BSWM_TRUE
          BswMRuleExpressionRef = SDC_LE_ApplRequest_S_SdServerService_0xC3C1_SenState
          BswMRuleFalseActionList = SDC_AL_ApplRelease_S_SdServerService_0xC3C1_SenState
          BswMRuleTrueActionList = SDC_AL_ApplRequest_S_SdServerService_0xC3C1_SenState
        SDC_LE_ApplRequest_S_SdServerService_0xC3C1_SenState (BswMLogicalExpression): BswMLogicalOperator=BSWM_AND, BswMArgumentRef=SDC_Cond_S_SdServerService_0xC3C1_SenState_EQ_SDC_SERVER_AVAILABE
        SDC_Cond_S_SdServerService_0xC3C1_SenState_EQ_SDC_SERVER_AVAILABE (BswMModeCondition): BswMConditionType=BSWM_EQUALS, BswMConditionMode=SDC_S_SdServerService_0xC3C1_SenState
          BswMConditionValue
            BswMModeDeclaration: BswMModeValueRef=SDC_SERVER_AVAILABE
        SDC_S_SdServerService_0xC3C1_SenState (BswMModeRequestPort): BswMArbitrateOnInit=false, BswMRequestProcessing=BSWM_DEFERRED
          BswMModeRequestSource
            BswMSwcModeRequest: BswMModeRequestDataElementPrototypeName=requestedMode, BswMSwcModeRequestModeDeclarationGroupPrototypeRef=BswM_MDGP_SDC_SdServerServiceRequest
          BswMModeInitValue
            BswMSwcModeInitValue: BswMSwcModeInitValueRef=SDC_SERVER_AVAILABE
        SDC_SdStateChange_C_SdClientService_0xC3CC_VechicleStatus (BswMRule):
          BswMNestedExecutionOnly = false
          BswMRuleId = 22
          BswMRuleInitState = BSWM_FALSE
          BswMRuleExpressionRef = SDC_C_SdClientService_0xC3CC_VechicleStatusIsAvailable
          BswMRuleFalseActionList = SDC_AL_SdDown_C_SdClientService_0xC3CC_VechicleStatus_DOWN
          BswMRuleTrueActionList = SDC_AL_SdAvailable_C_SdClientService_0xC3CC_VechicleStatus_AVAILABLE
        SDC_C_SdClientService_0xC3CC_VechicleStatusIsAvailable (BswMLogicalExpression): BswMLogicalOperator=BSWM_AND, BswMArgumentRef=SDC_Cond_SdClientState_C_SdClientService_0xC3CC_VechicleStatus_EQ_SD_CLIENT_SERVICE_AVAILABLE
        SDC_Cond_SdClientState_C_SdClientService_0xC3CC_VechicleStatus_EQ_SD_CLIENT_SERVICE_AVAILABLE (BswMModeCondition): BswMConditionType=BSWM_EQUALS, BswMConditionMode=SDC_SdClientState_C_SdClientService_0xC3CC_VechicleStatus
          BswMConditionValue
            BswMBswMode: BswMBswRequestedMode=SD_CLIENT_SERVICE_AVAILABLE
        SDC_SdClientState_C_SdClientService_0xC3CC_VechicleStatus (BswMModeRequestPort): BswMArbitrateOnInit=false, BswMRequestProcessing=BSWM_DEFERRED
          BswMModeRequestSource
            BswMSdClientServiceCurrentState: BswMSdClientMethodsRef=SdClientService_0xC3CC_VechicleStatus
          BswMModeInitValue
            BswMBswModeInitValue: BswMBswModeInitValueMode=SD_CLIENT_SERVICE_DOWN
        SDC_ApplRequest_C_SdClientService_0xC3CD_VechicleInfo (BswMRule):
          BswMNestedExecutionOnly = false
          BswMRuleId = 15
          BswMRuleInitState = BSWM_FALSE
          BswMRuleExpressionRef = SDC_LE_ApplRequest_C_SdClientService_0xC3CD_VechicleInfo
          BswMRuleFalseActionList = SDC_AL_ApplRelease_C_SdClientService_0xC3CD_VechicleInfo
          BswMRuleTrueActionList = SDC_AL_ApplRequest_C_SdClientService_0xC3CD_VechicleInfo
        SDC_LE_ApplRequest_C_SdClientService_0xC3CD_VechicleInfo (BswMLogicalExpression): BswMLogicalOperator=BSWM_AND, BswMArgumentRef=SDC_Cond_C_SdClientService_0xC3CD_VechicleInfo_EQ_SDC_CLIENT_REQUESTED
        SDC_Cond_C_SdClientService_0xC3CD_VechicleInfo_EQ_SDC_CLIENT_REQUESTED (BswMModeCondition): BswMConditionType=BSWM_EQUALS, BswMConditionMode=SDC_C_SdClientService_0xC3CD_VechicleInfo
          BswMConditionValue
            BswMModeDeclaration: BswMModeValueRef=SDC_CLIENT_REQUESTED
        SDC_C_SdClientService_0xC3CD_VechicleInfo (BswMModeRequestPort): BswMArbitrateOnInit=false, BswMRequestProcessing=BSWM_DEFERRED
          BswMModeRequestSource
            BswMSwcModeRequest: BswMModeRequestDataElementPrototypeName=requestedMode, BswMSwcModeRequestModeDeclarationGroupPrototypeRef=BswM_MDGP_SDC_SdClientServiceRequest
          BswMModeInitValue
            BswMSwcModeInitValue: BswMSwcModeInitValueRef=SDC_CLIENT_RELEASED
        SDC_ApplRequest_C_SdClientService_0xC3CC_VechicleStatus_CEG_SdConsumedEventGroup_0xC3CC_VechicleStatus (BswMRule):
          BswMNestedExecutionOnly = false
          BswMRuleId = 14
          BswMRuleInitState = BSWM_TRUE
          BswMRuleExpressionRef = SDC_LE_ApplRequest_C_SdClientService_0xC3CC_VechicleStatus_CEG_SdConsumedEventGroup_0xC3CC_VechicleStatus
          BswMRuleFalseActionList = SDC_AL_ApplRelease_C_SdClientService_0xC3CC_VechicleStatus_CEG_SdConsumedEventGroup_0xC3CC_VechicleStatus
          BswMRuleTrueActionList = SDC_AL_ApplRequest_C_SdClientService_0xC3CC_VechicleStatus_CEG_SdConsumedEventGroup_0xC3CC_VechicleStatus
        SDC_LE_ApplRequest_C_SdClientService_0xC3CC_VechicleStatus_CEG_SdConsumedEventGroup_0xC3CC_VechicleStatus (BswMLogicalExpression):
          BswMLogicalOperator = BSWM_AND
          BswMArgumentRef = SDC_Cond_C_SdClientService_0xC3CC_VechicleStatus_CEG_SdConsumedEventGroup_0xC3CC_VechicleStatus_EQ_SDC_CEG_REQUESTED
        SDC_Cond_C_SdClientService_0xC3CC_VechicleStatus_CEG_SdConsumedEventGroup_0xC3CC_VechicleStatus_EQ_SDC_CEG_REQUESTED (BswMModeCondition): BswMConditionType=BSWM_EQUALS, BswMConditionMode=SDC_C_SdClientService_0xC3CC_VechicleStatus_CEG_SdConsumedEventGroup_0xC3CC_VechicleStatus
          BswMConditionValue
            BswMModeDeclaration: BswMModeValueRef=SDC_CEG_REQUESTED
        SDC_C_SdClientService_0xC3CC_VechicleStatus_CEG_SdConsumedEventGroup_0xC3CC_VechicleStatus (BswMModeRequestPort): BswMArbitrateOnInit=false, BswMRequestProcessing=BSWM_DEFERRED
          BswMModeRequestSource
            BswMSwcModeRequest:
              BswMModeRequestDataElementPrototypeName = requestedMode
              BswMSwcModeRequestModeDeclarationGroupPrototypeRef = BswM_MDGP_SDC_SdConsumedEventGroupRequest
          BswMModeInitValue
            BswMSwcModeInitValue: BswMSwcModeInitValueRef=SDC_CEG_REQUESTED
        SDC_SdStateChange_C_SdClientService_0xC3CD_VechicleInfo_CEG_SdConsumedEventGroup_0xC3CD_VechicleInfo (BswMRule):
          BswMNestedExecutionOnly = false
          BswMRuleId = 25
          BswMRuleInitState = BSWM_FALSE
          BswMRuleExpressionRef = SDC_C_SdClientService_0xC3CD_VechicleInfo_CEG_SdConsumedEventGroup_0xC3CD_VechicleInfoIsAvailable
          BswMRuleFalseActionList = SDC_AL_SdDown_C_SdClientService_0xC3CD_VechicleInfo_CEG_SdConsumedEventGroup_0xC3CD_VechicleInfo_DOWN
          BswMRuleTrueActionList = SDC_AL_SdAvailable_C_SdClientService_0xC3CD_VechicleInfo_CEG_SdConsumedEventGroup_0xC3CD_VechicleInfo_AVAILABLE
        SDC_C_SdClientService_0xC3CD_VechicleInfo_CEG_SdConsumedEventGroup_0xC3CD_VechicleInfoIsAvailable (BswMLogicalExpression):
          BswMLogicalOperator = BSWM_AND
          BswMArgumentRef = SDC_Cond_SdCEGState_C_SdClientService_0xC3CD_VechicleInfo_CEG_SdConsumedEventGroup_0xC3CD_VechicleInfo_EQ_SD_CONSUMED_E_0bd2b71b
        SDC_Cond_SdCEGState_C_SdClientService_0xC3CD_VechicleInfo_CEG_SdConsumedEventGroup_0xC3CD_VechicleInfo_EQ_SD_CONSUMED_E_0bd2b71b (BswMModeCondition):
          BswMConditionType = BSWM_EQUALS
          BswMConditionMode = SDC_SdCEGState_C_SdClientService_0xC3CD_VechicleInfo_CEG_SdConsumedEventGroup_0xC3CD_VechicleInfo
          BswMConditionValue
            BswMBswMode: BswMBswRequestedMode=SD_CONSUMED_EVENTGROUP_AVAILABLE
        SDC_SdCEGState_C_SdClientService_0xC3CD_VechicleInfo_CEG_SdConsumedEventGroup_0xC3CD_VechicleInfo (BswMModeRequestPort): BswMArbitrateOnInit=false, BswMRequestProcessing=BSWM_DEFERRED
          BswMModeRequestSource
            BswMSdConsumedEventGroupCurrentState: BswMSdConsumedEventGroupRef=SdConsumedEventGroup_0xC3CD_VechicleInfo
          BswMModeInitValue
            BswMBswModeInitValue: BswMBswModeInitValueMode=SD_CONSUMED_EVENTGROUP_DOWN
        SDC_ApplRequest_S_SdServerService_0xC3C2_EcuState (BswMRule):
          BswMNestedExecutionOnly = false
          BswMRuleId = 19
          BswMRuleInitState = BSWM_TRUE
          BswMRuleExpressionRef = SDC_LE_ApplRequest_S_SdServerService_0xC3C2_EcuState
          BswMRuleFalseActionList = SDC_AL_ApplRelease_S_SdServerService_0xC3C2_EcuState
          BswMRuleTrueActionList = SDC_AL_ApplRequest_S_SdServerService_0xC3C2_EcuState
        SDC_LE_ApplRequest_S_SdServerService_0xC3C2_EcuState (BswMLogicalExpression): BswMLogicalOperator=BSWM_AND, BswMArgumentRef=SDC_Cond_S_SdServerService_0xC3C2_EcuState_EQ_SDC_SERVER_AVAILABE
        SDC_Cond_S_SdServerService_0xC3C2_EcuState_EQ_SDC_SERVER_AVAILABE (BswMModeCondition): BswMConditionType=BSWM_EQUALS, BswMConditionMode=SDC_S_SdServerService_0xC3C2_EcuState
          BswMConditionValue
            BswMModeDeclaration: BswMModeValueRef=SDC_SERVER_AVAILABE
        SDC_S_SdServerService_0xC3C2_EcuState (BswMModeRequestPort): BswMArbitrateOnInit=false, BswMRequestProcessing=BSWM_DEFERRED
          BswMModeRequestSource
            BswMSwcModeRequest: BswMModeRequestDataElementPrototypeName=requestedMode, BswMSwcModeRequestModeDeclarationGroupPrototypeRef=BswM_MDGP_SDC_SdServerServiceRequest
          BswMModeInitValue
            BswMSwcModeInitValue: BswMSwcModeInitValueRef=SDC_SERVER_AVAILABE
        SDC_SdStateChange_S_SdServerService_0xC3C2_EcuState_EH_SdEventHandler_0xC3C2_EcuState (BswMRule):
          BswMNestedExecutionOnly = false
          BswMRuleId = 28
          BswMRuleInitState = BSWM_FALSE
          BswMRuleExpressionRef = SDC_S_SdServerService_0xC3C2_EcuState_EH_SdEventHandler_0xC3C2_EcuStateIsRequested
          BswMRuleFalseActionList = SDC_AL_SdRelease_S_SdServerService_0xC3C2_EcuState_EH_SdEventHandler_0xC3C2_EcuState
          BswMRuleTrueActionList = SDC_AL_SdRequest_S_SdServerService_0xC3C2_EcuState_EH_SdEventHandler_0xC3C2_EcuState
        SDC_S_SdServerService_0xC3C2_EcuState_EH_SdEventHandler_0xC3C2_EcuStateIsRequested (BswMLogicalExpression):
          BswMLogicalOperator = BSWM_AND
          BswMArgumentRef = SDC_Cond_SdEHState_S_SdServerService_0xC3C2_EcuState_EH_SdEventHandler_0xC3C2_EcuState_EQ_SD_EVENT_HANDLER_REQUESTED
        SDC_Cond_SdEHState_S_SdServerService_0xC3C2_EcuState_EH_SdEventHandler_0xC3C2_EcuState_EQ_SD_EVENT_HANDLER_REQUESTED (BswMModeCondition): BswMConditionType=BSWM_EQUALS, BswMConditionMode=SDC_SdEHState_S_SdServerService_0xC3C2_EcuState_EH_SdEventHandler_0xC3C2_EcuState
          BswMConditionValue
            BswMBswMode: BswMBswRequestedMode=SD_EVENT_HANDLER_REQUESTED
        SDC_SdEHState_S_SdServerService_0xC3C2_EcuState_EH_SdEventHandler_0xC3C2_EcuState (BswMModeRequestPort): BswMArbitrateOnInit=false, BswMRequestProcessing=BSWM_DEFERRED
          BswMModeRequestSource
            BswMSdEventHandlerCurrentState: BswMSdEventHandlerRef=SdEventHandler_0xC3C2_EcuState
          BswMModeInitValue
            BswMBswModeInitValue: BswMBswModeInitValueMode=SD_EVENT_HANDLER_RELEASED
        SDC_ApplRequest_C_SdClientService_0xC3CD_VechicleInfo_CEG_SdConsumedEventGroup_0xC3CD_VechicleInfo (BswMRule):
          BswMNestedExecutionOnly = false
          BswMRuleId = 16
          BswMRuleInitState = BSWM_TRUE
          BswMRuleExpressionRef = SDC_LE_ApplRequest_C_SdClientService_0xC3CD_VechicleInfo_CEG_SdConsumedEventGroup_0xC3CD_VechicleInfo
          BswMRuleFalseActionList = SDC_AL_ApplRelease_C_SdClientService_0xC3CD_VechicleInfo_CEG_SdConsumedEventGroup_0xC3CD_VechicleInfo
          BswMRuleTrueActionList = SDC_AL_ApplRequest_C_SdClientService_0xC3CD_VechicleInfo_CEG_SdConsumedEventGroup_0xC3CD_VechicleInfo
        SDC_LE_ApplRequest_C_SdClientService_0xC3CD_VechicleInfo_CEG_SdConsumedEventGroup_0xC3CD_VechicleInfo (BswMLogicalExpression):
          BswMLogicalOperator = BSWM_AND
          BswMArgumentRef = SDC_Cond_C_SdClientService_0xC3CD_VechicleInfo_CEG_SdConsumedEventGroup_0xC3CD_VechicleInfo_EQ_SDC_CEG_REQUESTED
        SDC_Cond_C_SdClientService_0xC3CD_VechicleInfo_CEG_SdConsumedEventGroup_0xC3CD_VechicleInfo_EQ_SDC_CEG_REQUESTED (BswMModeCondition): BswMConditionType=BSWM_EQUALS, BswMConditionMode=SDC_C_SdClientService_0xC3CD_VechicleInfo_CEG_SdConsumedEventGroup_0xC3CD_VechicleInfo
          BswMConditionValue
            BswMModeDeclaration: BswMModeValueRef=SDC_CEG_REQUESTED
        SDC_C_SdClientService_0xC3CD_VechicleInfo_CEG_SdConsumedEventGroup_0xC3CD_VechicleInfo (BswMModeRequestPort): BswMArbitrateOnInit=false, BswMRequestProcessing=BSWM_DEFERRED
          BswMModeRequestSource
            BswMSwcModeRequest:
              BswMModeRequestDataElementPrototypeName = requestedMode
              BswMSwcModeRequestModeDeclarationGroupPrototypeRef = BswM_MDGP_SDC_SdConsumedEventGroupRequest
          BswMModeInitValue
            BswMSwcModeInitValue: BswMSwcModeInitValueRef=SDC_CEG_REQUESTED
      BswMModeControl: BswMInitActionListRef=INIT_AL_Initialize
        ESH_AL_RunToPostRun (BswMActionList): BswMActionListExecution=BSWM_CONDITION
          7 x BswMActionListItem, all with BswMAbortOnFail=false:
            ESH_Action_EcuMClearValidatedWakeupEvents: BswMActionListItemIndex=3, BswMActionListItemRef=BswMModeControl/ESH_Action_EcuMClearValidatedWakeupEvents
            ESH_Action_OnEnterPostRun: BswMActionListItemIndex=4, BswMActionListItemRef=BswMModeControl/ESH_Action_OnEnterPostRun
            ESH_Action_SwitchPostRun: BswMActionListItemIndex=5, BswMActionListItemRef=BswMModeControl/ESH_Action_SwitchPostRun
            ESH_Action_ESH_PostRun: BswMActionListItemIndex=6, BswMActionListItemRef=BswMModeControl/ESH_Action_ESH_PostRun
            ESH_Action_ComMDisallow_ComMChannel_untagged: BswMActionListItemIndex=0, BswMActionListItemRef=BswMModeControl/ESH_Action_ComMDisallow_ComMChannel_untagged
            ESH_Action_ComMDisallow_ComMChannel_Vlan1: BswMActionListItemIndex=1, BswMActionListItemRef=BswMModeControl/ESH_Action_ComMDisallow_ComMChannel_Vlan1
            ESH_Action_ComMDisallow_ComMChannel_Vlan23: BswMActionListItemIndex=2, BswMActionListItemRef=BswMModeControl/ESH_Action_ComMDisallow_ComMChannel_Vlan23
        3 x BswMAction:
          ESH_Action_EcuMClearValidatedWakeupEvents
            BswMAvailableActions
              BswMUserCallout: BswMUserCalloutFunction=EcuM_ClearValidatedWakeupEvent(ECUM_WKSOURCE_ALL_SOURCES), BswMCreateCallout=false, BswMUserIncludeFile=EcuM.h
          ESH_Action_OnEnterPostRun
            BswMAvailableActions
              BswMUserCallout: BswMUserCalloutFunction=BswM_ESH_OnEnterPostRun(), BswMCreateCallout=true
          ESH_Action_SwitchPostRun
            BswMAvailableActions
              BswMRteSwitch: BswMSwitchedMode=POSTRUN, BswMRteSwitchPortRef=ESH_ModeSwitch
        ESH_ModeSwitch (BswMSwitchPort): BswMModeSwitchInterfaceRef=BswM_MSI_ESH_Mode
        ESH_Action_ESH_PostRun (BswMAction)
          BswMAvailableActions
            BswMGenericModeSwitch: BswMGenericRequestRef=ESH_State, BswMGenericRequestModeRef=ESH_POST_RUN
        ESH_AL_WaitForNvMToShutdown (BswMActionList): BswMActionListExecution=BSWM_CONDITION
          ESH_Action_OnEnterShutdown (BswMActionListItem): BswMAbortOnFail=false, BswMActionListItemIndex=0, BswMActionListItemRef=BswMModeControl/ESH_Action_OnEnterShutdown
          ESH_Action_EcuMGoToSelectedShutdownTarget (BswMActionListItem): BswMAbortOnFail=false, BswMActionListItemIndex=1, BswMActionListItemRef=BswMModeControl/ESH_Action_EcuMGoToSelectedShutdownTarget
        ESH_Action_OnEnterShutdown (BswMAction)
          BswMAvailableActions
            BswMUserCallout: BswMUserCalloutFunction=BswM_ESH_OnEnterShutdown(), BswMCreateCallout=true
        ESH_Action_EcuMGoToSelectedShutdownTarget (BswMAction)
          BswMAvailableActions
            BswMUserCallout: BswMUserCalloutFunction=(void)EcuM_GoToSelectedShutdownTarget(), BswMCreateCallout=false, BswMUserIncludeFile=EcuM.h
        ESH_AL_WakeupToPrep (BswMActionList): BswMActionListExecution=BSWM_CONDITION
          3 x BswMActionListItem, all with BswMAbortOnFail=false:
            ESH_Action_OnEnterPrepShutdown: BswMActionListItemIndex=0, BswMActionListItemRef=BswMModeControl/ESH_Action_OnEnterPrepShutdown
            ESH_Action_SwitchShutdown: BswMActionListItemIndex=1, BswMActionListItemRef=BswMModeControl/ESH_Action_SwitchShutdown
            ESH_Action_ESH_PrepShutdown: BswMActionListItemIndex=2, BswMActionListItemRef=BswMModeControl/ESH_Action_ESH_PrepShutdown
        3 x BswMAction:
          ESH_Action_OnEnterPrepShutdown
            BswMAvailableActions
              BswMUserCallout: BswMUserCalloutFunction=BswM_ESH_OnEnterPrepShutdown(), BswMCreateCallout=true
          ESH_Action_SwitchShutdown
            BswMAvailableActions
              BswMRteSwitch: BswMSwitchedMode=SHUTDOWN, BswMRteSwitchPortRef=ESH_ModeSwitch
          ESH_Action_ESH_PrepShutdown
            BswMAvailableActions
              BswMGenericModeSwitch: BswMGenericRequestRef=ESH_State, BswMGenericRequestModeRef=ESH_PREP_SHUTDOWN
        ESH_AL_WaitForNvMWakeup (BswMActionList): BswMActionListExecution=BSWM_CONDITION
          3 x BswMActionListItem, all with BswMAbortOnFail=false:
            ESH_Action_OnEnterWakeup: BswMActionListItemIndex=0, BswMActionListItemRef=BswMModeControl/ESH_Action_OnEnterWakeup
            ESH_Action_SwitchWakeup: BswMActionListItemIndex=1, BswMActionListItemRef=BswMModeControl/ESH_Action_SwitchWakeup
            ESH_Action_ESH_Wakeup: BswMActionListItemIndex=2, BswMActionListItemRef=BswMModeControl/ESH_Action_ESH_Wakeup
        3 x BswMAction:
          ESH_Action_OnEnterWakeup
            BswMAvailableActions
              BswMUserCallout: BswMUserCalloutFunction=BswM_ESH_OnEnterWakeup(), BswMCreateCallout=true
          ESH_Action_SwitchWakeup
            BswMAvailableActions
              BswMRteSwitch: BswMSwitchedMode=WAKEUP, BswMRteSwitchPortRef=ESH_ModeSwitch
          ESH_Action_ESH_Wakeup
            BswMAvailableActions
              BswMGenericModeSwitch: BswMGenericRequestRef=ESH_State, BswMGenericRequestModeRef=ESH_WAKEUP
        ESH_AL_WakeupToRun (BswMActionList): BswMActionListExecution=BSWM_CONDITION
          7 x BswMActionListItem, all with BswMAbortOnFail=false:
            ESH_Action_SelfRunRequestTimer_Start: BswMActionListItemIndex=3, BswMActionListItemRef=BswMModeControl/ESH_Action_SelfRunRequestTimer_Start
            ESH_Action_OnEnterRun: BswMActionListItemIndex=4, BswMActionListItemRef=BswMModeControl/ESH_Action_OnEnterRun
            ESH_Action_SwitchRun: BswMActionListItemIndex=5, BswMActionListItemRef=BswMModeControl/ESH_Action_SwitchRun
            ESH_Action_ESH_Run: BswMActionListItemIndex=6, BswMActionListItemRef=BswMModeControl/ESH_Action_ESH_Run
            ESH_Action_ComMAllow_ComMChannel_untagged: BswMActionListItemIndex=0, BswMActionListItemRef=BswMModeControl/ESH_Action_ComMAllow_ComMChannel_untagged
            ESH_Action_ComMAllow_ComMChannel_Vlan1: BswMActionListItemIndex=1, BswMActionListItemRef=BswMModeControl/ESH_Action_ComMAllow_ComMChannel_Vlan1
            ESH_Action_ComMAllow_ComMChannel_Vlan23: BswMActionListItemIndex=2, BswMActionListItemRef=BswMModeControl/ESH_Action_ComMAllow_ComMChannel_Vlan23
        4 x BswMAction:
          ESH_Action_SelfRunRequestTimer_Start
            BswMAvailableActions
              BswMTimerControl: BswMTimerAction=BSWM_TIMER_START, BswMTimerValue=0.1, BswMTimerRef=ESH_SelfRunRequestTimer
          ESH_Action_OnEnterRun
            BswMAvailableActions
              BswMUserCallout: BswMUserCalloutFunction=BswM_ESH_OnEnterRun(), BswMCreateCallout=true
          ESH_Action_SwitchRun
            BswMAvailableActions
              BswMRteSwitch: BswMSwitchedMode=RUN, BswMRteSwitchPortRef=ESH_ModeSwitch
          ESH_Action_ESH_Run
            BswMAvailableActions
              BswMGenericModeSwitch: BswMGenericRequestRef=ESH_State, BswMGenericRequestModeRef=ESH_RUN
        6 x BswMActionList, all with BswMActionListExecution=BSWM_CONDITION:
          ESH_AL_InitToWakeup
            3 x BswMActionListItem, all with BswMAbortOnFail=false:
              ESH_Action_OnEnterWakeup: BswMActionListItemIndex=0, BswMActionListItemRef=BswMModeControl/ESH_Action_OnEnterWakeup
              ESH_Action_SwitchWakeup: BswMActionListItemIndex=1, BswMActionListItemRef=BswMModeControl/ESH_Action_SwitchWakeup
              ESH_Action_ESH_Wakeup: BswMActionListItemIndex=2, BswMActionListItemRef=BswMModeControl/ESH_Action_ESH_Wakeup
          ESH_AL_PostRunToPrepShutdown
            3 x BswMActionListItem, all with BswMAbortOnFail=false:
              ESH_Action_OnEnterPrepShutdown: BswMActionListItemIndex=0, BswMActionListItemRef=BswMModeControl/ESH_Action_OnEnterPrepShutdown
              ESH_Action_SwitchShutdown: BswMActionListItemIndex=1, BswMActionListItemRef=BswMModeControl/ESH_Action_SwitchShutdown
              ESH_Action_ESH_PrepShutdown: BswMActionListItemIndex=2, BswMActionListItemRef=BswMModeControl/ESH_Action_ESH_PrepShutdown
          ESH_AL_ESH_PostRunToPrepCheck
            ESH_PostRunToPrepNested (BswMActionListItem): BswMAbortOnFail=false, BswMActionListItemIndex=0, BswMActionListItemRef=BswMArbitration/ESH_PostRunToPrepNested
          ESH_AL_PostRunToRun
            7 x BswMActionListItem, all with BswMAbortOnFail=false:
              ESH_Action_SelfRunRequestTimer_Start: BswMActionListItemIndex=3, BswMActionListItemRef=BswMModeControl/ESH_Action_SelfRunRequestTimer_Start
              ESH_Action_OnEnterRun: BswMActionListItemIndex=4, BswMActionListItemRef=BswMModeControl/ESH_Action_OnEnterRun
              ESH_Action_SwitchRun: BswMActionListItemIndex=5, BswMActionListItemRef=BswMModeControl/ESH_Action_SwitchRun
              ESH_Action_ESH_Run: BswMActionListItemIndex=6, BswMActionListItemRef=BswMModeControl/ESH_Action_ESH_Run
              ESH_Action_ComMAllow_ComMChannel_untagged: BswMActionListItemIndex=0, BswMActionListItemRef=BswMModeControl/ESH_Action_ComMAllow_ComMChannel_untagged
              ESH_Action_ComMAllow_ComMChannel_Vlan1: BswMActionListItemIndex=1, BswMActionListItemRef=BswMModeControl/ESH_Action_ComMAllow_ComMChannel_Vlan1
              ESH_Action_ComMAllow_ComMChannel_Vlan23: BswMActionListItemIndex=2, BswMActionListItemRef=BswMModeControl/ESH_Action_ComMAllow_ComMChannel_Vlan23
          ESH_AL_ExitPostRun
            4 x BswMActionListItem, all with BswMAbortOnFail=false:
              ESH_PostRunNested: BswMActionListItemIndex=2, BswMActionListItemRef=BswMArbitration/ESH_PostRunNested
              ESH_Action_EnterExclusiveArea: BswMActionListItemIndex=0, BswMActionListItemRef=BswMModeControl/ESH_Action_EnterExclusiveArea
              ESH_Action_ComMCheckPendingRequests: BswMActionListItemIndex=1, BswMActionListItemRef=BswMModeControl/ESH_Action_ComMCheckPendingRequests
              ESH_Action_ExitExclusiveArea: BswMActionListItemIndex=3, BswMActionListItemRef=BswMModeControl/ESH_Action_ExitExclusiveArea
          ESH_AL_PrepShutdownToWaitForNvM
            3 x BswMActionListItem, all with BswMAbortOnFail=false:
              ESH_Action_OnEnterWaitForNvm: BswMActionListItemIndex=1, BswMActionListItemRef=BswMModeControl/ESH_Action_OnEnterWaitForNvm
              ESH_Action_ESH_WaitForNvm: BswMActionListItemIndex=2, BswMActionListItemRef=BswMModeControl/ESH_Action_ESH_WaitForNvm
              ESH_Action_ComMCheckPendingRequests: BswMActionListItemIndex=0, BswMActionListItemRef=BswMModeControl/ESH_Action_ComMCheckPendingRequests
        ESH_Action_OnEnterWaitForNvm (BswMAction)
          BswMAvailableActions
            BswMUserCallout: BswMUserCalloutFunction=BswM_ESH_OnEnterWaitForNvm(), BswMCreateCallout=true
        ESH_Action_ESH_WaitForNvm (BswMAction)
          BswMAvailableActions
            BswMGenericModeSwitch: BswMGenericRequestRef=ESH_State, BswMGenericRequestModeRef=ESH_WAIT_FOR_NVM
        INIT_AL_Initialize (BswMActionList): BswMActionListExecution=BSWM_CONDITION
          19 x BswMActionListItem, all with BswMAbortOnFail=false:
            INIT_Action_EnableInterrupts: BswMActionListItemIndex=14, BswMActionListItemRef=BswMModeControl/INIT_Action_EnableInterrupts
            INIT_Action_Rte_Start: BswMActionListItemIndex=15, BswMActionListItemRef=BswMModeControl/INIT_Action_Rte_Start
            INIT_Action_EthTrcv_30_Tja1100_Init: BswMActionListItemIndex=1, BswMActionListItemRef=BswMModeControl/INIT_Action_EthTrcv_30_Tja1100_Init
            INIT_Action_Eth_30_Tc3xx_init: BswMActionListItemIndex=2, BswMActionListItemRef=BswMModeControl/INIT_Action_Eth_30_Tc3xx_init
            INIT_Action_Com_Init: BswMActionListItemIndex=5, BswMActionListItemRef=BswMModeControl/INIT_Action_Com_Init
            INIT_Action_ComM_Init: BswMActionListItemIndex=16, BswMActionListItemRef=BswMModeControl/INIT_Action_ComM_Init
            INIT_Action_EthIf_Init: BswMActionListItemIndex=3, BswMActionListItemRef=BswMModeControl/INIT_Action_EthIf_Init
            INIT_Action_EthSM_Init: BswMActionListItemIndex=8, BswMActionListItemRef=BswMModeControl/INIT_Action_EthSM_Init
            INIT_Action_EthTsyn_Init: BswMActionListItemIndex=11, BswMActionListItemRef=BswMModeControl/INIT_Action_EthTsyn_Init
            INIT_Action_Pdur_Init: BswMActionListItemIndex=7, BswMActionListItemRef=BswMModeControl/INIT_Action_Pdur_Init
            INIT_Action_SoAd_Init: BswMActionListItemIndex=4, BswMActionListItemRef=BswMModeControl/INIT_Action_SoAd_Init
            INIT_Action_StbM_Init: BswMActionListItemIndex=13, BswMActionListItemRef=BswMModeControl/INIT_Action_StbM_Init
            INIT_Action_TcpIp_Init: BswMActionListItemIndex=10, BswMActionListItemRef=BswMModeControl/INIT_Action_TcpIp_Init
            INIT_Action_Det_Start: BswMActionListItemIndex=0, BswMActionListItemRef=BswMModeControl/INIT_Action_Det_Start
            INIT_Action_Debug: BswMActionListItemIndex=18, BswMActionListItemRef=BswMModeControl/INIT_Action_Debug
            INIT_Action_LdCom_Init: BswMActionListItemIndex=6, BswMActionListItemRef=BswMModeControl/INIT_Action_LdCom_Init
            INIT_Action_DoIP_Init: BswMActionListItemIndex=9, BswMActionListItemRef=BswMModeControl/INIT_Action_DoIP_Init
            INIT_Action_Dcm_Init: BswMActionListItemIndex=17, BswMActionListItemRef=BswMModeControl/INIT_Action_Dcm_Init
            INIT_Action_Sd_Init: BswMActionListItemIndex=12, BswMActionListItemRef=BswMModeControl/INIT_Action_Sd_Init
        18 x BswMAction:
          INIT_Action_EnableInterrupts
            BswMAvailableActions
              BswMUserCallout: BswMUserCalloutFunction=BswM_AL_SetProgrammableInterrupts(), BswMCreateCallout=true
          INIT_Action_Rte_Start
            BswMAvailableActions
              BswMUserCallout: BswMUserCalloutFunction=Rte_Start(), BswMCreateCallout=false, BswMUserIncludeFile=Rte_Main.h
          INIT_Action_EthTrcv_30_Tja1100_Init
            BswMAvailableActions
              BswMUserCallout:
                BswMUserCalloutFunction = EthTrcv_30_Tja1100_Init(EthTrcv_30_Tja1100_Config_Ptr)
                BswMCreateCallout = false
                BswMUserIncludeFile = EthTrcv_30_Tja1100.h
          INIT_Action_Eth_30_Tc3xx_init
            BswMAvailableActions
              BswMUserCallout: BswMUserCalloutFunction=Eth_30_Tc3xx_Init(Eth_30_Tc3xx_Config_Ptr), BswMCreateCallout=false, BswMUserIncludeFile=Eth_30_Tc3xx.h
          INIT_Action_SoAd_Init
            BswMAvailableActions
              BswMUserCallout: BswMUserCalloutFunction=SoAd_Init(SoAd_Config_Ptr), BswMCreateCallout=false, BswMUserIncludeFile=SoAd.h
          INIT_Action_EthIf_Init
            BswMAvailableActions
              BswMUserCallout: BswMUserCalloutFunction=EthIf_Init(EthIf_Config_Ptr), BswMCreateCallout=false, BswMUserIncludeFile=EthIf.h
          INIT_Action_Com_Init
            BswMAvailableActions
              BswMUserCallout: BswMUserCalloutFunction=Com_Init(Com_Config_Ptr), BswMCreateCallout=false, BswMUserIncludeFile=Com.h
          INIT_Action_Pdur_Init
            BswMAvailableActions
              BswMUserCallout: BswMUserCalloutFunction=PduR_Init(PduR_Config_Ptr), BswMCreateCallout=false, BswMUserIncludeFile=PduR.h
          INIT_Action_EthSM_Init
            BswMAvailableActions
              BswMUserCallout: BswMUserCalloutFunction=EthSM_Init(EthSM_Config_Ptr), BswMCreateCallout=false, BswMUserIncludeFile=EthSM.h
          INIT_Action_TcpIp_Init
            BswMAvailableActions
              BswMUserCallout: BswMUserCalloutFunction=TcpIp_Init(TcpIp_Config_Ptr), BswMCreateCallout=false, BswMUserIncludeFile=TcpIp.h
          INIT_Action_EthTsyn_Init
            BswMAvailableActions
              BswMUserCallout: BswMUserCalloutFunction=EthTSyn_Init(EthTSyn_Config_Ptr), BswMCreateCallout=false, BswMUserIncludeFile=EthTSyn.h
          INIT_Action_StbM_Init
            BswMAvailableActions
              BswMUserCallout: BswMUserCalloutFunction=StbM_Init(StbM_Config_Ptr), BswMCreateCallout=false, BswMUserIncludeFile=StbM.h
          INIT_Action_ComM_Init
            BswMAvailableActions
              BswMUserCallout: BswMUserCalloutFunction=ComM_Init(), BswMCreateCallout=false, BswMUserIncludeFile=ComM.h
          INIT_Action_Det_Start
            BswMAvailableActions
              BswMUserCallout: BswMUserCalloutFunction=Det_Start(), BswMCreateCallout=false, BswMUserIncludeFile=Det.h
          INIT_Action_Debug
            BswMAvailableActions
              BswMUserCallout: BswMUserCalloutFunction=BswM_Action_EthTrcvDebug(), BswMCreateCallout=true, BswMUserIncludeFile=EthTrcv_30_Tja1100_Hw_Int.h
          INIT_Action_LdCom_Init
            BswMAvailableActions
              BswMUserCallout: BswMUserCalloutFunction=LdCom_Init(LdCom_Config_Ptr), BswMCreateCallout=false, BswMUserIncludeFile=LdCom.h
          INIT_Action_DoIP_Init
            BswMAvailableActions
              BswMUserCallout: BswMUserCalloutFunction=DoIP_Init(DoIP_Config_Ptr), BswMCreateCallout=false, BswMUserIncludeFile=DoIP.h
          INIT_Action_Dcm_Init
            BswMAvailableActions
              BswMUserCallout: BswMUserCalloutFunction=Dcm_Init(NULL_PTR), BswMCreateCallout=false, BswMUserIncludeFile=Dcm.h
        ESH_AL_ExitRun (BswMActionList): BswMActionListExecution=BSWM_CONDITION
          4 x BswMActionListItem, all with BswMAbortOnFail=false:
            ESH_Action_EnterExclusiveArea: BswMActionListItemIndex=0, BswMActionListItemRef=BswMModeControl/ESH_Action_EnterExclusiveArea
            ESH_Action_ComMCheckPendingRequests: BswMActionListItemIndex=1, BswMActionListItemRef=BswMModeControl/ESH_Action_ComMCheckPendingRequests
            ESH_RunToPostRunNested: BswMActionListItemIndex=2, BswMActionListItemRef=BswMArbitration/ESH_RunToPostRunNested
            ESH_Action_ExitExclusiveArea: BswMActionListItemIndex=3, BswMActionListItemRef=BswMModeControl/ESH_Action_ExitExclusiveArea
        9 x BswMAction:
          ESH_Action_EnterExclusiveArea
            BswMAvailableActions
              BswMUserCallout: BswMUserCalloutFunction=SchM_Enter_BswM_BSWM_EXCLUSIVE_AREA_0(), BswMCreateCallout=false, BswMUserIncludeFile=SchM_BswM.h
          ESH_Action_ComMCheckPendingRequests
            BswMAvailableActions
              BswMUserCallout:
                BswMUserCalloutFunction = ESH_ComM_CheckPendingRequests()
                BswMCreateCallout = true
                BswMUserCode = ComM_StateType ComMChannel_untagged = COMM_NO_COM_NO_PENDING_REQUEST; ComM_StateType ComMChannel_Vlan1 = COMM_NO_COM_NO_PENDING_REQUEST; ComM_StateType ComMChannel_Vlan23 = COMM_NO_COM_NO_PENDING_REQUEST; (void)ComM_GetState(ComMConf_ComMChannel_ComMChannel_untagged, &ComMChannel_untagged); /* SBSW_BSWM_FCTCALL_LOCALVAR */ (void)ComM_GetState(ComMConf_ComMChannel_ComMChannel_Vlan1, &ComMChannel_Vlan1); /* SBSW_BSWM_FCTCALL_LOCALVAR */ (void)ComM_GetState(ComMConf_ComMChannel_ComMChannel_Vlan23, &ComMChannel_Vlan23); /* SBSW_BSWM_FCTCALL_LOCALVAR */ if((ComMChannel_untagged != COMM_NO_COM_NO_PENDING_REQUEST) || (ComMChannel_Vlan1 != COMM_NO_COM_NO_PENDING_REQUEST) || (ComMChannel_Vlan23 != COMM_NO_COM_NO_PENDING_REQUEST)) { BswM_RequestMode(BSWM_GENERIC_ESH_ComMPendingRequests, BSWM_GENERICVALUE_ESH_ComMPendingRequests_ESH_COMM_PENDING_REQUEST); } else { BswM_RequestMode(BSWM_GENERIC_ESH_ComMPendingRequests, BSWM_GENERICVALUE_ESH_ComMPendingRequests_ESH_COMM_NO_REQUEST); }
          ESH_Action_ComMDisallow_ComMChannel_untagged
            BswMAvailableActions
              BswMComMAllowCom: BswMComAllowed=false, BswMComMAllowChannelRef=ComMChannel_untagged
          ESH_Action_ComMDisallow_ComMChannel_Vlan1
            BswMAvailableActions
              BswMComMAllowCom: BswMComAllowed=false, BswMComMAllowChannelRef=ComMChannel_Vlan1
          ESH_Action_ExitExclusiveArea
            BswMAvailableActions
              BswMUserCallout: BswMUserCalloutFunction=SchM_Exit_BswM_BSWM_EXCLUSIVE_AREA_0(), BswMCreateCallout=false, BswMUserIncludeFile=SchM_BswM.h
          ESH_Action_ComMAllow_ComMChannel_untagged
            BswMAvailableActions
              BswMComMAllowCom: BswMComAllowed=true, BswMComMAllowChannelRef=ComMChannel_untagged
          ESH_Action_ComMAllow_ComMChannel_Vlan1
            BswMAvailableActions
              BswMComMAllowCom: BswMComAllowed=true, BswMComMAllowChannelRef=ComMChannel_Vlan1
          ESH_Action_ComMDisallow_ComMChannel_Vlan23
            BswMAvailableActions
              BswMComMAllowCom: BswMComAllowed=false, BswMComMAllowChannelRef=ComMChannel_Vlan23
          ESH_Action_ComMAllow_ComMChannel_Vlan23
            BswMAvailableActions
              BswMComMAllowCom: BswMComAllowed=true, BswMComMAllowChannelRef=ComMChannel_Vlan23
        SDC_AL_SdRelease_S_SdServerService_0xC3C1_SenState_EH_SdEventHandler_0xC3C1_SenState (BswMActionList): BswMActionListExecution=BSWM_TRIGGER
          SDC_Mode_S_SdServerService_0xC3C1_SenState_EH_SdEventHandler_0xC3C1_SenState_SDC_EH_RELEASED (BswMActionListItem):
            BswMAbortOnFail = false
            BswMActionListItemIndex = 0
            BswMActionListItemRef = BswMModeControl/SDC_Mode_S_SdServerService_0xC3C1_SenState_EH_SdEventHandler_0xC3C1_SenState_SDC_EH_RELEASED
        SDC_Mode_S_SdServerService_0xC3C1_SenState_EH_SdEventHandler_0xC3C1_SenState_SDC_EH_RELEASED (BswMAction)
          BswMAvailableActions
            BswMRteSwitch: BswMSwitchedMode=SDC_EH_RELEASED, BswMRteSwitchPortRef=SDC_Mode_S_SdServerService_0xC3C1_SenState_EH_SdEventHandler_0xC3C1_SenState
        SDC_Mode_S_SdServerService_0xC3C1_SenState_EH_SdEventHandler_0xC3C1_SenState (BswMSwitchPort): BswMModeSwitchInterfaceRef=BswM_MSI_SDC_SdEventHandlerState
        SDC_AL_SdRequest_S_SdServerService_0xC3C1_SenState_EH_SdEventHandler_0xC3C1_SenState (BswMActionList): BswMActionListExecution=BSWM_TRIGGER
          SDC_Mode_S_SdServerService_0xC3C1_SenState_EH_SdEventHandler_0xC3C1_SenState_SDC_EH_REQUESTED (BswMActionListItem):
            BswMAbortOnFail = false
            BswMActionListItemIndex = 0
            BswMActionListItemRef = BswMModeControl/SDC_Mode_S_SdServerService_0xC3C1_SenState_EH_SdEventHandler_0xC3C1_SenState_SDC_EH_REQUESTED
        SDC_Mode_S_SdServerService_0xC3C1_SenState_EH_SdEventHandler_0xC3C1_SenState_SDC_EH_REQUESTED (BswMAction)
          BswMAvailableActions
            BswMRteSwitch: BswMSwitchedMode=SDC_EH_REQUESTED, BswMRteSwitchPortRef=SDC_Mode_S_SdServerService_0xC3C1_SenState_EH_SdEventHandler_0xC3C1_SenState
        SDC_AL_ApplRelease_C_SdClientService_0xC3CB_VechicleSpeed (BswMActionList): BswMActionListExecution=BSWM_TRIGGER
          SDC_SdClientServiceModeRequetst_C_SdClientService_0xC3CB_VechicleSpeed_RELEASED (BswMActionListItem):
            BswMAbortOnFail = false
            BswMActionListItemIndex = 0
            BswMActionListItemRef = BswMModeControl/SDC_SdClientServiceModeRequetst_C_SdClientService_0xC3CB_VechicleSpeed_RELEASED
        SDC_SdClientServiceModeRequetst_C_SdClientService_0xC3CB_VechicleSpeed_RELEASED (BswMAction)
          BswMAvailableActions
            BswMSdClientServiceModeRequest: BswMSdClientServiceState=BSWM_SD_CLIENT_SERVICE_RELEASED, BswMSdClientMethodsRef=SdClientService_0xC3CB_VechicleSpeed
        SDC_AL_ApplRequest_C_SdClientService_0xC3CB_VechicleSpeed (BswMActionList): BswMActionListExecution=BSWM_TRIGGER
          SDC_SdClientServiceModeRequest_SdClientService_0xC3CB_VechicleSpeed_BSWM_SD_CLIENT_SERVICE_REQUESTED (BswMActionListItem):
            BswMAbortOnFail = false
            BswMActionListItemIndex = 0
            BswMActionListItemRef = BswMModeControl/SDC_SdClientServiceModeRequest_SdClientService_0xC3CB_VechicleSpeed_BSWM_SD_CLIENT_SERVICE_REQUESTED
        SDC_SdClientServiceModeRequest_SdClientService_0xC3CB_VechicleSpeed_BSWM_SD_CLIENT_SERVICE_REQUESTED (BswMAction)
          BswMAvailableActions
            BswMSdClientServiceModeRequest: BswMSdClientServiceState=BSWM_SD_CLIENT_SERVICE_REQUESTED, BswMSdClientMethodsRef=SdClientService_0xC3CB_VechicleSpeed
        SDC_AL_SdDown_C_SdClientService_0xC3CD_VechicleInfo_DOWN (BswMActionList): BswMActionListExecution=BSWM_TRIGGER
          SDC_Mode_C_SdClientService_0xC3CD_VechicleInfo_SDC_CLIENT_DOWN (BswMActionListItem):
            BswMAbortOnFail = false
            BswMActionListItemIndex = 0
            BswMActionListItemRef = BswMModeControl/SDC_Mode_C_SdClientService_0xC3CD_VechicleInfo_SDC_CLIENT_DOWN
        SDC_Mode_C_SdClientService_0xC3CD_VechicleInfo_SDC_CLIENT_DOWN (BswMAction)
          BswMAvailableActions
            BswMRteSwitch: BswMSwitchedMode=SDC_CLIENT_DOWN, BswMRteSwitchPortRef=SDC_Mode_C_SdClientService_0xC3CD_VechicleInfo
        SDC_Mode_C_SdClientService_0xC3CD_VechicleInfo (BswMSwitchPort): BswMModeSwitchInterfaceRef=BswM_MSI_SDC_SdClientServiceState
        SDC_AL_SdAvailable_C_SdClientService_0xC3CD_VechicleInfo_AVAILABLE (BswMActionList): BswMActionListExecution=BSWM_TRIGGER
          SDC_Mode_C_SdClientService_0xC3CD_VechicleInfo_SDC_CLIENT_AVAILABLE (BswMActionListItem):
            BswMAbortOnFail = false
            BswMActionListItemIndex = 0
            BswMActionListItemRef = BswMModeControl/SDC_Mode_C_SdClientService_0xC3CD_VechicleInfo_SDC_CLIENT_AVAILABLE
        SDC_Mode_C_SdClientService_0xC3CD_VechicleInfo_SDC_CLIENT_AVAILABLE (BswMAction)
          BswMAvailableActions
            BswMRteSwitch: BswMSwitchedMode=SDC_CLIENT_AVAILABLE, BswMRteSwitchPortRef=SDC_Mode_C_SdClientService_0xC3CD_VechicleInfo
        SDC_AL_SdDown_C_SdClientService_0xC3CB_VechicleSpeed_DOWN (BswMActionList): BswMActionListExecution=BSWM_TRIGGER
          SDC_Mode_C_SdClientService_0xC3CB_VechicleSpeed_SDC_CLIENT_DOWN (BswMActionListItem):
            BswMAbortOnFail = false
            BswMActionListItemIndex = 0
            BswMActionListItemRef = BswMModeControl/SDC_Mode_C_SdClientService_0xC3CB_VechicleSpeed_SDC_CLIENT_DOWN
        SDC_Mode_C_SdClientService_0xC3CB_VechicleSpeed_SDC_CLIENT_DOWN (BswMAction)
          BswMAvailableActions
            BswMRteSwitch: BswMSwitchedMode=SDC_CLIENT_DOWN, BswMRteSwitchPortRef=SDC_Mode_C_SdClientService_0xC3CB_VechicleSpeed
        SDC_Mode_C_SdClientService_0xC3CB_VechicleSpeed (BswMSwitchPort): BswMModeSwitchInterfaceRef=BswM_MSI_SDC_SdClientServiceState
        SDC_AL_SdAvailable_C_SdClientService_0xC3CB_VechicleSpeed_AVAILABLE (BswMActionList): BswMActionListExecution=BSWM_TRIGGER
          SDC_Mode_C_SdClientService_0xC3CB_VechicleSpeed_SDC_CLIENT_AVAILABLE (BswMActionListItem):
            BswMAbortOnFail = false
            BswMActionListItemIndex = 0
            BswMActionListItemRef = BswMModeControl/SDC_Mode_C_SdClientService_0xC3CB_VechicleSpeed_SDC_CLIENT_AVAILABLE
        SDC_Mode_C_SdClientService_0xC3CB_VechicleSpeed_SDC_CLIENT_AVAILABLE (BswMAction)
          BswMAvailableActions
            BswMRteSwitch: BswMSwitchedMode=SDC_CLIENT_AVAILABLE, BswMRteSwitchPortRef=SDC_Mode_C_SdClientService_0xC3CB_VechicleSpeed
        SDC_AL_SdDown_C_SdClientService_0xC3CC_VechicleStatus_CEG_SdConsumedEventGroup_0xC3CC_VechicleStatus_DOWN (BswMActionList): BswMActionListExecution=BSWM_TRIGGER
          SDC_Mode_C_SdClientService_0xC3CC_VechicleStatus_CEG_SdConsumedEventGroup_0xC3CC_VechicleStatus_SDC_CEG_DOWN (BswMActionListItem):
            BswMAbortOnFail = false
            BswMActionListItemIndex = 0
            BswMActionListItemRef = BswMModeControl/SDC_Mode_C_SdClientService_0xC3CC_VechicleStatus_CEG_SdConsumedEventGroup_0xC3CC_VechicleStatus_SDC_CEG_DOWN
        SDC_Mode_C_SdClientService_0xC3CC_VechicleStatus_CEG_SdConsumedEventGroup_0xC3CC_VechicleStatus_SDC_CEG_DOWN (BswMAction)
          BswMAvailableActions
            BswMRteSwitch:
              BswMSwitchedMode = SDC_CEG_DOWN
              BswMRteSwitchPortRef = SDC_Mode_C_SdClientService_0xC3CC_VechicleStatus_CEG_SdConsumedEventGroup_0xC3CC_VechicleStatus
        SDC_Mode_C_SdClientService_0xC3CC_VechicleStatus_CEG_SdConsumedEventGroup_0xC3CC_VechicleStatus (BswMSwitchPort): BswMModeSwitchInterfaceRef=BswM_MSI_SDC_SdConsumedEventGroupState
        SDC_AL_SdAvailable_C_SdClientService_0xC3CC_VechicleStatus_CEG_SdConsumedEventGroup_0xC3CC_VechicleStatus_AVAILABLE (BswMActionList): BswMActionListExecution=BSWM_TRIGGER
          SDC_Mode_C_SdClientService_0xC3CC_VechicleStatus_CEG_SdConsumedEventGroup_0xC3CC_VechicleStatus_SDC_CEG_AVAILABLE (BswMActionListItem):
            BswMAbortOnFail = false
            BswMActionListItemIndex = 0
            BswMActionListItemRef = BswMModeControl/SDC_Mode_C_SdClientService_0xC3CC_VechicleStatus_CEG_SdConsumedEventGroup_0xC3CC_VechicleStatus_SDC_CEG_AVAILABLE
        SDC_Mode_C_SdClientService_0xC3CC_VechicleStatus_CEG_SdConsumedEventGroup_0xC3CC_VechicleStatus_SDC_CEG_AVAILABLE (BswMAction)
          BswMAvailableActions
            BswMRteSwitch:
              BswMSwitchedMode = SDC_CEG_AVAILABLE
              BswMRteSwitchPortRef = SDC_Mode_C_SdClientService_0xC3CC_VechicleStatus_CEG_SdConsumedEventGroup_0xC3CC_VechicleStatus
        SDC_AL_SdDown_C_SdClientService_0xC3CB_VechicleSpeed_CEG_SdConsumedEventGroup_0xC3CB_VechicleSpeed_DOWN (BswMActionList): BswMActionListExecution=BSWM_TRIGGER
          SDC_Mode_C_SdClientService_0xC3CB_VechicleSpeed_CEG_SdConsumedEventGroup_0xC3CB_VechicleSpeed_SDC_CEG_DOWN (BswMActionListItem):
            BswMAbortOnFail = false
            BswMActionListItemIndex = 0
            BswMActionListItemRef = BswMModeControl/SDC_Mode_C_SdClientService_0xC3CB_VechicleSpeed_CEG_SdConsumedEventGroup_0xC3CB_VechicleSpeed_SDC_CEG_DOWN
        SDC_Mode_C_SdClientService_0xC3CB_VechicleSpeed_CEG_SdConsumedEventGroup_0xC3CB_VechicleSpeed_SDC_CEG_DOWN (BswMAction)
          BswMAvailableActions
            BswMRteSwitch:
              BswMSwitchedMode = SDC_CEG_DOWN
              BswMRteSwitchPortRef = SDC_Mode_C_SdClientService_0xC3CB_VechicleSpeed_CEG_SdConsumedEventGroup_0xC3CB_VechicleSpeed
        SDC_Mode_C_SdClientService_0xC3CB_VechicleSpeed_CEG_SdConsumedEventGroup_0xC3CB_VechicleSpeed (BswMSwitchPort): BswMModeSwitchInterfaceRef=BswM_MSI_SDC_SdConsumedEventGroupState
        SDC_AL_SdAvailable_C_SdClientService_0xC3CB_VechicleSpeed_CEG_SdConsumedEventGroup_0xC3CB_VechicleSpeed_AVAILABLE (BswMActionList): BswMActionListExecution=BSWM_TRIGGER
          SDC_Mode_C_SdClientService_0xC3CB_VechicleSpeed_CEG_SdConsumedEventGroup_0xC3CB_VechicleSpeed_SDC_CEG_AVAILABLE (BswMActionListItem):
            BswMAbortOnFail = false
            BswMActionListItemIndex = 0
            BswMActionListItemRef = BswMModeControl/SDC_Mode_C_SdClientService_0xC3CB_VechicleSpeed_CEG_SdConsumedEventGroup_0xC3CB_VechicleSpeed_SDC_CEG_AVAILABLE
        SDC_Mode_C_SdClientService_0xC3CB_VechicleSpeed_CEG_SdConsumedEventGroup_0xC3CB_VechicleSpeed_SDC_CEG_AVAILABLE (BswMAction)
          BswMAvailableActions
            BswMRteSwitch:
              BswMSwitchedMode = SDC_CEG_AVAILABLE
              BswMRteSwitchPortRef = SDC_Mode_C_SdClientService_0xC3CB_VechicleSpeed_CEG_SdConsumedEventGroup_0xC3CB_VechicleSpeed
        SDC_AL_ApplRelease_C_SdClientService_0xC3CB_VechicleSpeed_CEG_SdConsumedEventGroup_0xC3CB_VechicleSpeed (BswMActionList): BswMActionListExecution=BSWM_TRIGGER
          SDC_SdCEGModeRequest_C_SdClientService_0xC3CB_VechicleSpeed_CEG_SdConsumedEventGroup_0xC3CB_VechicleSpeed_RELEASED (BswMActionListItem):
            BswMAbortOnFail = false
            BswMActionListItemIndex = 0
            BswMActionListItemRef = BswMModeControl/SDC_SdCEGModeRequest_C_SdClientService_0xC3CB_VechicleSpeed_CEG_SdConsumedEventGroup_0xC3CB_VechicleSpeed_RELEASED
        SDC_SdCEGModeRequest_C_SdClientService_0xC3CB_VechicleSpeed_CEG_SdConsumedEventGroup_0xC3CB_VechicleSpeed_RELEASED (BswMAction)
          BswMAvailableActions
            BswMSdConsumedEventGroupModeRequest: BswMSdConsumedEventGroupState=BSWM_SD_CONSUMED_EVENTGROUP_RELEASED, BswMSdConsumedEventGroupRef=SdConsumedEventGroup_0xC3CB_VechicleSpeed
        SDC_AL_ApplRequest_C_SdClientService_0xC3CB_VechicleSpeed_CEG_SdConsumedEventGroup_0xC3CB_VechicleSpeed (BswMActionList): BswMActionListExecution=BSWM_TRIGGER
          SDC_SdCEGModeRequest_C_SdClientService_0xC3CB_VechicleSpeed_CEG_SdConsumedEventGroup_0xC3CB_VechicleSpeed_REQUESTED (BswMActionListItem):
            BswMAbortOnFail = false
            BswMActionListItemIndex = 0
            BswMActionListItemRef = BswMModeControl/SDC_SdCEGModeRequest_C_SdClientService_0xC3CB_VechicleSpeed_CEG_SdConsumedEventGroup_0xC3CB_VechicleSpeed_REQUESTED
        SDC_SdCEGModeRequest_C_SdClientService_0xC3CB_VechicleSpeed_CEG_SdConsumedEventGroup_0xC3CB_VechicleSpeed_REQUESTED (BswMAction)
          BswMAvailableActions
            BswMSdConsumedEventGroupModeRequest: BswMSdConsumedEventGroupState=BSWM_SD_CONSUMED_EVENTGROUP_REQUESTED, BswMSdConsumedEventGroupRef=SdConsumedEventGroup_0xC3CB_VechicleSpeed
        SDC_AL_SdRelease_S_SdServerService_0xC3C0_FaultInfo_EH_SdEventHandler_0xC3C0_FaultInfo (BswMActionList): BswMActionListExecution=BSWM_TRIGGER
          SDC_Mode_S_SdServerService_0xC3C0_FaultInfo_EH_SdEventHandler_0xC3C0_FaultInfo_SDC_EH_RELEASED (BswMActionListItem):
            BswMAbortOnFail = false
            BswMActionListItemIndex = 0
            BswMActionListItemRef = BswMModeControl/SDC_Mode_S_SdServerService_0xC3C0_FaultInfo_EH_SdEventHandler_0xC3C0_FaultInfo_SDC_EH_RELEASED
        SDC_Mode_S_SdServerService_0xC3C0_FaultInfo_EH_SdEventHandler_0xC3C0_FaultInfo_SDC_EH_RELEASED (BswMAction)
          BswMAvailableActions
            BswMRteSwitch: BswMSwitchedMode=SDC_EH_RELEASED, BswMRteSwitchPortRef=SDC_Mode_S_SdServerService_0xC3C0_FaultInfo_EH_SdEventHandler_0xC3C0_FaultInfo
        SDC_Mode_S_SdServerService_0xC3C0_FaultInfo_EH_SdEventHandler_0xC3C0_FaultInfo (BswMSwitchPort): BswMModeSwitchInterfaceRef=BswM_MSI_SDC_SdEventHandlerState
        SDC_AL_SdRequest_S_SdServerService_0xC3C0_FaultInfo_EH_SdEventHandler_0xC3C0_FaultInfo (BswMActionList): BswMActionListExecution=BSWM_TRIGGER
          SDC_Mode_S_SdServerService_0xC3C0_FaultInfo_EH_SdEventHandler_0xC3C0_FaultInfo_SDC_EH_REQUESTED (BswMActionListItem):
            BswMAbortOnFail = false
            BswMActionListItemIndex = 0
            BswMActionListItemRef = BswMModeControl/SDC_Mode_S_SdServerService_0xC3C0_FaultInfo_EH_SdEventHandler_0xC3C0_FaultInfo_SDC_EH_REQUESTED
        SDC_Mode_S_SdServerService_0xC3C0_FaultInfo_EH_SdEventHandler_0xC3C0_FaultInfo_SDC_EH_REQUESTED (BswMAction)
          BswMAvailableActions
            BswMRteSwitch: BswMSwitchedMode=SDC_EH_REQUESTED, BswMRteSwitchPortRef=SDC_Mode_S_SdServerService_0xC3C0_FaultInfo_EH_SdEventHandler_0xC3C0_FaultInfo
        SDC_AL_ApplRelease_C_SdClientService_0xC3CC_VechicleStatus (BswMActionList): BswMActionListExecution=BSWM_TRIGGER
          SDC_SdClientServiceModeRequetst_C_SdClientService_0xC3CC_VechicleStatus_RELEASED (BswMActionListItem):
            BswMAbortOnFail = false
            BswMActionListItemIndex = 0
            BswMActionListItemRef = BswMModeControl/SDC_SdClientServiceModeRequetst_C_SdClientService_0xC3CC_VechicleStatus_RELEASED
        SDC_SdClientServiceModeRequetst_C_SdClientService_0xC3CC_VechicleStatus_RELEASED (BswMAction)
          BswMAvailableActions
            BswMSdClientServiceModeRequest: BswMSdClientServiceState=BSWM_SD_CLIENT_SERVICE_RELEASED, BswMSdClientMethodsRef=SdClientService_0xC3CC_VechicleStatus
        SDC_AL_ApplRequest_C_SdClientService_0xC3CC_VechicleStatus (BswMActionList): BswMActionListExecution=BSWM_TRIGGER
          SDC_SdClientServiceModeRequest_SdClientService_0xC3CC_VechicleStatus_BSWM_SD_CLIENT_SERVICE_REQUESTED (BswMActionListItem):
            BswMAbortOnFail = false
            BswMActionListItemIndex = 0
            BswMActionListItemRef = BswMModeControl/SDC_SdClientServiceModeRequest_SdClientService_0xC3CC_VechicleStatus_BSWM_SD_CLIENT_SERVICE_REQUESTED
        SDC_SdClientServiceModeRequest_SdClientService_0xC3CC_VechicleStatus_BSWM_SD_CLIENT_SERVICE_REQUESTED (BswMAction)
          BswMAvailableActions
            BswMSdClientServiceModeRequest: BswMSdClientServiceState=BSWM_SD_CLIENT_SERVICE_REQUESTED, BswMSdClientMethodsRef=SdClientService_0xC3CC_VechicleStatus
        SDC_AL_ApplRelease_S_SdServerService_0xC3C0_FaultInfo (BswMActionList): BswMActionListExecution=BSWM_TRIGGER
          SDC_SdServerServiceModeRequest_SdServerService_0xC3C0_FaultInfo_BSWM_SD_SERVER_SERVICE_DOWN (BswMActionListItem):
            BswMAbortOnFail = false
            BswMActionListItemIndex = 0
            BswMActionListItemRef = BswMModeControl/SDC_SdServerServiceModeRequest_SdServerService_0xC3C0_FaultInfo_BSWM_SD_SERVER_SERVICE_DOWN
        SDC_SdServerServiceModeRequest_SdServerService_0xC3C0_FaultInfo_BSWM_SD_SERVER_SERVICE_DOWN (BswMAction)
          BswMAvailableActions
            BswMSdServerServiceModeRequest: BswMSdServerServiceState=BSWM_SD_SERVER_SERVICE_DOWN, BswMSdServerMethodsRef=SdServerService_0xC3C0_FaultInfo
        SDC_AL_ApplRequest_S_SdServerService_0xC3C0_FaultInfo (BswMActionList): BswMActionListExecution=BSWM_TRIGGER
          SDC_SdServerServiceModeRequest_SdServerService_0xC3C0_FaultInfo_BSWM_SD_SERVER_SERVICE_AVAILABLE (BswMActionListItem):
            BswMAbortOnFail = false
            BswMActionListItemIndex = 0
            BswMActionListItemRef = BswMModeControl/SDC_SdServerServiceModeRequest_SdServerService_0xC3C0_FaultInfo_BSWM_SD_SERVER_SERVICE_AVAILABLE
        SDC_SdServerServiceModeRequest_SdServerService_0xC3C0_FaultInfo_BSWM_SD_SERVER_SERVICE_AVAILABLE (BswMAction)
          BswMAvailableActions
            BswMSdServerServiceModeRequest: BswMSdServerServiceState=BSWM_SD_SERVER_SERVICE_AVAILABLE, BswMSdServerMethodsRef=SdServerService_0xC3C0_FaultInfo
        SDC_AL_ApplRelease_S_SdServerService_0xC3C1_SenState (BswMActionList): BswMActionListExecution=BSWM_TRIGGER
          SDC_SdServerServiceModeRequest_SdServerService_0xC3C1_SenState_BSWM_SD_SERVER_SERVICE_DOWN (BswMActionListItem):
            BswMAbortOnFail = false
            BswMActionListItemIndex = 0
            BswMActionListItemRef = BswMModeControl/SDC_SdServerServiceModeRequest_SdServerService_0xC3C1_SenState_BSWM_SD_SERVER_SERVICE_DOWN
        SDC_SdServerServiceModeRequest_SdServerService_0xC3C1_SenState_BSWM_SD_SERVER_SERVICE_DOWN (BswMAction)
          BswMAvailableActions
            BswMSdServerServiceModeRequest: BswMSdServerServiceState=BSWM_SD_SERVER_SERVICE_DOWN, BswMSdServerMethodsRef=SdServerService_0xC3C1_SenState
        SDC_AL_ApplRequest_S_SdServerService_0xC3C1_SenState (BswMActionList): BswMActionListExecution=BSWM_TRIGGER
          SDC_SdServerServiceModeRequest_SdServerService_0xC3C1_SenState_BSWM_SD_SERVER_SERVICE_AVAILABLE (BswMActionListItem):
            BswMAbortOnFail = false
            BswMActionListItemIndex = 0
            BswMActionListItemRef = BswMModeControl/SDC_SdServerServiceModeRequest_SdServerService_0xC3C1_SenState_BSWM_SD_SERVER_SERVICE_AVAILABLE
        SDC_SdServerServiceModeRequest_SdServerService_0xC3C1_SenState_BSWM_SD_SERVER_SERVICE_AVAILABLE (BswMAction)
          BswMAvailableActions
            BswMSdServerServiceModeRequest: BswMSdServerServiceState=BSWM_SD_SERVER_SERVICE_AVAILABLE, BswMSdServerMethodsRef=SdServerService_0xC3C1_SenState
        SDC_AL_SdDown_C_SdClientService_0xC3CC_VechicleStatus_DOWN (BswMActionList): BswMActionListExecution=BSWM_TRIGGER
          SDC_Mode_C_SdClientService_0xC3CC_VechicleStatus_SDC_CLIENT_DOWN (BswMActionListItem):
            BswMAbortOnFail = false
            BswMActionListItemIndex = 0
            BswMActionListItemRef = BswMModeControl/SDC_Mode_C_SdClientService_0xC3CC_VechicleStatus_SDC_CLIENT_DOWN
        SDC_Mode_C_SdClientService_0xC3CC_VechicleStatus_SDC_CLIENT_DOWN (BswMAction)
          BswMAvailableActions
            BswMRteSwitch: BswMSwitchedMode=SDC_CLIENT_DOWN, BswMRteSwitchPortRef=SDC_Mode_C_SdClientService_0xC3CC_VechicleStatus
        SDC_Mode_C_SdClientService_0xC3CC_VechicleStatus (BswMSwitchPort): BswMModeSwitchInterfaceRef=BswM_MSI_SDC_SdClientServiceState
        SDC_AL_SdAvailable_C_SdClientService_0xC3CC_VechicleStatus_AVAILABLE (BswMActionList): BswMActionListExecution=BSWM_TRIGGER
          SDC_Mode_C_SdClientService_0xC3CC_VechicleStatus_SDC_CLIENT_AVAILABLE (BswMActionListItem):
            BswMAbortOnFail = false
            BswMActionListItemIndex = 0
            BswMActionListItemRef = BswMModeControl/SDC_Mode_C_SdClientService_0xC3CC_VechicleStatus_SDC_CLIENT_AVAILABLE
        SDC_Mode_C_SdClientService_0xC3CC_VechicleStatus_SDC_CLIENT_AVAILABLE (BswMAction)
          BswMAvailableActions
            BswMRteSwitch: BswMSwitchedMode=SDC_CLIENT_AVAILABLE, BswMRteSwitchPortRef=SDC_Mode_C_SdClientService_0xC3CC_VechicleStatus
        SDC_AL_ApplRelease_C_SdClientService_0xC3CD_VechicleInfo (BswMActionList): BswMActionListExecution=BSWM_TRIGGER
          SDC_SdClientServiceModeRequetst_C_SdClientService_0xC3CD_VechicleInfo_RELEASED (BswMActionListItem):
            BswMAbortOnFail = false
            BswMActionListItemIndex = 0
            BswMActionListItemRef = BswMModeControl/SDC_SdClientServiceModeRequetst_C_SdClientService_0xC3CD_VechicleInfo_RELEASED
        SDC_SdClientServiceModeRequetst_C_SdClientService_0xC3CD_VechicleInfo_RELEASED (BswMAction)
          BswMAvailableActions
            BswMSdClientServiceModeRequest: BswMSdClientServiceState=BSWM_SD_CLIENT_SERVICE_RELEASED, BswMSdClientMethodsRef=SdClientService_0xC3CD_VechicleInfo
        SDC_AL_ApplRequest_C_SdClientService_0xC3CD_VechicleInfo (BswMActionList): BswMActionListExecution=BSWM_TRIGGER
          SDC_SdClientServiceModeRequest_SdClientService_0xC3CD_VechicleInfo_BSWM_SD_CLIENT_SERVICE_REQUESTED (BswMActionListItem):
            BswMAbortOnFail = false
            BswMActionListItemIndex = 0
            BswMActionListItemRef = BswMModeControl/SDC_SdClientServiceModeRequest_SdClientService_0xC3CD_VechicleInfo_BSWM_SD_CLIENT_SERVICE_REQUESTED
        SDC_SdClientServiceModeRequest_SdClientService_0xC3CD_VechicleInfo_BSWM_SD_CLIENT_SERVICE_REQUESTED (BswMAction)
          BswMAvailableActions
            BswMSdClientServiceModeRequest: BswMSdClientServiceState=BSWM_SD_CLIENT_SERVICE_REQUESTED, BswMSdClientMethodsRef=SdClientService_0xC3CD_VechicleInfo
        SDC_AL_ApplRelease_C_SdClientService_0xC3CC_VechicleStatus_CEG_SdConsumedEventGroup_0xC3CC_VechicleStatus (BswMActionList): BswMActionListExecution=BSWM_TRIGGER
          SDC_SdCEGModeRequest_C_SdClientService_0xC3CC_VechicleStatus_CEG_SdConsumedEventGroup_0xC3CC_VechicleStatus_RELEASED (BswMActionListItem):
            BswMAbortOnFail = false
            BswMActionListItemIndex = 0
            BswMActionListItemRef = BswMModeControl/SDC_SdCEGModeRequest_C_SdClientService_0xC3CC_VechicleStatus_CEG_SdConsumedEventGroup_0xC3CC_VechicleStatus_RELEASED
        SDC_SdCEGModeRequest_C_SdClientService_0xC3CC_VechicleStatus_CEG_SdConsumedEventGroup_0xC3CC_VechicleStatus_RELEASED (BswMAction)
          BswMAvailableActions
            BswMSdConsumedEventGroupModeRequest: BswMSdConsumedEventGroupState=BSWM_SD_CONSUMED_EVENTGROUP_RELEASED, BswMSdConsumedEventGroupRef=SdConsumedEventGroup_0xC3CC_VechicleStatus
        SDC_AL_ApplRequest_C_SdClientService_0xC3CC_VechicleStatus_CEG_SdConsumedEventGroup_0xC3CC_VechicleStatus (BswMActionList): BswMActionListExecution=BSWM_TRIGGER
          SDC_SdCEGModeRequest_C_SdClientService_0xC3CC_VechicleStatus_CEG_SdConsumedEventGroup_0xC3CC_VechicleStatus_REQUESTED (BswMActionListItem):
            BswMAbortOnFail = false
            BswMActionListItemIndex = 0
            BswMActionListItemRef = BswMModeControl/SDC_SdCEGModeRequest_C_SdClientService_0xC3CC_VechicleStatus_CEG_SdConsumedEventGroup_0xC3CC_VechicleStatus_REQUESTED
        SDC_SdCEGModeRequest_C_SdClientService_0xC3CC_VechicleStatus_CEG_SdConsumedEventGroup_0xC3CC_VechicleStatus_REQUESTED (BswMAction)
          BswMAvailableActions
            BswMSdConsumedEventGroupModeRequest: BswMSdConsumedEventGroupState=BSWM_SD_CONSUMED_EVENTGROUP_REQUESTED, BswMSdConsumedEventGroupRef=SdConsumedEventGroup_0xC3CC_VechicleStatus
        SDC_AL_SdDown_C_SdClientService_0xC3CD_VechicleInfo_CEG_SdConsumedEventGroup_0xC3CD_VechicleInfo_DOWN (BswMActionList): BswMActionListExecution=BSWM_TRIGGER
          SDC_Mode_C_SdClientService_0xC3CD_VechicleInfo_CEG_SdConsumedEventGroup_0xC3CD_VechicleInfo_SDC_CEG_DOWN (BswMActionListItem):
            BswMAbortOnFail = false
            BswMActionListItemIndex = 0
            BswMActionListItemRef = BswMModeControl/SDC_Mode_C_SdClientService_0xC3CD_VechicleInfo_CEG_SdConsumedEventGroup_0xC3CD_VechicleInfo_SDC_CEG_DOWN
        SDC_Mode_C_SdClientService_0xC3CD_VechicleInfo_CEG_SdConsumedEventGroup_0xC3CD_VechicleInfo_SDC_CEG_DOWN (BswMAction)
          BswMAvailableActions
            BswMRteSwitch:
              BswMSwitchedMode = SDC_CEG_DOWN
              BswMRteSwitchPortRef = SDC_Mode_C_SdClientService_0xC3CD_VechicleInfo_CEG_SdConsumedEventGroup_0xC3CD_VechicleInfo
        SDC_Mode_C_SdClientService_0xC3CD_VechicleInfo_CEG_SdConsumedEventGroup_0xC3CD_VechicleInfo (BswMSwitchPort): BswMModeSwitchInterfaceRef=BswM_MSI_SDC_SdConsumedEventGroupState
        SDC_AL_SdAvailable_C_SdClientService_0xC3CD_VechicleInfo_CEG_SdConsumedEventGroup_0xC3CD_VechicleInfo_AVAILABLE (BswMActionList): BswMActionListExecution=BSWM_TRIGGER
          SDC_Mode_C_SdClientService_0xC3CD_VechicleInfo_CEG_SdConsumedEventGroup_0xC3CD_VechicleInfo_SDC_CEG_AVAILABLE (BswMActionListItem):
            BswMAbortOnFail = false
            BswMActionListItemIndex = 0
            BswMActionListItemRef = BswMModeControl/SDC_Mode_C_SdClientService_0xC3CD_VechicleInfo_CEG_SdConsumedEventGroup_0xC3CD_VechicleInfo_SDC_CEG_AVAILABLE
        SDC_Mode_C_SdClientService_0xC3CD_VechicleInfo_CEG_SdConsumedEventGroup_0xC3CD_VechicleInfo_SDC_CEG_AVAILABLE (BswMAction)
          BswMAvailableActions
            BswMRteSwitch:
              BswMSwitchedMode = SDC_CEG_AVAILABLE
              BswMRteSwitchPortRef = SDC_Mode_C_SdClientService_0xC3CD_VechicleInfo_CEG_SdConsumedEventGroup_0xC3CD_VechicleInfo
        SDC_AL_ApplRelease_S_SdServerService_0xC3C2_EcuState (BswMActionList): BswMActionListExecution=BSWM_TRIGGER
          SDC_SdServerServiceModeRequest_SdServerService_0xC3C2_EcuState_BSWM_SD_SERVER_SERVICE_DOWN (BswMActionListItem):
            BswMAbortOnFail = false
            BswMActionListItemIndex = 0
            BswMActionListItemRef = BswMModeControl/SDC_SdServerServiceModeRequest_SdServerService_0xC3C2_EcuState_BSWM_SD_SERVER_SERVICE_DOWN
        SDC_SdServerServiceModeRequest_SdServerService_0xC3C2_EcuState_BSWM_SD_SERVER_SERVICE_DOWN (BswMAction)
          BswMAvailableActions
            BswMSdServerServiceModeRequest: BswMSdServerServiceState=BSWM_SD_SERVER_SERVICE_DOWN, BswMSdServerMethodsRef=SdServerService_0xC3C2_EcuState
        SDC_AL_ApplRequest_S_SdServerService_0xC3C2_EcuState (BswMActionList): BswMActionListExecution=BSWM_TRIGGER
          SDC_SdServerServiceModeRequest_SdServerService_0xC3C2_EcuState_BSWM_SD_SERVER_SERVICE_AVAILABLE (BswMActionListItem):
            BswMAbortOnFail = false
            BswMActionListItemIndex = 0
            BswMActionListItemRef = BswMModeControl/SDC_SdServerServiceModeRequest_SdServerService_0xC3C2_EcuState_BSWM_SD_SERVER_SERVICE_AVAILABLE
        SDC_SdServerServiceModeRequest_SdServerService_0xC3C2_EcuState_BSWM_SD_SERVER_SERVICE_AVAILABLE (BswMAction)
          BswMAvailableActions
            BswMSdServerServiceModeRequest: BswMSdServerServiceState=BSWM_SD_SERVER_SERVICE_AVAILABLE, BswMSdServerMethodsRef=SdServerService_0xC3C2_EcuState
        SDC_AL_SdRelease_S_SdServerService_0xC3C2_EcuState_EH_SdEventHandler_0xC3C2_EcuState (BswMActionList): BswMActionListExecution=BSWM_TRIGGER
          SDC_Mode_S_SdServerService_0xC3C2_EcuState_EH_SdEventHandler_0xC3C2_EcuState_SDC_EH_RELEASED (BswMActionListItem):
            BswMAbortOnFail = false
            BswMActionListItemIndex = 0
            BswMActionListItemRef = BswMModeControl/SDC_Mode_S_SdServerService_0xC3C2_EcuState_EH_SdEventHandler_0xC3C2_EcuState_SDC_EH_RELEASED
        SDC_Mode_S_SdServerService_0xC3C2_EcuState_EH_SdEventHandler_0xC3C2_EcuState_SDC_EH_RELEASED (BswMAction)
          BswMAvailableActions
            BswMRteSwitch: BswMSwitchedMode=SDC_EH_RELEASED, BswMRteSwitchPortRef=SDC_Mode_S_SdServerService_0xC3C2_EcuState_EH_SdEventHandler_0xC3C2_EcuState
        SDC_Mode_S_SdServerService_0xC3C2_EcuState_EH_SdEventHandler_0xC3C2_EcuState (BswMSwitchPort): BswMModeSwitchInterfaceRef=BswM_MSI_SDC_SdEventHandlerState
        SDC_AL_SdRequest_S_SdServerService_0xC3C2_EcuState_EH_SdEventHandler_0xC3C2_EcuState (BswMActionList): BswMActionListExecution=BSWM_TRIGGER
          SDC_Mode_S_SdServerService_0xC3C2_EcuState_EH_SdEventHandler_0xC3C2_EcuState_SDC_EH_REQUESTED (BswMActionListItem):
            BswMAbortOnFail = false
            BswMActionListItemIndex = 0
            BswMActionListItemRef = BswMModeControl/SDC_Mode_S_SdServerService_0xC3C2_EcuState_EH_SdEventHandler_0xC3C2_EcuState_SDC_EH_REQUESTED
        SDC_Mode_S_SdServerService_0xC3C2_EcuState_EH_SdEventHandler_0xC3C2_EcuState_SDC_EH_REQUESTED (BswMAction)
          BswMAvailableActions
            BswMRteSwitch: BswMSwitchedMode=SDC_EH_REQUESTED, BswMRteSwitchPortRef=SDC_Mode_S_SdServerService_0xC3C2_EcuState_EH_SdEventHandler_0xC3C2_EcuState
        SDC_AL_ApplRelease_C_SdClientService_0xC3CD_VechicleInfo_CEG_SdConsumedEventGroup_0xC3CD_VechicleInfo (BswMActionList): BswMActionListExecution=BSWM_TRIGGER
          SDC_SdCEGModeRequest_C_SdClientService_0xC3CD_VechicleInfo_CEG_SdConsumedEventGroup_0xC3CD_VechicleInfo_RELEASED (BswMActionListItem):
            BswMAbortOnFail = false
            BswMActionListItemIndex = 0
            BswMActionListItemRef = BswMModeControl/SDC_SdCEGModeRequest_C_SdClientService_0xC3CD_VechicleInfo_CEG_SdConsumedEventGroup_0xC3CD_VechicleInfo_RELEASED
        SDC_SdCEGModeRequest_C_SdClientService_0xC3CD_VechicleInfo_CEG_SdConsumedEventGroup_0xC3CD_VechicleInfo_RELEASED (BswMAction)
          BswMAvailableActions
            BswMSdConsumedEventGroupModeRequest: BswMSdConsumedEventGroupState=BSWM_SD_CONSUMED_EVENTGROUP_RELEASED, BswMSdConsumedEventGroupRef=SdConsumedEventGroup_0xC3CD_VechicleInfo
        SDC_AL_ApplRequest_C_SdClientService_0xC3CD_VechicleInfo_CEG_SdConsumedEventGroup_0xC3CD_VechicleInfo (BswMActionList): BswMActionListExecution=BSWM_TRIGGER
          SDC_SdCEGModeRequest_C_SdClientService_0xC3CD_VechicleInfo_CEG_SdConsumedEventGroup_0xC3CD_VechicleInfo_REQUESTED (BswMActionListItem):
            BswMAbortOnFail = false
            BswMActionListItemIndex = 0
            BswMActionListItemRef = BswMModeControl/SDC_SdCEGModeRequest_C_SdClientService_0xC3CD_VechicleInfo_CEG_SdConsumedEventGroup_0xC3CD_VechicleInfo_REQUESTED
        SDC_SdCEGModeRequest_C_SdClientService_0xC3CD_VechicleInfo_CEG_SdConsumedEventGroup_0xC3CD_VechicleInfo_REQUESTED (BswMAction)
          BswMAvailableActions
            BswMSdConsumedEventGroupModeRequest: BswMSdConsumedEventGroupState=BSWM_SD_CONSUMED_EVENTGROUP_REQUESTED, BswMSdConsumedEventGroupRef=SdConsumedEventGroup_0xC3CD_VechicleInfo
        INIT_Action_Sd_Init (BswMAction)
          BswMAvailableActions
            BswMUserCallout: BswMUserCalloutFunction=Sd_Init(Sd_Config_Ptr), BswMCreateCallout=false, BswMUserIncludeFile=Sd.h
      ESH_Mode (BswMRteModeDclGroup): BswMInitMode=STARTUP
        5 x BswMRteMode:
          STARTUP: BswMModePhysicalValue=0
          RUN: BswMModePhysicalValue=1
          POSTRUN: BswMModePhysicalValue=2
          WAKEUP: BswMModePhysicalValue=3
          SHUTDOWN: BswMModePhysicalValue=4
      ESH_RunRequest (BswMRteModeDclGroup): BswMInitMode=RELEASED
        RELEASED (BswMRteMode): BswMModePhysicalValue=0
        REQUESTED (BswMRteMode): BswMModePhysicalValue=1
      BswMDataTypeMappingSets: BswMDataTypeMappingSetRef=BswMMappingSet
      6 x BswMRteModeDclGroup:
        SDC_SdEventHandlerState: BswMInitMode=SDC_EH_RELEASED
          SDC_EH_RELEASED (BswMRteMode): BswMModePhysicalValue=0
          SDC_EH_REQUESTED (BswMRteMode): BswMModePhysicalValue=1
        SDC_SdClientServiceState: BswMInitMode=SDC_CLIENT_DOWN
          SDC_CLIENT_DOWN (BswMRteMode): BswMModePhysicalValue=0
          SDC_CLIENT_AVAILABLE (BswMRteMode): BswMModePhysicalValue=1
        SDC_SdConsumedEventGroupState: BswMInitMode=SDC_CEG_DOWN
          SDC_CEG_DOWN (BswMRteMode): BswMModePhysicalValue=0
          SDC_CEG_AVAILABLE (BswMRteMode): BswMModePhysicalValue=1
        SDC_SdServerServiceRequest: BswMInitMode=SDC_SERVER_DOWN
          SDC_SERVER_DOWN (BswMRteMode): BswMModePhysicalValue=0
          SDC_SERVER_AVAILABE (BswMRteMode): BswMModePhysicalValue=1
        SDC_SdConsumedEventGroupRequest: BswMInitMode=SDC_CEG_RELEASED
          SDC_CEG_RELEASED (BswMRteMode): BswMModePhysicalValue=0
          SDC_CEG_REQUESTED (BswMRteMode): BswMModePhysicalValue=1
        SDC_SdClientServiceRequest: BswMInitMode=SDC_CLIENT_RELEASED
          SDC_CLIENT_RELEASED (BswMRteMode): BswMModePhysicalValue=0
          SDC_CLIENT_REQUESTED (BswMRteMode): BswMModePhysicalValue=1
