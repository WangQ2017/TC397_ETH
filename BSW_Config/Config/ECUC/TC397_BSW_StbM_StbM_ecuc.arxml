AUTOSAR XML (schema 00048)
package /ActiveEcuC
  module config StbM: implementation-config-variant=VARIANT-PRE-COMPILE, module-description=StbM_Impl
    StbMGeneral: StbMDevErrorDetect=true, StbMMainFunctionPeriod=0.01, StbMTimeRecordingSupport=false, StbMVersionInfoApi=false, StbMSafeBswChecks=false
    StbMSynchronizedTimeBase_MAIN0 (StbMSynchronizedTimeBase):
      StbMIsSystemWideGlobalTimeMaster = false
      StbMSynchronizedTimeBaseIdentifier = 0
      StbMClearTimeleapCount = 3
      StbMStoreTimebaseNonVolatile = NO_STORAGE
      StbMSyncLossTimeout = 0.5
      StbMTimeLeapFutureThreshold = 0.0006
      StbMTimeLeapPastThreshold = 0.0006
      StbMLocalTimeClock: StbMClockFrequency=100000000, StbMClockPrescaler=1, StbMLocalTimeHardware=EthTSynGlobalTimeDomain_MAIN0
      StbMTimeCorrection:
        StbMOffsetCorrectionAdaptionInterval = 0.5
        StbMOffsetCorrectionJumpThreshold = 0.0001
        StbMRateCorrectionMeasurementDuration = 5
        StbMRateCorrectionsPerMeasurementDuration = 1
    StbMSynchronizedTimeBase_MAIN6 (StbMSynchronizedTimeBase): StbMIsSystemWideGlobalTimeMaster=true, StbMSynchronizedTimeBaseIdentifier=6, StbMAllowMasterRateCorrection=false
      StbMLocalTimeClock: StbMClockFrequency=100000000, StbMClockPrescaler=1, StbMLocalTimeHardware=EthTSynGlobalTimeDomain_MAIN6
