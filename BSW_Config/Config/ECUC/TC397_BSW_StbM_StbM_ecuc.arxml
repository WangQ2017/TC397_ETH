AUTOSAR XML (schema 00048)
package /ActiveEcuC
  module config StbM: implementation-config-variant=VARIANT-PRE-COMPILE, module-description=StbM_Impl
    StbMGeneral: StbMDevErrorDetect=true, StbMMainFunctionPeriod=0.01, StbMTimeRecordingSupport=false, StbMVersionInfoApi=false, StbMSafeBswChecks=false
    StbMSynchronizedTimeBase: StbMIsSystemWideGlobalTimeMaster=false, StbMSynchronizedTimeBaseIdentifier=(unset)
