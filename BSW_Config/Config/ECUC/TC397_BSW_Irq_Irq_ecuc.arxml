AUTOSAR XML (schema 00048)
package /Irq
  module config Irq: implementation-config-variant=VARIANT-PRE-COMPILE, module-description=Irq_Impl
    CommonPublishedInformation:
      ArMajorVersion = 4
      ArMinorVersion = 4
      ArPatchVersion = 0
      ModuleId = 255
      Release = _TRICORE_TC397
      SwMajorVersion = 20
      SwMinorVersion = 0
      SwPatchVersion = 0
      VendorId = 17
    IrqASCLINConfig_0 (IrqASCLINConfig)
      IrqAsclinCatConfig
        IrqAsclinErrCatConfig:
          IrqAsclin0ErrCat = CAT1
          IrqAsclin{10..19}ErrCat = CAT1
          IrqAsclin1ErrCat = CAT1
          IrqAsclin{20..23}ErrCat = CAT1
          IrqAsclin{2..9}ErrCat = CAT1
        IrqAsclinRxCatConfig:
          IrqAsclin0RxCat = CAT1
          IrqAsclin{10..19}RxCat = CAT1
          IrqAsclin1RxCat = CAT1
          IrqAsclin{20..23}RxCat = CAT1
          IrqAsclin{2..9}RxCat = CAT1
        IrqAsclinTxCatConfig:
          IrqAsclin0TxCat = CAT1
          IrqAsclin{10..19}TxCat = CAT1
          IrqAsclin1TxCat = CAT1
          IrqAsclin{20..23}TxCat = CAT1
          IrqAsclin{2..9}TxCat = CAT1
      IrqAsclinPrioConfig
        IrqAsclinErrPrioConfig:
          IrqAsclin0ErrPrio = 0
          IrqAsclin{10..19}ErrPrio = 0
          IrqAsclin1ErrPrio = 0
          IrqAsclin{20..23}ErrPrio = 0
          IrqAsclin{2..9}ErrPrio = 0
        IrqAsclinRxPrioConfig:
          IrqAsclin0RxPrio = 0
          IrqAsclin{10..19}RxPrio = 0
          IrqAsclin1RxPrio = 0
          IrqAsclin{20..23}RxPrio = 0
          IrqAsclin{2..9}RxPrio = 0
        IrqAsclinTxPrioConfig:
          IrqAsclin0TxPrio = 0
          IrqAsclin{10..19}TxPrio = 0
          IrqAsclin1TxPrio = 0
          IrqAsclin{20..23}TxPrio = 0
          IrqAsclin{2..9}TxPrio = 0
      IrqAsclinTosConfig
        IrqAsclinErrTosConfig:
          IrqAsclin0ErrTos = CPU0
          IrqAsclin{10..19}ErrTos = CPU0
          IrqAsclin1ErrTos = CPU0
          IrqAsclin{20..23}ErrTos = CPU0
          IrqAsclin{2..9}ErrTos = CPU0
        IrqAsclinRxTosConfig:
          IrqAsclin0RxTos = CPU0
          IrqAsclin{10..19}RxTos = CPU0
          IrqAsclin1RxTos = CPU0
          IrqAsclin{20..23}RxTos = CPU0
          IrqAsclin{2..9}RxTos = CPU0
        IrqAsclinTxTosConfig:
          IrqAsclin0TxTos = CPU0
          IrqAsclin{10..19}TxTos = CPU0
          IrqAsclin1TxTos = CPU0
          IrqAsclin{20..23}TxTos = CPU0
          IrqAsclin{2..9}TxTos = CPU0
    IrqAdcConfig_0 (IrqAdcConfig)
      IrqAdc0Config
        IrqAdc0CatConfig: IrqAdc0SR0Cat=CAT1, IrqAdc0SR1Cat=CAT1, IrqAdc0SR2Cat=CAT1, IrqAdc0SR3Cat=CAT1
        IrqAdc0PrioConfig: IrqAdc0SR0Prio=0, IrqAdc0SR1Prio=0, IrqAdc0SR2Prio=0, IrqAdc0SR3Prio=0
        IrqAdc0TosConfig: IrqAdc0SR0Tos=CPU0, IrqAdc0SR1Tos=CPU0, IrqAdc0SR2Tos=CPU0, IrqAdc0SR3Tos=CPU0
      IrqAdc10Config
        IrqAdc10CatConfig: IrqAdc10SR0Cat=CAT1, IrqAdc10SR1Cat=CAT1, IrqAdc10SR2Cat=CAT1, IrqAdc10SR3Cat=CAT1
        IrqAdc10PrioConfig: IrqAdc10SR0Prio=0, IrqAdc10SR1Prio=0, IrqAdc10SR2Prio=0, IrqAdc10SR3Prio=0
        IrqAdc10TosConfig: IrqAdc10SR0Tos=CPU0, IrqAdc10SR1Tos=CPU0, IrqAdc10SR2Tos=CPU0, IrqAdc10SR3Tos=CPU0
      IrqAdc11Config
        IrqAdc11CatConfig: IrqAdc11SR0Cat=CAT1, IrqAdc11SR1Cat=CAT1, IrqAdc11SR2Cat=CAT1, IrqAdc11SR3Cat=CAT1
        IrqAdc11PrioConfig: IrqAdc11SR0Prio=0, IrqAdc11SR1Prio=0, IrqAdc11SR2Prio=0, IrqAdc11SR3Prio=0
        IrqAdc11TosConfig: IrqAdc11SR0Tos=CPU0, IrqAdc11SR1Tos=CPU0, IrqAdc11SR2Tos=CPU0, IrqAdc11SR3Tos=CPU0
      IrqAdc1Config
        IrqAdc1CatConfig: IrqAdc1SR0Cat=CAT1, IrqAdc1SR1Cat=CAT1, IrqAdc1SR2Cat=CAT1, IrqAdc1SR3Cat=CAT1
        IrqAdc1PrioConfig: IrqAdc1SR0Prio=0, IrqAdc1SR1Prio=0, IrqAdc1SR2Prio=0, IrqAdc1SR3Prio=0
        IrqAdc1TosConfig: IrqAdc1SR0Tos=CPU0, IrqAdc1SR1Tos=CPU0, IrqAdc1SR2Tos=CPU0, IrqAdc1SR3Tos=CPU0
      IrqAdc2Config
        IrqAdc2CatConfig: IrqAdc2SR0Cat=CAT1, IrqAdc2SR1Cat=CAT1, IrqAdc2SR2Cat=CAT1, IrqAdc2SR3Cat=CAT1
        IrqAdc2PrioConfig: IrqAdc2SR0Prio=0, IrqAdc2SR1Prio=0, IrqAdc2SR2Prio=0, IrqAdc2SR3Prio=0
        IrqAdc2TosConfig: IrqAdc2SR0Tos=CPU0, IrqAdc2SR1Tos=CPU0, IrqAdc2SR2Tos=CPU0, IrqAdc2SR3Tos=CPU0
      IrqAdc3Config
        IrqAdc3CatConfig: IrqAdc3SR0Cat=CAT1, IrqAdc3SR1Cat=CAT1, IrqAdc3SR2Cat=CAT1, IrqAdc3SR3Cat=CAT1
        IrqAdc3PrioConfig: IrqAdc3SR0Prio=0, IrqAdc3SR1Prio=0, IrqAdc3SR2Prio=0, IrqAdc3SR3Prio=0
        IrqAdc3TosConfig: IrqAdc3SR0Tos=CPU0, IrqAdc3SR1Tos=CPU0, IrqAdc3SR2Tos=CPU0, IrqAdc3SR3Tos=CPU0
      IrqAdc4Config
        IrqAdc4CatConfig: IrqAdc4SR0Cat=CAT1, IrqAdc4SR1Cat=CAT1, IrqAdc4SR2Cat=CAT1, IrqAdc4SR3Cat=CAT1
        IrqAdc4PrioConfig: IrqAdc4SR0Prio=0, IrqAdc4SR1Prio=0, IrqAdc4SR2Prio=0, IrqAdc4SR3Prio=0
        IrqAdc4TosConfig: IrqAdc4SR0Tos=CPU0, IrqAdc4SR1Tos=CPU0, IrqAdc4SR2Tos=CPU0, IrqAdc4SR3Tos=CPU0
      IrqAdc5Config
        IrqAdc5CatConfig: IrqAdc5SR0Cat=CAT1, IrqAdc5SR1Cat=CAT1, IrqAdc5SR2Cat=CAT1, IrqAdc5SR3Cat=CAT1
        IrqAdc5PrioConfig: IrqAdc5SR0Prio=0, IrqAdc5SR1Prio=0, IrqAdc5SR2Prio=0, IrqAdc5SR3Prio=0
        IrqAdc5TosConfig: IrqAdc5SR0Tos=CPU0, IrqAdc5SR1Tos=CPU0, IrqAdc5SR2Tos=CPU0, IrqAdc5SR3Tos=CPU0
      IrqAdc6Config
        IrqAdc6CatConfig: IrqAdc6SR0Cat=CAT1, IrqAdc6SR1Cat=CAT1, IrqAdc6SR2Cat=CAT1, IrqAdc6SR3Cat=CAT1
        IrqAdc6PrioConfig: IrqAdc6SR0Prio=0, IrqAdc6SR1Prio=0, IrqAdc6SR2Prio=0, IrqAdc6SR3Prio=0
        IrqAdc6TosConfig: IrqAdc6SR0Tos=CPU0, IrqAdc6SR1Tos=CPU0, IrqAdc6SR2Tos=CPU0, IrqAdc6SR3Tos=CPU0
      IrqAdc7Config
        IrqAdc7CatConfig: IrqAdc7SR0Cat=CAT1, IrqAdc7SR1Cat=CAT1, IrqAdc7SR2Cat=CAT1, IrqAdc7SR3Cat=CAT1
        IrqAdc7PrioConfig: IrqAdc7SR0Prio=0, IrqAdc7SR1Prio=0, IrqAdc7SR2Prio=0, IrqAdc7SR3Prio=0
        IrqAdc7TosConfig: IrqAdc7SR0Tos=CPU0, IrqAdc7SR1Tos=CPU0, IrqAdc7SR2Tos=CPU0, IrqAdc7SR3Tos=CPU0
      IrqAdc8Config
        IrqAdc8CatConfig: IrqAdc8SR0Cat=CAT1, IrqAdc8SR1Cat=CAT1, IrqAdc8SR2Cat=CAT1, IrqAdc8SR3Cat=CAT1
        IrqAdc8PrioConfig: IrqAdc8SR0Prio=0, IrqAdc8SR1Prio=0, IrqAdc8SR2Prio=0, IrqAdc8SR3Prio=0
        IrqAdc8TosConfig: IrqAdc8SR0Tos=CPU0, IrqAdc8SR1Tos=CPU0, IrqAdc8SR2Tos=CPU0, IrqAdc8SR3Tos=CPU0
      IrqAdc9Config
        IrqAdc9CatConfig: IrqAdc9SR0Cat=CAT1, IrqAdc9SR1Cat=CAT1, IrqAdc9SR2Cat=CAT1, IrqAdc9SR3Cat=CAT1
        IrqAdc9PrioConfig: IrqAdc9SR0Prio=0, IrqAdc9SR1Prio=0, IrqAdc9SR2Prio=0, IrqAdc9SR3Prio=0
        IrqAdc9TosConfig: IrqAdc9SR0Tos=CPU0, IrqAdc9SR1Tos=CPU0, IrqAdc9SR2Tos=CPU0, IrqAdc9SR3Tos=CPU0
      IrqAdcCG0Config
        IrqAdcCG0CatConfig: IrqAdcCG0SR0Cat=CAT1, IrqAdcCG0SR1Cat=CAT1, IrqAdcCG0SR2Cat=CAT1, IrqAdcCG0SR3Cat=CAT1
        IrqAdcCG0PrioConfig: IrqAdcCG0SR0Prio=0, IrqAdcCG0SR1Prio=0, IrqAdcCG0SR2Prio=0, IrqAdcCG0SR3Prio=0
        IrqAdcCG0TosConfig: IrqAdcCG0SR0Tos=CPU0, IrqAdcCG0SR1Tos=CPU0, IrqAdcCG0SR2Tos=CPU0, IrqAdcCG0SR3Tos=CPU0
      IrqAdcCG1Config
        IrqAdcCG1CatConfig: IrqAdcCG1SR0Cat=CAT1, IrqAdcCG1SR1Cat=CAT1, IrqAdcCG1SR2Cat=CAT1, IrqAdcCG1SR3Cat=CAT1
        IrqAdcCG1PrioConfig: IrqAdcCG1SR0Prio=0, IrqAdcCG1SR1Prio=0, IrqAdcCG1SR2Prio=0, IrqAdcCG1SR3Prio=0
        IrqAdcCG1TosConfig: IrqAdcCG1SR0Tos=CPU0, IrqAdcCG1SR1Tos=CPU0, IrqAdcCG1SR2Tos=CPU0, IrqAdcCG1SR3Tos=CPU0
    IrqCCU6Config_0 (IrqCCU6Config)
      Irq_CCU60_Config
        Irq_CCU60Cat_Config: Irq_CCU60SR0_Cat=CAT1, Irq_CCU60SR1_Cat=CAT1, Irq_CCU60SR2_Cat=CAT1, Irq_CCU60SR3_Cat=CAT1
        Irq_CCU60Prio_Config: Irq_CCU60SR0_Prio=0, Irq_CCU60SR1_Prio=0, Irq_CCU60SR2_Prio=0, Irq_CCU60SR3_Prio=0
        Irq_CCU60Tos_Config: Irq_CCU60SR0_Tos=CPU0, Irq_CCU60SR1_Tos=CPU0, Irq_CCU60SR2_Tos=CPU0, Irq_CCU60SR3_Tos=CPU0
      Irq_CCU61_Config
        Irq_CCU61Cat_Config: Irq_CCU61SR0_Cat=CAT1, Irq_CCU61SR1_Cat=CAT1, Irq_CCU61SR2_Cat=CAT1, Irq_CCU61SR3_Cat=CAT1
        Irq_CCU61Prio_Config: Irq_CCU61SR0_Prio=0, Irq_CCU61SR1_Prio=0, Irq_CCU61SR2_Prio=0, Irq_CCU61SR3_Prio=0
        Irq_CCU61Tos_Config: Irq_CCU61SR0_Tos=CPU0, Irq_CCU61SR1_Tos=CPU0, Irq_CCU61SR2_Tos=CPU0, Irq_CCU61SR3_Tos=CPU0
    IrqCanConfig_0 (IrqCanConfig)
      IrqCan0Config
        IrqCanCatConfig:
          IrqCanSR0Cat = CAT1
          IrqCanSR{10..15}Cat = CAT1
          IrqCanSR{1..9}Cat = CAT1
        IrqCanPrioConfig:
          IrqCanSR0Prio = 0
          IrqCanSR{10..15}Prio = 0
          IrqCanSR{1..9}Prio = 0
        IrqCanTosConfig:
          IrqCanSR0Tos = CPU0
          IrqCanSR{10..15}Tos = CPU0
          IrqCanSR{1..9}Tos = CPU0
      IrqCan1Config
        IrqCanCatConfig:
          IrqCanSR0Cat = CAT1
          IrqCanSR{10..15}Cat = CAT1
          IrqCanSR{1..9}Cat = CAT1
        IrqCanPrioConfig:
          IrqCanSR0Prio = 0
          IrqCanSR{10..15}Prio = 0
          IrqCanSR{1..9}Prio = 0
        IrqCanTosConfig:
          IrqCanSR0Tos = CPU0
          IrqCanSR{10..15}Tos = CPU0
          IrqCanSR{1..9}Tos = CPU0
      IrqCan2Config
        IrqCanCatConfig:
          IrqCanSR0Cat = CAT1
          IrqCanSR{10..15}Cat = CAT1
          IrqCanSR{1..9}Cat = CAT1
        IrqCanPrioConfig:
          IrqCanSR0Prio = 0
          IrqCanSR{10..15}Prio = 0
          IrqCanSR{1..9}Prio = 0
        IrqCanTosConfig:
          IrqCanSR0Tos = CPU0
          IrqCanSR{10..15}Tos = CPU0
          IrqCanSR{1..9}Tos = CPU0
      IrqCan3Config
        IrqCanCatConfig:
          IrqCanSR0Cat = CAT1
          IrqCanSR{10..15}Cat = CAT1
          IrqCanSR{1..9}Cat = CAT1
        IrqCanPrioConfig:
          IrqCanSR0Prio = 0
          IrqCanSR{10..15}Prio = 0
          IrqCanSR{1..9}Prio = 0
        IrqCanTosConfig:
          IrqCanSR0Tos = CPU0
          IrqCanSR{10..15}Tos = CPU0
          IrqCanSR{1..9}Tos = CPU0
      IrqCan4Config
        IrqCanCatConfig:
          IrqCanSR0Cat = CAT1
          IrqCanSR{10..15}Cat = CAT1
          IrqCanSR{1..9}Cat = CAT1
        IrqCanPrioConfig:
          IrqCanSR0Prio = 0
          IrqCanSR{10..15}Prio = 0
          IrqCanSR{1..9}Prio = 0
        IrqCanTosConfig:
          IrqCanSR0Tos = CPU0
          IrqCanSR{10..15}Tos = CPU0
          IrqCanSR{1..9}Tos = CPU0
    IrqDMUConfig_0 (IrqDMUConfig)
      IrqDMUCatConfig: IrqDMUFSICat=CAT1, IrqDMUHOSTCat=CAT1
      IrqDMUPrioConfig: IrqDMUFSIPrio=0, IrqDMUHOSTPrio=0
      IrqDMUTosConfig: IrqDMUFSITos=CPU0, IrqDMUHOSTTos=CPU0
    IrqDmaConfig_0 (IrqDmaConfig)
      IrqDmaCatConfig:
        IrqDmaCh0SRCat = CAT1
        IrqDmaCh{100..109}SRCat = CAT1
        IrqDmaCh10SRCat = CAT1
        IrqDmaCh{110..119}SRCat = CAT1
        IrqDmaCh11SRCat = CAT1
        IrqDmaCh{120..127}SRCat = CAT1
        IrqDmaCh{12..19}SRCat = CAT1
        IrqDmaCh1SRCat = CAT1
        IrqDmaCh{20..29}SRCat = CAT1
        IrqDmaCh2SRCat = CAT1
        IrqDmaCh{30..39}SRCat = CAT1
        IrqDmaCh3SRCat = CAT1
        IrqDmaCh{40..49}SRCat = CAT1
        IrqDmaCh4SRCat = CAT1
        IrqDmaCh{50..59}SRCat = CAT1
        IrqDmaCh5SRCat = CAT1
        IrqDmaCh{60..69}SRCat = CAT1
        IrqDmaCh6SRCat = CAT1
        IrqDmaCh{70..79}SRCat = CAT1
        IrqDmaCh7SRCat = CAT1
        IrqDmaCh{80..89}SRCat = CAT1
        IrqDmaCh8SRCat = CAT1
        IrqDmaCh{90..99}SRCat = CAT1
        IrqDmaCh9SRCat = CAT1
        IrqDmaErr{0..3}SRCat = CAT1
      IrqDmaPrioConfig:
        IrqDmaCh0SRPrio = 0
        IrqDmaCh{100..109}SRPrio = 0
        IrqDmaCh10SRPrio = 0
        IrqDmaCh{110..119}SRPrio = 0
        IrqDmaCh11SRPrio = 0
        IrqDmaCh{120..127}SRPrio = 0
        IrqDmaCh{12..19}SRPrio = 0
        IrqDmaCh1SRPrio = 0
        IrqDmaCh{20..29}SRPrio = 0
        IrqDmaCh2SRPrio = 0
        IrqDmaCh{30..39}SRPrio = 0
        IrqDmaCh3SRPrio = 0
        IrqDmaCh{40..49}SRPrio = 0
        IrqDmaCh4SRPrio = 0
        IrqDmaCh{50..59}SRPrio = 0
        IrqDmaCh5SRPrio = 0
        IrqDmaCh{60..69}SRPrio = 0
        IrqDmaCh6SRPrio = 0
        IrqDmaCh{70..79}SRPrio = 0
        IrqDmaCh7SRPrio = 0
        IrqDmaCh{80..89}SRPrio = 0
        IrqDmaCh8SRPrio = 0
        IrqDmaCh{90..99}SRPrio = 0
        IrqDmaCh9SRPrio = 0
        IrqDmaErr{0..3}SRPrio = 0
      IrqDmaTosConfig:
        IrqDmaCh0SRTos = CPU0
        IrqDmaCh{100..109}SRTos = CPU0
        IrqDmaCh10SRTos = CPU0
        IrqDmaCh{110..119}SRTos = CPU0
        IrqDmaCh11SRTos = CPU0
        IrqDmaCh{120..127}SRTos = CPU0
        IrqDmaCh{12..19}SRTos = CPU0
        IrqDmaCh1SRTos = CPU0
        IrqDmaCh{20..29}SRTos = CPU0
        IrqDmaCh2SRTos = CPU0
        IrqDmaCh{30..39}SRTos = CPU0
        IrqDmaCh3SRTos = CPU0
        IrqDmaCh{40..49}SRTos = CPU0
        IrqDmaCh4SRTos = CPU0
        IrqDmaCh{50..59}SRTos = CPU0
        IrqDmaCh5SRTos = CPU0
        IrqDmaCh{60..69}SRTos = CPU0
        IrqDmaCh6SRTos = CPU0
        IrqDmaCh{70..79}SRTos = CPU0
        IrqDmaCh7SRTos = CPU0
        IrqDmaCh{80..89}SRTos = CPU0
        IrqDmaCh8SRTos = CPU0
        IrqDmaCh{90..99}SRTos = CPU0
        IrqDmaCh9SRTos = CPU0
        IrqDmaErr{0..3}SRTos = CPU0
    IrqDsadcConfig_0 (IrqDsadcConfig)
      IrqDsadcCatConfig
        IrqDsadcSRACatConfig:
          IrqDSAdcSRA0Cat = CAT1
          IrqDSAdcSRA{10..13}Cat = CAT1
          IrqDSAdcSRA{1..9}Cat = CAT1
        IrqDsadcSRMCatConfig:
          IrqDSAdcSRM0Cat = CAT1
          IrqDSAdcSRM{10..13}Cat = CAT1
          IrqDSAdcSRM{1..9}Cat = CAT1
      IrqDsadcPrioConfig
        IrqDsadcSRAPrioConfig:
          IrqDsadcSRA0Prio = 0
          IrqDsadcSRA{10..13}Prio = 0
          IrqDsadcSRA{1..9}Prio = 0
        IrqDsadcSRMPrioConfig:
          IrqDsadcSRM0Prio = 0
          IrqDsadcSRM{10..13}Prio = 0
          IrqDsadcSRM{1..9}Prio = 0
      IrqDsadcTosConfig
        IrqDsadcSRATosConfig:
          IrqDsadcSRA0Tos = CPU0
          IrqDsadcSRA{10..13}Tos = CPU0
          IrqDsadcSRA{1..9}Tos = CPU0
        IrqDsadcSRMTosConfig:
          IrqDsadcSRM0Tos = CPU0
          IrqDsadcSRM{10..13}Tos = CPU0
          IrqDsadcSRM{1..9}Tos = CPU0
    IrqETHConfig_0 (IrqETHConfig)
      IrqETHCatConfig:
        IrqETHSR0Cat = CAT1
        IrqETHSR1Cat = CAT1
        IrqETHSR2Cat = CAT2
        IrqETHSR{3..9}Cat = CAT1
      IrqETHPrioConfig:
        IrqETHSR0Prio = 0
        IrqETHSR1Prio = 0
        IrqETHSR2Prio = 50
        IrqETHSR{3..9}Prio = 0
      IrqETHTosConfig:
        IrqETHSR{0..9}Tos = CPU0
    IrqFlexRayConfig_0 (IrqFlexRayConfig)
      Irq_FlexRay0_Config
        Irq_FlexRay0Cat_Config:
          Irq_FlexRay0IBusy_Cat = CAT1
          Irq_FlexRay0INT0_Cat = CAT1
          Irq_FlexRay0INT1_Cat = CAT1
          Irq_FlexRay0MBSC0_Cat = CAT1
          Irq_FlexRay0MBSC1_Cat = CAT1
          Irq_FlexRay0NewData0_Cat = CAT1
          Irq_FlexRay0NewData1_Cat = CAT1
          Irq_FlexRay0OBusy_Cat = CAT1
          Irq_FlexRay0TimerInt0_Cat = CAT1
          Irq_FlexRay0TimerInt1_Cat = CAT1
        Irq_FlexRay0Prio_Config:
          Irq_FlexRay0IBusy_Prio = 0
          Irq_FlexRay0INT0_Prio = 0
          Irq_FlexRay0INT1_Prio = 0
          Irq_FlexRay0MBSC0_Prio = 0
          Irq_FlexRay0MBSC1_Prio = 0
          Irq_FlexRay0NewData0_Prio = 0
          Irq_FlexRay0NewData1_Prio = 0
          Irq_FlexRay0OBusy_Prio = 0
          Irq_FlexRay0TimerInt0_Prio = 0
          Irq_FlexRay0TimerInt1_Prio = 0
        Irq_FlexRay0Tos_Config:
          Irq_FlexRay0IBusy_Tos = CPU0
          Irq_FlexRay0INT0_Tos = CPU0
          Irq_FlexRay0INT1_Tos = CPU0
          Irq_FlexRay0MBSC0_Tos = CPU0
          Irq_FlexRay0MBSC1_Tos = CPU0
          Irq_FlexRay0NewData0_Tos = CPU0
          Irq_FlexRay0NewData1_Tos = CPU0
          Irq_FlexRay0OBusy_Tos = CPU0
          Irq_FlexRay0TimerInt0_Tos = CPU0
          Irq_FlexRay0TimerInt1_Tos = CPU0
      Irq_FlexRay1_Config
        Irq_FlexRay1Cat_Config:
          Irq_FlexRay1IBusy_Cat = CAT1
          Irq_FlexRay1INT0_Cat = CAT1
          Irq_FlexRay1INT1_Cat = CAT1
          Irq_FlexRay1MBSC0_Cat = CAT1
          Irq_FlexRay1MBSC1_Cat = CAT1
          Irq_FlexRay1NewData0_Cat = CAT1
          Irq_FlexRay1NewData1_Cat = CAT1
          Irq_FlexRay1OBusy_Cat = CAT1
          Irq_FlexRay1TimerInt0_Cat = CAT1
          Irq_FlexRay1TimerInt1_Cat = CAT1
        Irq_FlexRay1Prio_Config:
          Irq_FlexRay1IBusy_Prio = 0
          Irq_FlexRay1INT0_Prio = 0
          Irq_FlexRay1INT1_Prio = 0
          Irq_FlexRay1MBSC0_Prio = 0
          Irq_FlexRay1MBSC1_Prio = 0
          Irq_FlexRay1NewData0_Prio = 0
          Irq_FlexRay1NewData1_Prio = 0
          Irq_FlexRay1OBusy_Prio = 0
          Irq_FlexRay1TimerInt0_Prio = 0
          Irq_FlexRay1TimerInt1_Prio = 0
        Irq_FlexRay1Tos_Config:
          Irq_FlexRay1IBusy_Tos = CPU0
          Irq_FlexRay1INT0_Tos = CPU0
          Irq_FlexRay1INT1_Tos = CPU0
          Irq_FlexRay1MBSC0_Tos = CPU0
          Irq_FlexRay1MBSC1_Tos = CPU0
          Irq_FlexRay1NewData0_Tos = CPU0
          Irq_FlexRay1NewData1_Tos = CPU0
          Irq_FlexRay1OBusy_Tos = CPU0
          Irq_FlexRay1TimerInt0_Tos = CPU0
          Irq_FlexRay1TimerInt1_Tos = CPU0
    IrqGPSRGroupConfig_0 (IrqGPSRGroupConfig)
      Irq_GPSRGroup0_Config
        Irq_GPSRGroup0Cat_Config:
          Irq_GPSRGroup0SR{0..7}_Cat = CAT1
        Irq_GPSRGroup0Prio_Config:
          Irq_GPSRGroup0SR{0..7}_Prio = 0
        Irq_GPSRGroup0Tos_Config:
          Irq_GPSRGroup0SR{0..7}_Tos = CPU0
      Irq_GPSRGroup1_Config
        Irq_GPSRGroup1Cat_Config:
          Irq_GPSRGroup1SR{0..7}_Cat = CAT1
        Irq_GPSRGroup1Prio_Config:
          Irq_GPSRGroup1SR{0..7}_Prio = 0
        Irq_GPSRGroup1Tos_Config:
          Irq_GPSRGroup1SR{0..7}_Tos = CPU0
      Irq_GPSRGroup2_Config
        Irq_GPSRGroup2Cat_Config:
          Irq_GPSRGroup2SR{0..7}_Cat = CAT1
        Irq_GPSRGroup2Prio_Config:
          Irq_GPSRGroup2SR{0..7}_Prio = 0
        Irq_GPSRGroup2Tos_Config:
          Irq_GPSRGroup2SR{0..7}_Tos = CPU0
      Irq_GPSRGroup3_Config
        Irq_GPSRGroup3Cat_Config:
          Irq_GPSRGroup3SR{0..7}_Cat = CAT1
        Irq_GPSRGroup3Prio_Config:
          Irq_GPSRGroup3SR{0..7}_Prio = 0
        Irq_GPSRGroup3Tos_Config:
          Irq_GPSRGroup3SR{0..7}_Tos = CPU0
      Irq_GPSRGroup4_Config
        Irq_GPSRGroup4Cat_Config:
          Irq_GPSRGroup4SR{0..7}_Cat = CAT1
        Irq_GPSRGroup4Prio_Config:
          Irq_GPSRGroup4SR{0..7}_Prio = 0
        Irq_GPSRGroup4Tos_Config:
          Irq_GPSRGroup4SR{0..7}_Tos = CPU0
      Irq_GPSRGroup5_Config
        Irq_GPSRGroup5Cat_Config:
          Irq_GPSRGroup5SR{0..7}_Cat = CAT1
        Irq_GPSRGroup5Prio_Config:
          Irq_GPSRGroup5SR{0..7}_Prio = 0
        Irq_GPSRGroup5Tos_Config:
          Irq_GPSRGroup5SR{0..7}_Tos = CPU0
    IrqGPT120Config_0 (IrqGPT120Config)
      IrqGPT120CatConfig: Irq_GPT120CIRQ_Cat=CAT1, Irq_GPT120T2_Cat=CAT1, Irq_GPT120T3_Cat=CAT1, Irq_GPT120T4_Cat=CAT1, Irq_GPT120T5_Cat=CAT1, Irq_GPT120T6_Cat=CAT1
      IrqGPT120PrioConfig: Irq_GPT120CIRQ_Prio=0, Irq_GPT120T2_Prio=0, Irq_GPT120T3_Prio=0, Irq_GPT120T4_Prio=0, Irq_GPT120T5_Prio=0, Irq_GPT120T6_Prio=0
      IrqGPT120TosConfig: Irq_GPT120CIRQ_Tos=CPU0, Irq_GPT120T2_Tos=CPU0, Irq_GPT120T3_Tos=CPU0, Irq_GPT120T4_Tos=CPU0, Irq_GPT120T5_Tos=CPU0, Irq_GPT120T6_Tos=CPU0
    IrqGeneral: IrqOsekEnable=true
    IrqGtmConfig_0 (IrqGtmConfig)
      Irq_GtmAEI_Config
        Irq_GtmAEICat_Config: Irq_GtmAEI_Cat=CAT1
        Irq_GtmAEIPrio_Config: Irq_GtmAEI_Prio=0
        Irq_GtmAEITos_Config: Irq_GtmAEI_Tos=CPU0
      Irq_GtmARU_Config
        Irq_GtmARUCat_Config: Irq_GtmARUSR0_Cat=CAT1, Irq_GtmARUSR1_Cat=CAT1, Irq_GtmARUSR2_Cat=CAT1
        Irq_GtmARUPrio_Config: Irq_GtmARUSR0_Prio=0, Irq_GtmARUSR1_Prio=0, Irq_GtmARUSR2_Prio=0
        Irq_GtmARUTos_Config: Irq_GtmARUSR0_Tos=CPU0, Irq_GtmARUSR1_Tos=CPU0, Irq_GtmARUSR2_Tos=CPU0
      12 x Irq_GtmATOM_Config:
        Irq_GtmATOM0_Config
          IrqGtmATOMCatConfig: IrqGtmATOMSR0Cat=CAT1, IrqGtmATOMSR1Cat=CAT1, IrqGtmATOMSR2Cat=CAT1, IrqGtmATOMSR3Cat=CAT1
          IrqGtmATOMPrioConfig: IrqGtmATOMSR0Prio=0, IrqGtmATOMSR1Prio=0, IrqGtmATOMSR2Prio=0, IrqGtmATOMSR3Prio=0
          IrqGtmATOMTosConfig: IrqGtmATOMSR0Tos=CPU0, IrqGtmATOMSR1Tos=CPU0, IrqGtmATOMSR2Tos=CPU0, IrqGtmATOMSR3Tos=CPU0
        Irq_GtmATOM10_Config
          IrqGtmATOMCatConfig: IrqGtmATOMSR0Cat=CAT1, IrqGtmATOMSR1Cat=CAT1, IrqGtmATOMSR2Cat=CAT1, IrqGtmATOMSR3Cat=CAT1
          IrqGtmATOMPrioConfig: IrqGtmATOMSR0Prio=0, IrqGtmATOMSR1Prio=0, IrqGtmATOMSR2Prio=0, IrqGtmATOMSR3Prio=0
          IrqGtmATOMTosConfig: IrqGtmATOMSR0Tos=CPU0, IrqGtmATOMSR1Tos=CPU0, IrqGtmATOMSR2Tos=CPU0, IrqGtmATOMSR3Tos=CPU0
        Irq_GtmATOM11_Config
          IrqGtmATOMCatConfig: IrqGtmATOMSR0Cat=CAT1, IrqGtmATOMSR1Cat=CAT1, IrqGtmATOMSR2Cat=CAT1, IrqGtmATOMSR3Cat=CAT1
          IrqGtmATOMPrioConfig: IrqGtmATOMSR0Prio=0, IrqGtmATOMSR1Prio=0, IrqGtmATOMSR2Prio=0, IrqGtmATOMSR3Prio=0
          IrqGtmATOMTosConfig: IrqGtmATOMSR0Tos=CPU0, IrqGtmATOMSR1Tos=CPU0, IrqGtmATOMSR2Tos=CPU0, IrqGtmATOMSR3Tos=CPU0
        Irq_GtmATOM1_Config
          IrqGtmATOMCatConfig: IrqGtmATOMSR0Cat=CAT1, IrqGtmATOMSR1Cat=CAT1, IrqGtmATOMSR2Cat=CAT1, IrqGtmATOMSR3Cat=CAT1
          IrqGtmATOMPrioConfig: IrqGtmATOMSR0Prio=0, IrqGtmATOMSR1Prio=0, IrqGtmATOMSR2Prio=0, IrqGtmATOMSR3Prio=0
          IrqGtmATOMTosConfig: IrqGtmATOMSR0Tos=CPU0, IrqGtmATOMSR1Tos=CPU0, IrqGtmATOMSR2Tos=CPU0, IrqGtmATOMSR3Tos=CPU0
        Irq_GtmATOM2_Config
          IrqGtmATOMCatConfig: IrqGtmATOMSR0Cat=CAT1, IrqGtmATOMSR1Cat=CAT1, IrqGtmATOMSR2Cat=CAT1, IrqGtmATOMSR3Cat=CAT1
          IrqGtmATOMPrioConfig: IrqGtmATOMSR0Prio=0, IrqGtmATOMSR1Prio=0, IrqGtmATOMSR2Prio=0, IrqGtmATOMSR3Prio=0
          IrqGtmATOMTosConfig: IrqGtmATOMSR0Tos=CPU0, IrqGtmATOMSR1Tos=CPU0, IrqGtmATOMSR2Tos=CPU0, IrqGtmATOMSR3Tos=CPU0
        Irq_GtmATOM3_Config
          IrqGtmATOMCatConfig: IrqGtmATOMSR0Cat=CAT1, IrqGtmATOMSR1Cat=CAT1, IrqGtmATOMSR2Cat=CAT1, IrqGtmATOMSR3Cat=CAT1
          IrqGtmATOMPrioConfig: IrqGtmATOMSR0Prio=0, IrqGtmATOMSR1Prio=0, IrqGtmATOMSR2Prio=0, IrqGtmATOMSR3Prio=0
          IrqGtmATOMTosConfig: IrqGtmATOMSR0Tos=CPU0, IrqGtmATOMSR1Tos=CPU0, IrqGtmATOMSR2Tos=CPU0, IrqGtmATOMSR3Tos=CPU0
        Irq_GtmATOM4_Config
          IrqGtmATOMCatConfig: IrqGtmATOMSR0Cat=CAT1, IrqGtmATOMSR1Cat=CAT1, IrqGtmATOMSR2Cat=CAT1, IrqGtmATOMSR3Cat=CAT1
          IrqGtmATOMPrioConfig: IrqGtmATOMSR0Prio=0, IrqGtmATOMSR1Prio=0, IrqGtmATOMSR2Prio=0, IrqGtmATOMSR3Prio=0
          IrqGtmATOMTosConfig: IrqGtmATOMSR0Tos=CPU0, IrqGtmATOMSR1Tos=CPU0, IrqGtmATOMSR2Tos=CPU0, IrqGtmATOMSR3Tos=CPU0
        Irq_GtmATOM5_Config
          IrqGtmATOMCatConfig: IrqGtmATOMSR0Cat=CAT1, IrqGtmATOMSR1Cat=CAT1, IrqGtmATOMSR2Cat=CAT1, IrqGtmATOMSR3Cat=CAT1
          IrqGtmATOMPrioConfig: IrqGtmATOMSR0Prio=0, IrqGtmATOMSR1Prio=0, IrqGtmATOMSR2Prio=0, IrqGtmATOMSR3Prio=0
          IrqGtmATOMTosConfig: IrqGtmATOMSR0Tos=CPU0, IrqGtmATOMSR1Tos=CPU0, IrqGtmATOMSR2Tos=CPU0, IrqGtmATOMSR3Tos=CPU0
        Irq_GtmATOM6_Config
          IrqGtmATOMCatConfig: IrqGtmATOMSR0Cat=CAT1, IrqGtmATOMSR1Cat=CAT1, IrqGtmATOMSR2Cat=CAT1, IrqGtmATOMSR3Cat=CAT1
          IrqGtmATOMPrioConfig: IrqGtmATOMSR0Prio=0, IrqGtmATOMSR1Prio=0, IrqGtmATOMSR2Prio=0, IrqGtmATOMSR3Prio=0
          IrqGtmATOMTosConfig: IrqGtmATOMSR0Tos=CPU0, IrqGtmATOMSR1Tos=CPU0, IrqGtmATOMSR2Tos=CPU0, IrqGtmATOMSR3Tos=CPU0
        Irq_GtmATOM7_Config
          IrqGtmATOMCatConfig: IrqGtmATOMSR0Cat=CAT1, IrqGtmATOMSR1Cat=CAT1, IrqGtmATOMSR2Cat=CAT1, IrqGtmATOMSR3Cat=CAT1
          IrqGtmATOMPrioConfig: IrqGtmATOMSR0Prio=0, IrqGtmATOMSR1Prio=0, IrqGtmATOMSR2Prio=0, IrqGtmATOMSR3Prio=0
          IrqGtmATOMTosConfig: IrqGtmATOMSR0Tos=CPU0, IrqGtmATOMSR1Tos=CPU0, IrqGtmATOMSR2Tos=CPU0, IrqGtmATOMSR3Tos=CPU0
        Irq_GtmATOM8_Config
          IrqGtmATOMCatConfig: IrqGtmATOMSR0Cat=CAT1, IrqGtmATOMSR1Cat=CAT1, IrqGtmATOMSR2Cat=CAT1, IrqGtmATOMSR3Cat=CAT1
          IrqGtmATOMPrioConfig: IrqGtmATOMSR0Prio=0, IrqGtmATOMSR1Prio=0, IrqGtmATOMSR2Prio=0, IrqGtmATOMSR3Prio=0
          IrqGtmATOMTosConfig: IrqGtmATOMSR0Tos=CPU0, IrqGtmATOMSR1Tos=CPU0, IrqGtmATOMSR2Tos=CPU0, IrqGtmATOMSR3Tos=CPU0
        Irq_GtmATOM9_Config
          IrqGtmATOMCatConfig: IrqGtmATOMSR0Cat=CAT1, IrqGtmATOMSR1Cat=CAT1, IrqGtmATOMSR2Cat=CAT1, IrqGtmATOMSR3Cat=CAT1
          IrqGtmATOMPrioConfig: IrqGtmATOMSR0Prio=0, IrqGtmATOMSR1Prio=0, IrqGtmATOMSR2Prio=0, IrqGtmATOMSR3Prio=0
          IrqGtmATOMTosConfig: IrqGtmATOMSR0Tos=CPU0, IrqGtmATOMSR1Tos=CPU0, IrqGtmATOMSR2Tos=CPU0, IrqGtmATOMSR3Tos=CPU0
      Irq_GtmBRC_Config
        Irq_GtmBRCCat_Config: Irq_GtmBRC_Cat=CAT1
        Irq_GtmBRCPrio_Config: Irq_GtmBRC_Prio=0
        Irq_GtmBRCTos_Config: IrqGtmBRCTos=CPU0
      Irq_GtmCMP_Config
        Irq_GtmCMPCat_Config: Irq_GtmCMP_Cat=CAT1
        Irq_GtmCMPPrio_Config: Irq_GtmCMP_Prio=0
        Irq_GtmCMPTos_Config: Irq_GtmCMP_Tos=CPU0
      27 x Irq_GtmDPLL_Config, all with Irq_GtmDPLLSR_Cat=CAT1, Irq_GtmDPLLSR_Prio=0, Irq_GtmDPLLSR_Tos=CPU0:
        Irq_GtmDPLLSR0_Config
        Irq_GtmDPLLSR{10..19}_Config
        Irq_GtmDPLLSR1_Config
        Irq_GtmDPLLSR{20..26}_Config
        Irq_GtmDPLLSR{2..9}_Config
      Irq_GtmERR_Config
        Irq_GtmERRCat_Config: Irq_GtmERRSR_Cat=CAT1
        Irq_GtmERRPrio_Config: Irq_GtmERRSR_Prio=0
        Irq_GtmERRTos_Config: IrqGtmERRSRTos=CPU0
      Irq_GtmMCSW_Config
        IrqGtmMCSWCatConfig:
          IrqGtmMCSW{0..9}Cat = CAT1
        IrqGtmMCSWPrioConfig:
          IrqGtmMCSW{0..9}Prio = 0
        IrqGtmMCSWTosConfig:
          IrqGtmMCSW{0..9}Tos = CPU0
      10 x Irq_GtmMCS_Config:
        Irq_GtmMCS0_Config
          IrqGtmMCSCatConfig:
            IrqGtmMCSSR{0..7}Cat = CAT1
          IrqGtmMCSPrioConfig:
            IrqGtmMCSSR{0..7}Prio = 0
          IrqGtmMCSTosConfig:
            IrqGtmMCSSR{0..7}Tos = CPU0
        Irq_GtmMCS1_Config
          IrqGtmMCSCatConfig:
            IrqGtmMCSSR{0..7}Cat = CAT1
          IrqGtmMCSPrioConfig:
            IrqGtmMCSSR{0..7}Prio = 0
          IrqGtmMCSTosConfig:
            IrqGtmMCSSR{0..7}Tos = CPU0
        Irq_GtmMCS2_Config
          IrqGtmMCSCatConfig:
            IrqGtmMCSSR{0..7}Cat = CAT1
          IrqGtmMCSPrioConfig:
            IrqGtmMCSSR{0..7}Prio = 0
          IrqGtmMCSTosConfig:
            IrqGtmMCSSR{0..7}Tos = CPU0
        Irq_GtmMCS3_Config
          IrqGtmMCSCatConfig:
            IrqGtmMCSSR{0..7}Cat = CAT1
          IrqGtmMCSPrioConfig:
            IrqGtmMCSSR{0..7}Prio = 0
          IrqGtmMCSTosConfig:
            IrqGtmMCSSR{0..7}Tos = CPU0
        Irq_GtmMCS4_Config
          IrqGtmMCSCatConfig:
            IrqGtmMCSSR{0..7}Cat = CAT1
          IrqGtmMCSPrioConfig:
            IrqGtmMCSSR{0..7}Prio = 0
          IrqGtmMCSTosConfig:
            IrqGtmMCSSR{0..7}Tos = CPU0
        Irq_GtmMCS5_Config
          IrqGtmMCSCatConfig:
            IrqGtmMCSSR{0..7}Cat = CAT1
          IrqGtmMCSPrioConfig:
            IrqGtmMCSSR{0..7}Prio = 0
          IrqGtmMCSTosConfig:
            IrqGtmMCSSR{0..7}Tos = CPU0
        Irq_GtmMCS6_Config
          IrqGtmMCSCatConfig:
            IrqGtmMCSSR{0..7}Cat = CAT1
          IrqGtmMCSPrioConfig:
            IrqGtmMCSSR{0..7}Prio = 0
          IrqGtmMCSTosConfig:
            IrqGtmMCSSR{0..7}Tos = CPU0
        Irq_GtmMCS7_Config
          IrqGtmMCSCatConfig:
            IrqGtmMCSSR{0..7}Cat = CAT1
          IrqGtmMCSPrioConfig:
            IrqGtmMCSSR{0..7}Prio = 0
          IrqGtmMCSTosConfig:
            IrqGtmMCSSR{0..7}Tos = CPU0
        Irq_GtmMCS8_Config
          IrqGtmMCSCatConfig:
            IrqGtmMCSSR{0..7}Cat = CAT1
          IrqGtmMCSPrioConfig:
            IrqGtmMCSSR{0..7}Prio = 0
          IrqGtmMCSTosConfig:
            IrqGtmMCSSR{0..7}Tos = CPU0
        Irq_GtmMCS9_Config
          IrqGtmMCSCatConfig:
            IrqGtmMCSSR{0..7}Cat = CAT1
          IrqGtmMCSPrioConfig:
            IrqGtmMCSSR{0..7}Prio = 0
          IrqGtmMCSTosConfig:
            IrqGtmMCSSR{0..7}Tos = CPU0
      Irq_GtmPSM0_Config
        Irq_GtmPSM0Cat_Config:
          Irq_GtmPSM0SR{0..7}_Cat = CAT1
        Irq_GtmPSM0Prio_Config:
          IrqGtmPSM0SR0Prio = 0
          Irq_GtmPSM0SR{1..7}_Prio = 0
        Irq_GtmPSM0Tos_Config:
          IrqGtmPSM0SR0Tos = CPU0
          Irq_GtmPSM0SR{1..7}_Tos = CPU0
      Irq_GtmPSM1_Config
        Irq_GtmPSM1Cat_Config:
          Irq_GtmPSM1SR{0..7}_Cat = CAT1
        Irq_GtmPSM1Prio_Config:
          IrqGtmPSM1SR0Prio = 0
          Irq_GtmPSM1SR{1..7}_Prio = 0
        Irq_GtmPSM1Tos_Config:
          IrqGtmPSM1SR0Tos = CPU0
          Irq_GtmPSM1SR{1..7}_Tos = CPU0
      Irq_GtmPSM2_Config
        Irq_GtmPSM2Cat_Config:
          Irq_GtmPSM2SR{0..7}_Cat = CAT1
        Irq_GtmPSM2Prio_Config:
          IrqGtmPSM2SR0Prio = 0
          Irq_GtmPSM2SR{1..7}_Prio = 0
        Irq_GtmPSM2Tos_Config:
          IrqGtmPSM2SR0Tos = CPU0
          Irq_GtmPSM2SR{1..7}_Tos = CPU0
      Irq_GtmSPE_Config
        Irq_GtmSPECat_Config: Irq_GtmSPE0_Cat=CAT1, Irq_GtmSPE1_Cat=CAT1, Irq_GtmSPE2_Cat=CAT1, Irq_GtmSPE3_Cat=CAT1, Irq_GtmSPE4_Cat=CAT1, Irq_GtmSPE5_Cat=CAT1
        Irq_GtmSPEPrio_Config: Irq_GtmSPE0_Prio=0, Irq_GtmSPE1_Prio=0, Irq_GtmSPE2_Prio=0, Irq_GtmSPE3_Prio=0, Irq_GtmSPE4_Prio=0, Irq_GtmSPE5_Prio=0
        Irq_GtmSPETos_Config: Irq_GtmSPE0_Tos=CPU0, Irq_GtmSPE1_Tos=CPU0, Irq_GtmSPE2_Tos=CPU0, Irq_GtmSPE3_Tos=CPU0, Irq_GtmSPE4_Tos=CPU0, Irq_GtmSPE5_Tos=CPU0
      8 x Irq_GtmTIM_Config:
        Irq_GtmTIM0_Config
          IrqGtmTIMCatConfig:
            IrqGtmTIMSR{0..7}Cat = CAT1
          IrqGtmTIMPrioConfig:
            IrqGtmTIMSR{0..7}Prio = 0
          IrqGtmTIMTosConfig:
            IrqGtmTIMSR{0..7}Tos = CPU0
        Irq_GtmTIM1_Config
          IrqGtmTIMCatConfig:
            IrqGtmTIMSR{0..7}Cat = CAT1
          IrqGtmTIMPrioConfig:
            IrqGtmTIMSR{0..7}Prio = 0
          IrqGtmTIMTosConfig:
            IrqGtmTIMSR{0..7}Tos = CPU0
        Irq_GtmTIM2_Config
          IrqGtmTIMCatConfig:
            IrqGtmTIMSR{0..7}Cat = CAT1
          IrqGtmTIMPrioConfig:
            IrqGtmTIMSR{0..7}Prio = 0
          IrqGtmTIMTosConfig:
            IrqGtmTIMSR{0..7}Tos = CPU0
        Irq_GtmTIM3_Config
          IrqGtmTIMCatConfig:
            IrqGtmTIMSR{0..7}Cat = CAT1
          IrqGtmTIMPrioConfig:
            IrqGtmTIMSR{0..7}Prio = 0
          IrqGtmTIMTosConfig:
            IrqGtmTIMSR{0..7}Tos = CPU0
        Irq_GtmTIM4_Config
          IrqGtmTIMCatConfig:
            IrqGtmTIMSR{0..7}Cat = CAT1
          IrqGtmTIMPrioConfig:
            IrqGtmTIMSR{0..7}Prio = 0
          IrqGtmTIMTosConfig:
            IrqGtmTIMSR{0..7}Tos = CPU0
        Irq_GtmTIM5_Config
          IrqGtmTIMCatConfig:
            IrqGtmTIMSR{0..7}Cat = CAT1
          IrqGtmTIMPrioConfig:
            IrqGtmTIMSR{0..7}Prio = 0
          IrqGtmTIMTosConfig:
            IrqGtmTIMSR{0..7}Tos = CPU0
        Irq_GtmTIM6_Config
          IrqGtmTIMCatConfig:
            IrqGtmTIMSR{0..7}Cat = CAT1
          IrqGtmTIMPrioConfig:
            IrqGtmTIMSR{0..7}Prio = 0
          IrqGtmTIMTosConfig:
            IrqGtmTIMSR{0..7}Tos = CPU0
        Irq_GtmTIM7_Config
          IrqGtmTIMCatConfig:
            IrqGtmTIMSR{0..7}Cat = CAT1
          IrqGtmTIMPrioConfig:
            IrqGtmTIMSR{0..7}Prio = 0
          IrqGtmTIMTosConfig:
            IrqGtmTIMSR{0..7}Tos = CPU0
      6 x Irq_GtmTOM_Config:
        Irq_GtmTOM0_Config
          IrqGtmTOMCatConfig:
            IrqGtmTOMSR{0..7}Cat = CAT1
          IrqGtmTOMPrioConfig:
            IrqGtmTOMSR{0..7}Prio = 0
          IrqGtmTOMTosConfig:
            IrqGtmTOMSR{0..7}Tos = CPU0
        Irq_GtmTOM1_Config
          IrqGtmTOMCatConfig:
            IrqGtmTOMSR{0..7}Cat = CAT1
          IrqGtmTOMPrioConfig:
            IrqGtmTOMSR{0..7}Prio = 0
          IrqGtmTOMTosConfig:
            IrqGtmTOMSR{0..7}Tos = CPU0
        Irq_GtmTOM2_Config
          IrqGtmTOMCatConfig:
            IrqGtmTOMSR{0..7}Cat = CAT1
          IrqGtmTOMPrioConfig:
            IrqGtmTOMSR{0..7}Prio = 0
          IrqGtmTOMTosConfig:
            IrqGtmTOMSR{0..7}Tos = CPU0
        Irq_GtmTOM3_Config
          IrqGtmTOMCatConfig:
            IrqGtmTOMSR{0..7}Cat = CAT1
          IrqGtmTOMPrioConfig:
            IrqGtmTOMSR{0..7}Prio = 0
          IrqGtmTOMTosConfig:
            IrqGtmTOMSR{0..7}Tos = CPU0
        Irq_GtmTOM4_Config
          IrqGtmTOMCatConfig:
            IrqGtmTOMSR{0..7}Cat = CAT1
          IrqGtmTOMPrioConfig:
            IrqGtmTOMSR{0..7}Prio = 0
          IrqGtmTOMTosConfig:
            IrqGtmTOMSR{0..7}Tos = CPU0
        Irq_GtmTOM5_Config
          IrqGtmTOMCatConfig:
            IrqGtmTOMSR{0..7}Cat = CAT1
          IrqGtmTOMPrioConfig:
            IrqGtmTOMSR{0..7}Prio = 0
          IrqGtmTOMTosConfig:
            IrqGtmTOMSR{0..7}Tos = CPU0
    IrqHsslConfig_0 (IrqHsslConfig)
      IrqHssl0Config
        IrqHssl0CatConfig
          IrqHssl0COKCatConfig: IrqHssl0COK_0Cat=CAT1, IrqHssl0COK_1Cat=CAT1, IrqHssl0COK_2Cat=CAT1, IrqHssl0COK_3Cat=CAT1
          IrqHssl0ERRCatConfig: IrqHssl0ERR_0Cat=CAT1, IrqHssl0ERR_1Cat=CAT1, IrqHssl0ERR_2Cat=CAT1, IrqHssl0ERR_3Cat=CAT1
          IrqHssl0EXICatConfig: IrqHssl0EXICat=CAT1
          IrqHssl0RDICatConfig: IrqHssl0RDI_0Cat=CAT1, IrqHssl0RDI_1Cat=CAT1, IrqHssl0RDI_2Cat=CAT1, IrqHssl0RDI_3Cat=CAT1
          IrqHssl0TRGCatConfig: IrqHssl0TRG_0Cat=CAT1, IrqHssl0TRG_1Cat=CAT1, IrqHssl0TRG_2Cat=CAT1, IrqHssl0TRG_3Cat=CAT1
        IrqHssl0PrioConfig
          IrqHssl0COKPrioConfig: IrqHssl0COK_0Prio=0, IrqHssl0COK_1Prio=0, IrqHssl0COK_2Prio=0, IrqHssl0COK_3Prio=0
          IrqHssl0ERRPrioConfig: IrqHssl0ERR_0Prio=0, IrqHssl0ERR_1Prio=0, IrqHssl0ERR_2Prio=0, IrqHssl0ERR_3Prio=0
          IrqHssl0EXIPrioConfig: IrqHssl0EXIPrio=0
          IrqHssl0RDIPrioConfig: IrqHssl0RDI_0Prio=0, IrqHssl0RDI_1Prio=0, IrqHssl0RDI_2Prio=0, IrqHssl0RDI_3Prio=0
          IrqHssl0TRGPrioConfig: IrqHssl0TRG_0Prio=0, IrqHssl0TRG_1Prio=0, IrqHssl0TRG_2Prio=0, IrqHssl0TRG_3Prio=0
        IrqHssl0TosConfig
          IrqHssl0COKTosConfig: IrqHssl0COK_0Tos=CPU0, IrqHssl0COK_1Tos=CPU0, IrqHssl0COK_2Tos=CPU0, IrqHssl0COK_3Tos=CPU0
          IrqHssl0ERRTosConfig: IrqHssl0ERR_0Tos=CPU0, IrqHssl0ERR_1Tos=CPU0, IrqHssl0ERR_2Tos=CPU0, IrqHssl0ERR_3Tos=CPU0
          IrqHssl0EXITosConfig: IrqHssl0EXITos=CPU0
          IrqHssl0RDITosConfig: IrqHssl0RDI_0Tos=CPU0, IrqHssl0RDI_1Tos=CPU0, IrqHssl0RDI_2Tos=CPU0, IrqHssl0RDI_3Tos=CPU0
          IrqHssl0TRGTosConfig: IrqHssl0TRG_0Tos=CPU0, IrqHssl0TRG_1Tos=CPU0, IrqHssl0TRG_2Tos=CPU0, IrqHssl0TRG_3Tos=CPU0
      IrqHssl1Config
        IrqHssl1CatConfig
          IrqHssl1COKCatConfig: IrqHssl1COK_0Cat=CAT1, IrqHssl1COK_1Cat=CAT1, IrqHssl1COK_2Cat=CAT1, IrqHssl1COK_3Cat=CAT1
          IrqHssl1ERRCatConfig: IrqHssl1ERR_0Cat=CAT1, IrqHssl1ERR_1Cat=CAT1, IrqHssl1ERR_2Cat=CAT1, IrqHssl1ERR_3Cat=CAT1
          IrqHssl1EXICatConfig: IrqHssl1EXICat=CAT1
          IrqHssl1RDICatConfig: IrqHssl1RDI_0Cat=CAT1, IrqHssl1RDI_1Cat=CAT1, IrqHssl1RDI_2Cat=CAT1, IrqHssl1RDI_3Cat=CAT1
          IrqHssl1TRGCatConfig: IrqHssl1TRG_0Cat=CAT1, IrqHssl1TRG_1Cat=CAT1, IrqHssl1TRG_2Cat=CAT1, IrqHssl1TRG_3Cat=CAT1
        IrqHssl1PrioConfig
          IrqHssl1COKPrioConfig: IrqHssl1COK_0Prio=0, IrqHssl1COK_1Prio=0, IrqHssl1COK_2Prio=0, IrqHssl1COK_3Prio=0
          IrqHssl1ERRPrioConfig: IrqHssl1ERR_0Prio=0, IrqHssl1ERR_1Prio=0, IrqHssl1ERR_2Prio=0, IrqHssl1ERR_3Prio=0
          IrqHssl1EXIPrioConfig: IrqHssl1EXIPrio=0
          IrqHssl1RDIPrioConfig: IrqHssl1RDI_0Prio=0, IrqHssl1RDI_1Prio=0, IrqHssl1RDI_2Prio=0, IrqHssl1RDI_3Prio=0
          IrqHssl1TRGPrioConfig: IrqHssl1TRG_0Prio=0, IrqHssl1TRG_1Prio=0, IrqHssl1TRG_2Prio=0, IrqHssl1TRG_3Prio=0
        IrqHssl1TosConfig
          IrqHssl1COKTosConfig: IrqHssl1COK_0Tos=CPU0, IrqHssl1COK_1Tos=CPU0, IrqHssl1COK_2Tos=CPU0, IrqHssl1COK_3Tos=CPU0
          IrqHssl1ERRTosConfig: IrqHssl1ERR_0Tos=CPU0, IrqHssl1ERR_1Tos=CPU0, IrqHssl1ERR_2Tos=CPU0, IrqHssl1ERR_3Tos=CPU0
          IrqHssl1EXITosConfig: IrqHssl1EXITos=CPU0
          IrqHssl1RDITosConfig: IrqHssl1RDI_0Tos=CPU0, IrqHssl1RDI_1Tos=CPU0, IrqHssl1RDI_2Tos=CPU0, IrqHssl1RDI_3Tos=CPU0
          IrqHssl1TRGTosConfig: IrqHssl1TRG_0Tos=CPU0, IrqHssl1TRG_1Tos=CPU0, IrqHssl1TRG_2Tos=CPU0, IrqHssl1TRG_3Tos=CPU0
    IrqI2cConfig_0 (IrqI2cConfig)
      IrqI2cCatConfig
        IrqI2cDtrCatConfig: IrqI2c0DtrCat=CAT1, IrqI2c1DtrCat=CAT1
        IrqI2cErrCatConfig: IrqI2c0ErrCat=CAT1, IrqI2c1ErrCat=CAT1
        IrqI2cPCatConfig: IrqI2c0PCat=CAT1, IrqI2c1PCat=CAT1
      IrqI2cPrioConfig
        IrqI2cDtrPrioConfig: IrqI2c0DtrPrio=0, IrqI2c1DtrPrio=0
        IrqI2cErrPrioConfig: IrqI2c0ErrPrio=0, IrqI2c1ErrPrio=0
        IrqI2cPPrioConfig: IrqI2c0PPrio=0, IrqI2c1PPrio=0
      IrqI2cTosConfig
        IrqI2cDtrTosConfig: IrqI2c0DtrTos=CPU0, IrqI2c1DtrTos=CPU0
        IrqI2cErrTosConfig: IrqI2c0ErrTos=CPU0, IrqI2c1ErrTos=CPU0
        IrqI2cPTosConfig: IrqI2c0PTos=CPU0, IrqI2c1PTos=CPU0
    IrqQSPIConfig_0 (IrqQSPIConfig)
      IrqQspiCatConfig
        IrqQspiErrCatConfig: IrqQspi0ErrCat=CAT1, IrqQspi1ErrCat=CAT1, IrqQspi2ErrCat=CAT1, IrqQspi3ErrCat=CAT1, IrqQspi4ErrCat=CAT1, IrqQspi5ErrCat=CAT1
        IrqQspiHCCatConfig: IrqQspi2HCCat=CAT1, IrqQspi3HCCat=CAT1
        IrqQspiPTCatConfig: IrqQspi0PTCat=CAT1, IrqQspi1PTCat=CAT1, IrqQspi2PTCat=CAT1, IrqQspi3PTCat=CAT1, IrqQspi4PTCat=CAT1, IrqQspi5PTCat=CAT1
        IrqQspiRxCatConfig: IrqQspi0RxCat=CAT1, IrqQspi1RxCat=CAT1, IrqQspi2RxCat=CAT1, IrqQspi3RxCat=CAT1, IrqQspi4RxCat=CAT1, IrqQspi5RxCat=CAT1
        IrqQspiTxCatConfig: IrqQspi0TxCat=CAT1, IrqQspi1TxCat=CAT1, IrqQspi2TxCat=CAT1, IrqQspi3TxCat=CAT1, IrqQspi4TxCat=CAT1, IrqQspi5TxCat=CAT1
        IrqQspiUDCatConfig: IrqQspi0UDCat=CAT1, IrqQspi1UDCat=CAT1, IrqQspi2UDCat=CAT1, IrqQspi3UDCat=CAT1, IrqQspi4UDCat=CAT1, IrqQspi5UDCat=CAT1
      IrqQspiPrioConfig
        IrqQspiErrPrioConfig: IrqQspi0ErrPrio=0, IrqQspi1ErrPrio=0, IrqQspi2ErrPrio=0, IrqQspi3ErrPrio=0, IrqQspi4ErrPrio=0, IrqQspi5ErrPrio=0
        IrqQspiHCPrioConfig: IrqQspi2HCPrio=0, IrqQspi3HCPrio=0
        IrqQspiPTPrioConfig: IrqQspi0PTPrio=0, IrqQspi1PTPrio=0, IrqQspi2PTPrio=0, IrqQspi3PTPrio=0, IrqQspi4PTPrio=0, IrqQspi5PTPrio=0
        IrqQspiRxPrioConfig: IrqQspi0RxPrio=0, IrqQspi1RxPrio=0, IrqQspi2RxPrio=0, IrqQspi3RxPrio=0, IrqQspi4RxPrio=0, IrqQspi5RxPrio=0
        IrqQspiTxPrioConfig: IrqQspi0TxPrio=0, IrqQspi1TxPrio=0, IrqQspi2TxPrio=0, IrqQspi3TxPrio=0, IrqQspi4TxPrio=0, IrqQspi5TxPrio=0
        IrqQspiUDPrioConfig: IrqQspi0UDPrio=0, IrqQspi1UDPrio=0, IrqQspi2UDPrio=0, IrqQspi3UDPrio=0, IrqQspi4UDPrio=0, IrqQspi5UDPrio=0
      IrqQspiTosConfig
        IrqQspiErrTosConfig: IrqQspi0ErrTos=CPU0, IrqQspi1ErrTos=CPU0, IrqQspi2ErrTos=CPU0, IrqQspi3ErrTos=CPU0, IrqQspi4ErrTos=CPU0, IrqQspi5ErrTos=CPU0
        IrqQspiHCTosConfig: IrqQspi2HCTos=CPU0, IrqQspi3HCTos=CPU0
        IrqQspiPTTosConfig: IrqQspi0PTTos=CPU0, IrqQspi1PTTos=CPU0, IrqQspi2PTTos=CPU0, IrqQspi3PTTos=CPU0, IrqQspi4PTTos=CPU0, IrqQspi5PTTos=CPU0
        IrqQspiRxTosConfig: IrqQspi0RxTos=CPU0, IrqQspi1RxTos=CPU0, IrqQspi2RxTos=CPU0, IrqQspi3RxTos=CPU0, IrqQspi4RxTos=CPU0, IrqQspi5RxTos=CPU0
        IrqQspiTxTosConfig: IrqQspi0TxTos=CPU0, IrqQspi1TxTos=CPU0, IrqQspi2TxTos=CPU0, IrqQspi3TxTos=CPU0, IrqQspi4TxTos=CPU0, IrqQspi5TxTos=CPU0
        IrqQspiUDTosConfig: IrqQspi0UDTos=CPU0, IrqQspi1UDTos=CPU0, IrqQspi2UDTos=CPU0, IrqQspi3UDTos=CPU0, IrqQspi4UDTos=CPU0, IrqQspi5UDTos=CPU0
    IrqScuConfig_0 (IrqScuConfig)
      Irq_ScuCat_Config: Irq_ScuEruSR0_Cat=CAT1, Irq_ScuEruSR1_Cat=CAT1, Irq_ScuEruSR2_Cat=CAT1, Irq_ScuEruSR3_Cat=CAT1
      Irq_ScuPrio_Config: Irq_ScuEruSR0_Prio=0, Irq_ScuEruSR1_Prio=0, Irq_ScuEruSR2_Prio=0, Irq_ScuEruSR3_Prio=0
      Irq_ScuTos_Config: Irq_ScuEruSR0_Tos=CPU0, Irq_ScuEruSR1_Tos=CPU0, Irq_ScuEruSR2_Tos=CPU0, Irq_ScuEruSR3_Tos=CPU0
    IrqSentConfig_0 (IrqSentConfig)
      IrqSentCatConfig:
        IrqSentSR{0..9}Cat = CAT1
      IrqSentPrioConfig:
        IrqSentSR{0..9}Prio = 0
      IrqSentTosConfig:
        IrqSentSR{0..9}Tos = CPU0
    IrqStmConfig_0 (IrqStmConfig)
      IrqStm0Config
        IrqStm0CatConfig: IrqStm0SR0Cat=CAT1, IrqStm0SR1Cat=CAT1
        IrqStm0PrioConfig: IrqStm0SR0Prio=0, IrqStm0SR1Prio=0
        IrqStm0TosConfig: IrqStm0SR0Tos=CPU0, IrqStm0SR1Tos=CPU0
      IrqStm1Config
        IrqStm1CatConfig: IrqStm1SR0Cat=CAT1, IrqStm1SR1Cat=CAT1
        IrqStm1PrioConfig: IrqStm1SR0Prio=0, IrqStm1SR1Prio=0
        IrqStm1TosConfig: IrqStm1SR0Tos=CPU0, IrqStm1SR1Tos=CPU0
      IrqStm2Config
        IrqStm2CatConfig: IrqStm2SR0Cat=CAT1, IrqStm2SR1Cat=CAT1
        IrqStm2PrioConfig: IrqStm2SR0Prio=0, IrqStm2SR1Prio=0
        IrqStm2TosConfig: IrqStm2SR0Tos=CPU0, IrqStm2SR1Tos=CPU0
      IrqStm3Config
        IrqStm3CatConfig: IrqStm3SR0Cat=CAT1, IrqStm3SR1Cat=CAT1
        IrqStm3PrioConfig: IrqStm3SR0Prio=0, IrqStm3SR1Prio=0
        IrqStm3TosConfig: IrqStm3SR0Tos=CPU0, IrqStm3SR1Tos=CPU0
      IrqStm4Config
        IrqStm4CatConfig: IrqStm4SR0Cat=CAT1, IrqStm4SR1Cat=CAT1
        IrqStm4PrioConfig: IrqStm4SR0Prio=0, IrqStm4SR1Prio=0
        IrqStm4TosConfig: IrqStm4SR0Tos=CPU0, IrqStm4SR1Tos=CPU0
      IrqStm5Config
        IrqStm5CatConfig: IrqStm5SR0Cat=CAT1, IrqStm5SR1Cat=CAT1
        IrqStm5PrioConfig: IrqStm5SR0Prio=0, IrqStm5SR1Prio=0
        IrqStm5TosConfig: IrqStm5SR0Tos=CPU0, IrqStm5SR1Tos=CPU0
