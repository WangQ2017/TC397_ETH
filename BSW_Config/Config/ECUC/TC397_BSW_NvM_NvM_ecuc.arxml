AUTOSAR XML (schema 00048)
package /ActiveEcuC
  module config NvM: implementation-config-variant=VARIANT-PRE-COMPILE, module-description=NvM_Impl
    NvMConfigBlock (NvMBlockDescriptor):
      NvMBlockCrcType = NVM_CRC16
      NvMBlockManagementType = NVM_BLOCK_REDUNDANT
      NvMInitBlockCallback = NULL_PTR
      NvMResistantToChangedSw = true
      NvMSelectBlockForReadAll = true
      NvMSelectBlockForWriteAll = true
      NvMUseInitCallback = false
      NvMUseJobendCallback = false
      NvMSingleBlockCallback = NULL_PTR
      NvMBswMBlockStatusInformation = false
      NvMBlockUseCrc = true
      NvMBlockUseSyncMechanism = false
      NvMCalcRamBlockCrc = false
      NvMUseServicePorts = false
      NvMNvramBlockIdentifier = 1
      NvMNvBlockNum = 2
      NvMNvBlockLength = 2
      NvMRomBlockDataAddress = NULL_PTR
      NvMBlockPostReadTransformCallback = NULL_PTR
      NvMBlockPreWriteTransformCallback = NULL_PTR
      NvMBlockUseSetRamBlockStatus = true
      NvMBlockJobPriority = 127
      NvMBlockWriteProt = false
      NvMWriteBlockOnce = false
      NvMBlockUseCRCCompMechanism = false
      NvMInvokeCallbacksForReadAll = true
      NvMInvokeCallbacksForWriteAll = true
      NvMTargetBlockReference
        NvMFeeRef: NvMNameOfFeeBlock=FeeBlockConfiguration
    NvMCommon:
      NvMDevErrorDetect = true
      NvMVersionInfoApi = false
      NvMApiConfigClass = NVM_API_CONFIG_CLASS_3
      NvMBswMMultiBlockJobStatusInformation = true
      NvMCompiledConfigId = 1
      NvMCrcNumOfBytes = 64
      NvMDatasetSelectionBits = 4
      NvMDrvModeSwitch = true
      NvMDynamicConfiguration = false
      NvMJobPrioritization = false
      NvMPollingMode = false
      NvMSetRamBlockStatusApi = true
      NvMSizeStandardJobQueue = 10
      NvMMaxNoOfWriteRetries = 1
      NvMMainFunctionPeriod = 0.01
      NvMUseBlockIdCheck = false
      NvMRepairRedundantBlocksApi = true
      NvMSafeBswChecks = false
    NvMCommonVendorParams: NvMCrcIntBuffer=true, NvMKillWriteAllApi=true
