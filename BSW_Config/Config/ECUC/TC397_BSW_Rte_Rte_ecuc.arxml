AUTOSAR XML (schema 00048)
package /ActiveEcuC
  module config Rte: implementation-config-variant=VARIANT-PRE-COMPILE, module-description=Rte_Impl
    RteOsInteraction
      22 x RteUsedOsActivation, all with RteExpectedActivationOffset=0, RteExpectedTickDuration=0:
        Rte_Al_TE_Cdd_Core{1..5}_Cdd_Core{1..5}_Runnable10ms: RteActivationOsAlarmRef=Rte_Al_TE_Cdd_Core{1..5}_Cdd_Core{1..5}_Runnable10ms, RteActivationOsTaskRef=OsTask_Asw_OsCore{1..5}
        Rte_Al_TE2_EcuM_EcuM_MainFunction: RteActivationOsAlarmRef=Rte_Al_TE2_EcuM_EcuM_MainFunction, RteActivationOsTaskRef=OsTask_Bsw_OsCore1
        Rte_Al_TE3_EcuM_EcuM_MainFunction: RteActivationOsAlarmRef=Rte_Al_TE3_EcuM_EcuM_MainFunction, RteActivationOsTaskRef=OsTask_Bsw_OsCore2
        Rte_Al_TE4_EcuM_EcuM_MainFunction: RteActivationOsAlarmRef=Rte_Al_TE4_EcuM_EcuM_MainFunction, RteActivationOsTaskRef=OsTask_Bsw_OsCore3
        Rte_Al_TE5_EcuM_EcuM_MainFunction: RteActivationOsAlarmRef=Rte_Al_TE5_EcuM_EcuM_MainFunction, RteActivationOsTaskRef=OsTask_Bsw_OsCore4
        Rte_Al_TE6_EcuM_EcuM_MainFunction: RteActivationOsAlarmRef=Rte_Al_TE6_EcuM_EcuM_MainFunction, RteActivationOsTaskRef=OsTask_Bsw_OsCore5
        Rte_Al_TE2_OsTask_Bsw_10ms_Core0_0_10ms: RteActivationOsAlarmRef=Rte_Al_TE2_OsTask_Bsw_10ms_Core0_0_10ms, RteActivationOsTaskRef=OsTask_Bsw_10ms_Core0
        Rte_Al_TE_EthTrcv_30_Tja1100_EthTrcv_30_Tja1100_MainFunction: RteActivationOsAlarmRef=Rte_Al_TE_EthTrcv_30_Tja1100_EthTrcv_30_Tja1100_MainFunction, RteActivationOsTaskRef=OsTask_Bsw_20ms_Core0
        Rte_Al_TE_Cdd_Core0_Cdd_Core0_Runnable20ms: RteActivationOsAlarmRef=Rte_Al_TE_Cdd_Core0_Cdd_Core0_Runnable20ms, RteActivationOsTaskRef=OsTask_Asw_OsCore0
        Rte_Al_TE_OsTask_Asw_OsCore0_0_10ms: RteActivationOsAlarmRef=Rte_Al_TE_OsTask_Asw_OsCore0_0_10ms, RteActivationOsTaskRef=OsTask_Asw_OsCore0
        Rte_Al_TE_OsTask_Asw_OsCore0_0_5ms: RteActivationOsAlarmRef=Rte_Al_TE_OsTask_Asw_OsCore0_0_5ms, RteActivationOsTaskRef=OsTask_Asw_OsCore0
        Rte_Al_TE_Cdd_Core0_Cdd_Core0_Runnable1ms: RteActivationOsAlarmRef=Rte_Al_TE_Cdd_Core0_Cdd_Core0_Runnable1ms, RteActivationOsTaskRef=OsTask_Asw_OsCore0
        Rte_Al_TE2_OsTask_Bsw_5ms_Core0_0_5ms: RteActivationOsAlarmRef=Rte_Al_TE2_OsTask_Bsw_5ms_Core0_0_5ms, RteActivationOsTaskRef=OsTask_Bsw_5ms_Core0
        Rte_Al_TE2_OsTask_Bsw_5ms_Core0_0_10ms: RteActivationOsAlarmRef=Rte_Al_TE2_OsTask_Bsw_5ms_Core0_0_10ms, RteActivationOsTaskRef=OsTask_Bsw_5ms_Core0
        Rte_Al_TE_EthIf_EthIf_MainFunctionState: RteActivationOsAlarmRef=Rte_Al_TE_EthIf_EthIf_MainFunctionState, RteActivationOsTaskRef=OsTask_Bsw_5ms_Core0
        Rte_Al_TE2_OsTask_Bsw_5ms_Core0_0_20ms: RteActivationOsAlarmRef=Rte_Al_TE2_OsTask_Bsw_5ms_Core0_0_20ms, RteActivationOsTaskRef=OsTask_Bsw_5ms_Core0
        Rte_Al_TE2_OsTask_Bsw_1ms_Core0_0_1ms: RteActivationOsAlarmRef=Rte_Al_TE2_OsTask_Bsw_1ms_Core0_0_1ms, RteActivationOsTaskRef=OsTask_Bsw_1ms_Core0
        Rte_Al_TE_OsTask_Asw_OsCore0_0_100ms: RteActivationOsAlarmRef=Rte_Al_TE_OsTask_Asw_OsCore0_0_100ms, RteActivationOsTaskRef=OsTask_Asw_OsCore0
    RteGeneration:
      RteGenerationMode = COMPATIBILITY_MODE
      RteIocInteractionReturnValue = RTE_IOC
      RteValueRangeCheckEnabled = false
      RteCalibrationSupport = NONE
      RteCodeVendorId = 30
      RteDevErrorDetect = false
      RteDevErrorDetectUninit = false
      RteMeasurementSupport = false
      RteOptimizationMode = MEMORY
      RteVfbTraceEnabled = false
    RteInitializationBehavior: RteInitializationStrategy=RTE_INITIALIZATION_STRATEGY_AT_DATA_DECLARATION, RteSectionInitializationPolicy=INIT
    RteBswGeneral: RteSchMVersionInfoApi=false, RteUseComShadowSignalApi=false
    5 x RteBswModuleInstance:
      Dio: RteBswImplementationRef=Dio_Impl, RteBswModuleConfigurationRef=Dio
      McalLib: RteBswImplementationRef=McalLib_Impl, RteBswModuleConfigurationRef=McalLib
        4 x RteBswExclusiveAreaImpl, all with RteExclusiveAreaImplMechanism=ALL_INTERRUPT_BLOCKING:
          PeripheralEndInit: RteBswExclusiveAreaRef=PeripheralEndInit
          SafetyEndInit: RteBswExclusiveAreaRef=SafetyEndInit
          CpuEndInit: RteBswExclusiveAreaRef=CpuEndInit
          StmTimerResolution: RteBswExclusiveAreaRef=StmTimerResolution
      Port: RteBswImplementationRef=Port_Impl, RteBswModuleConfigurationRef=Port
      Irq: RteBswImplementationRef=Irq_Impl, RteBswModuleConfigurationRef=Irq
      BswM: RteBswImplementationRef=BswM_Impl, RteBswModuleConfigurationRef=BswM
        BSWM_EXCLUSIVE_AREA_0 (RteBswExclusiveAreaImpl): RteExclusiveAreaImplMechanism=ALL_INTERRUPT_BLOCKING, RteBswExclusiveAreaRef=BSWM_EXCLUSIVE_AREA_0
        BswM_MainFunctionTimingEvent0 (RteBswEventToTaskMapping):
          RteBswImmediateRestart = false
          RteBswPositionInTask = 2
          RteBswEventRef = BswM_MainFunctionTimingEvent0
          RteBswMappedToTaskRef = OsTask_Bsw_10ms_Core0
          RteBswUsedOsAlarmRef = Rte_Al_TE2_OsTask_Bsw_10ms_Core0_0_10ms
    3 x RteSwComponentInstance:
      Det_EcuSwComposition: RteSoftwareComponentInstanceRef=Det
      EcuM_EcuSwComposition: RteSoftwareComponentInstanceRef=EcuM
        8 x RteEventToTaskMapping, all with RteImmediateRestart=false:
          Timer_EcuM_MainFunction: RtePositionInTask=0, RteEventRef=Timer_EcuM_MainFunction, RteMappedToTaskRef=OsTask_Bsw_10ms_Core0, RteUsedOsAlarmRef=Rte_Al_TE2_OsTask_Bsw_10ms_Core0_0_10ms
          OpEventSelectShutdownTarget_SelectShutdownTarget_EcuM_ShutdownTarget: RteEventRef=OpEventSelectShutdownTarget_SelectShutdownTarget_EcuM_ShutdownTarget
          OpEventGetShutdownTarget_GetShutdownTarget_EcuM_ShutdownTarget: RteEventRef=OpEventGetShutdownTarget_GetShutdownTarget_EcuM_ShutdownTarget
          OpEventGetLastShutdownTarget_GetLastShutdownTarget_EcuM_ShutdownTarget: RteEventRef=OpEventGetLastShutdownTarget_GetLastShutdownTarget_EcuM_ShutdownTarget
          OpEventSelectShutdownCause_SelectShutdownCause_EcuM_ShutdownTarget: RteEventRef=OpEventSelectShutdownCause_SelectShutdownCause_EcuM_ShutdownTarget
          OpEventGetShutdownCause_GetShutdownCause_EcuM_ShutdownTarget: RteEventRef=OpEventGetShutdownCause_GetShutdownCause_EcuM_ShutdownTarget
          OpEventSelectBootTarget_SelectBootTarget_EcuM_BootTarget: RteEventRef=OpEventSelectBootTarget_SelectBootTarget_EcuM_BootTarget
          OpEventGetBootTarget_GetBootTarget_EcuM_BootTarget: RteEventRef=OpEventGetBootTarget_GetBootTarget_EcuM_BootTarget
      Os_OsCore0_swc_EcuSwComposition: RteSoftwareComponentInstanceRef=Os_OsCore0_swc
        OpEventGetCounterValue_GetCounterValue_OsService_SystemTimer_OsCore0 (RteEventToTaskMapping): RteImmediateRestart=false, RteEventRef=OpEventGetCounterValue_GetCounterValue_OsService_SystemTimer_OsCore0
        OpEventGetElapsedValue_GetElapsedValue_OsService_SystemTimer_OsCore0 (RteEventToTaskMapping): RteImmediateRestart=false, RteEventRef=OpEventGetElapsedValue_GetElapsedValue_OsService_SystemTimer_OsCore0
    3 x RteBswModuleInstance:
      Det: RteBswImplementationRef=Det_Impl, RteBswModuleConfigurationRef=Det
        DET_EXCLUSIVE_AREA_0 (RteBswExclusiveAreaImpl): RteExclusiveAreaImplMechanism=ALL_INTERRUPT_BLOCKING, RteBswExclusiveAreaRef=DET_EXCLUSIVE_AREA_0
      EcuM: RteBswImplementationRef=EcuM_Impl, RteBswModuleConfigurationRef=EcuM
        4 x RteBswExclusiveAreaImpl, all with RteExclusiveAreaImplMechanism=ALL_INTERRUPT_BLOCKING:
          ECUM_EXCLUSIVE_AREA_{0..3}: RteBswExclusiveAreaRef=ECUM_EXCLUSIVE_AREA_{0..3}
        6 x RteBswEventToTaskMapping, all with RteBswImmediateRestart=false, RteBswPositionInTask=0:
          EcuM_MainFunctionTimingEvent0: RteBswEventRef=EcuM_MainFunctionTimingEvent0, RteBswMappedToTaskRef=OsTask_Bsw_10ms_Core0, RteBswUsedOsAlarmRef=Rte_Al_TE2_OsTask_Bsw_10ms_Core0_0_10ms
          EcuM_MainFunctionTimingEvent1: RteBswEventRef=EcuM_MainFunctionTimingEvent1, RteBswMappedToTaskRef=OsTask_Bsw_OsCore1, RteBswUsedOsAlarmRef=Rte_Al_TE2_EcuM_EcuM_MainFunction
          EcuM_MainFunctionTimingEvent2: RteBswEventRef=EcuM_MainFunctionTimingEvent2, RteBswMappedToTaskRef=OsTask_Bsw_OsCore2, RteBswUsedOsAlarmRef=Rte_Al_TE3_EcuM_EcuM_MainFunction
          EcuM_MainFunctionTimingEvent3: RteBswEventRef=EcuM_MainFunctionTimingEvent3, RteBswMappedToTaskRef=OsTask_Bsw_OsCore3, RteBswUsedOsAlarmRef=Rte_Al_TE4_EcuM_EcuM_MainFunction
          EcuM_MainFunctionTimingEvent4: RteBswEventRef=EcuM_MainFunctionTimingEvent4, RteBswMappedToTaskRef=OsTask_Bsw_OsCore4, RteBswUsedOsAlarmRef=Rte_Al_TE5_EcuM_EcuM_MainFunction
          EcuM_MainFunctionTimingEvent5: RteBswEventRef=EcuM_MainFunctionTimingEvent5, RteBswMappedToTaskRef=OsTask_Bsw_OsCore5, RteBswUsedOsAlarmRef=Rte_Al_TE6_EcuM_EcuM_MainFunction
      Rte: RteBswImplementationRef=Rte_Impl, RteBswModuleConfigurationRef=Rte
        Rte_ComSendSignalProxyPeriodicTimingEvent0 (RteBswEventToTaskMapping): RteBswImmediateRestart=false, RteBswEventRef=Rte_ComSendSignalProxyPeriodicTimingEvent0
    11 x RteSwComponentInstance:
      Os_OsCore1_swc_EcuSwComposition: RteSoftwareComponentInstanceRef=Os_OsCore1_swc
        OpEventGetCounterValue_GetCounterValue_OsService_SystemTimer_OsCore1 (RteEventToTaskMapping): RteImmediateRestart=false, RteEventRef=OpEventGetCounterValue_GetCounterValue_OsService_SystemTimer_OsCore1
        OpEventGetElapsedValue_GetElapsedValue_OsService_SystemTimer_OsCore1 (RteEventToTaskMapping): RteImmediateRestart=false, RteEventRef=OpEventGetElapsedValue_GetElapsedValue_OsService_SystemTimer_OsCore1
      Os_OsCore2_swc_EcuSwComposition: RteSoftwareComponentInstanceRef=Os_OsCore2_swc
        OpEventGetCounterValue_GetCounterValue_OsService_SystemTimer_OsCore2 (RteEventToTaskMapping): RteImmediateRestart=false, RteEventRef=OpEventGetCounterValue_GetCounterValue_OsService_SystemTimer_OsCore2
        OpEventGetElapsedValue_GetElapsedValue_OsService_SystemTimer_OsCore2 (RteEventToTaskMapping): RteImmediateRestart=false, RteEventRef=OpEventGetElapsedValue_GetElapsedValue_OsService_SystemTimer_OsCore2
      Os_OsCore3_swc_EcuSwComposition: RteSoftwareComponentInstanceRef=Os_OsCore3_swc
        OpEventGetCounterValue_GetCounterValue_OsService_SystemTimer_OsCore3 (RteEventToTaskMapping): RteImmediateRestart=false, RteEventRef=OpEventGetCounterValue_GetCounterValue_OsService_SystemTimer_OsCore3
        OpEventGetElapsedValue_GetElapsedValue_OsService_SystemTimer_OsCore3 (RteEventToTaskMapping): RteImmediateRestart=false, RteEventRef=OpEventGetElapsedValue_GetElapsedValue_OsService_SystemTimer_OsCore3
      Os_OsCore4_swc_EcuSwComposition: RteSoftwareComponentInstanceRef=Os_OsCore4_swc
        OpEventGetCounterValue_GetCounterValue_OsService_SystemTimer_OsCore4 (RteEventToTaskMapping): RteImmediateRestart=false, RteEventRef=OpEventGetCounterValue_GetCounterValue_OsService_SystemTimer_OsCore4
        OpEventGetElapsedValue_GetElapsedValue_OsService_SystemTimer_OsCore4 (RteEventToTaskMapping): RteImmediateRestart=false, RteEventRef=OpEventGetElapsedValue_GetElapsedValue_OsService_SystemTimer_OsCore4
      Os_OsCore5_swc_EcuSwComposition: RteSoftwareComponentInstanceRef=Os_OsCore5_swc
        OpEventGetCounterValue_GetCounterValue_OsService_SystemTimer_OsCore5 (RteEventToTaskMapping): RteImmediateRestart=false, RteEventRef=OpEventGetCounterValue_GetCounterValue_OsService_SystemTimer_OsCore5
        OpEventGetElapsedValue_GetElapsedValue_OsService_SystemTimer_OsCore5 (RteEventToTaskMapping): RteImmediateRestart=false, RteEventRef=OpEventGetElapsedValue_GetElapsedValue_OsService_SystemTimer_OsCore5
      Cdd_Core0_EcuSwComposition: RteSoftwareComponentInstanceRef=Cdd_Core0
        5 x RteEventToTaskMapping, all with RteImmediateRestart=false:
          Cdd_Core0_InitEvent: RtePositionInTask=2, RteEventRef=Cdd_Core0_InitEvent, RteMappedToTaskRef=OsTask_Init_OsCore0
          TMT_Runnable_5ms: RtePositionInTask=5, RteEventRef=TMT_Cdd_Core0_Runnable10ms, RteMappedToTaskRef=OsTask_Asw_OsCore0, RteUsedOsEventRef=Rte_Ev_Cyclic_OsTask_Asw_OsCore0_0_10ms, RteUsedOsAlarmRef=Rte_Al_TE_OsTask_Asw_OsCore0_0_10ms
          TMT_Runnable_20: RtePositionInTask=6, RteEventRef=TMT_Cdd_Core0_Runnable20ms, RteMappedToTaskRef=OsTask_Asw_OsCore0, RteUsedOsEventRef=Rte_Ev_Run_Cdd_Core0_Cdd_Core0_Runnable20ms, RteUsedOsAlarmRef=Rte_Al_TE_Cdd_Core0_Cdd_Core0_Runnable20ms
          TMT_Cdd_Nm_Runnable5ms: RtePositionInTask=4, RteEventRef=TMT_Cdd_Core0_Runnable5ms, RteMappedToTaskRef=OsTask_Asw_OsCore0, RteUsedOsEventRef=Rte_Ev_Cyclic_OsTask_Asw_OsCore0_0_5ms, RteUsedOsAlarmRef=Rte_Al_TE_OsTask_Asw_OsCore0_0_5ms
          TMT_Cdd_Core0_Runnable1ms: RtePositionInTask=0, RteEventRef=TMT_Cdd_Core0_Runnable1ms, RteMappedToTaskRef=OsTask_Asw_OsCore0, RteUsedOsEventRef=Rte_Ev_Run_Cdd_Core0_Cdd_Core0_Runnable1ms, RteUsedOsAlarmRef=Rte_Al_TE_Cdd_Core0_Cdd_Core0_Runnable1ms
      Cdd_Core1_EcuSwComposition: RteSoftwareComponentInstanceRef=Cdd_Core1
        Cdd_Core1_InitEvent (RteEventToTaskMapping): RteImmediateRestart=false, RtePositionInTask=0, RteEventRef=Cdd_Core1_InitEvent, RteMappedToTaskRef=OsTask_Init_OsCore1
        TMT_Cdd_Core1_Runnable10ms (RteEventToTaskMapping):
          RteImmediateRestart = false
          RtePositionInTask = 0
          RteEventRef = TMT_Cdd_Core1_Runnable10ms
          RteMappedToTaskRef = OsTask_Asw_OsCore1
          RteUsedOsAlarmRef = Rte_Al_TE_Cdd_Core1_Cdd_Core1_Runnable10ms
      Cdd_Core2_EcuSwComposition: RteSoftwareComponentInstanceRef=Cdd_Core2
        Cdd_Core2_InitEvent (RteEventToTaskMapping): RteImmediateRestart=false, RtePositionInTask=0, RteEventRef=Cdd_Core2_InitEvent, RteMappedToTaskRef=OsTask_Init_OsCore2
        TMT_Cdd_Core2_Runnable10ms (RteEventToTaskMapping):
          RteImmediateRestart = false
          RtePositionInTask = 0
          RteEventRef = TMT_Cdd_Core2_Runnable10ms
          RteMappedToTaskRef = OsTask_Asw_OsCore2
          RteUsedOsAlarmRef = Rte_Al_TE_Cdd_Core2_Cdd_Core2_Runnable10ms
      Cdd_Core3_EcuSwComposition: RteSoftwareComponentInstanceRef=Cdd_Core3
        Cdd_Core3_InitEvent (RteEventToTaskMapping): RteImmediateRestart=false, RtePositionInTask=0, RteEventRef=Cdd_Core3_InitEvent, RteMappedToTaskRef=OsTask_Init_OsCore3
        TMT_Cdd_Core3_Runnable10ms (RteEventToTaskMapping):
          RteImmediateRestart = false
          RtePositionInTask = 0
          RteEventRef = TMT_Cdd_Core3_Runnable10ms
          RteMappedToTaskRef = OsTask_Asw_OsCore3
          RteUsedOsAlarmRef = Rte_Al_TE_Cdd_Core3_Cdd_Core3_Runnable10ms
      Cdd_Core4_EcuSwComposition: RteSoftwareComponentInstanceRef=Cdd_Core4
        Cdd_Core4_InitEvent (RteEventToTaskMapping): RteImmediateRestart=false, RtePositionInTask=0, RteEventRef=Cdd_Core4_InitEvent, RteMappedToTaskRef=OsTask_Init_OsCore4
        TMT_Cdd_Core4_Runnable10ms (RteEventToTaskMapping):
          RteImmediateRestart = false
          RtePositionInTask = 0
          RteEventRef = TMT_Cdd_Core4_Runnable10ms
          RteMappedToTaskRef = OsTask_Asw_OsCore4
          RteUsedOsAlarmRef = Rte_Al_TE_Cdd_Core4_Cdd_Core4_Runnable10ms
      Cdd_Core5_EcuSwComposition: RteSoftwareComponentInstanceRef=Cdd_Core5
        Cdd_Core5_InitEvent (RteEventToTaskMapping): RteImmediateRestart=false, RtePositionInTask=0, RteEventRef=Cdd_Core5_InitEvent, RteMappedToTaskRef=OsTask_Init_OsCore5
        TMT_Cdd_Core5_Runnable10ms (RteEventToTaskMapping):
          RteImmediateRestart = false
          RtePositionInTask = 0
          RteEventRef = TMT_Cdd_Core5_Runnable10ms
          RteMappedToTaskRef = OsTask_Asw_OsCore5
          RteUsedOsAlarmRef = Rte_Al_TE_Cdd_Core5_Cdd_Core5_Runnable10ms
    6 x RteSwComponentType:
      Cdd_Core0: RteComponentTypeRef=Cdd_Core0, RteImplementationRef=Cdd_Core0_Implementation
        ComponentTypeCalibration (RteComponentTypeCalibration): RteCalibrationSupportEnabled=false
      Cdd_Core1: RteComponentTypeRef=Cdd_Core1, RteImplementationRef=Cdd_Core1_Implementation
        ComponentTypeCalibration (RteComponentTypeCalibration): RteCalibrationSupportEnabled=false
      Cdd_Core2: RteComponentTypeRef=Cdd_Core2, RteImplementationRef=Cdd_Core2_Implementation
        ComponentTypeCalibration (RteComponentTypeCalibration): RteCalibrationSupportEnabled=false
      Cdd_Core3: RteComponentTypeRef=Cdd_Core3, RteImplementationRef=Cdd_Core3_Implementation
        ComponentTypeCalibration (RteComponentTypeCalibration): RteCalibrationSupportEnabled=false
      Cdd_Core4: RteComponentTypeRef=Cdd_Core4, RteImplementationRef=Cdd_Core4_Implementation
        ComponentTypeCalibration (RteComponentTypeCalibration): RteCalibrationSupportEnabled=false
      Cdd_Core5: RteComponentTypeRef=Cdd_Core5, RteImplementationRef=Cdd_Core5_Implementation
        ComponentTypeCalibration (RteComponentTypeCalibration): RteCalibrationSupportEnabled=false
    BswM_EcuSwComposition (RteSwComponentInstance): RteSoftwareComponentInstanceRef=BswM
      Timer_BswM_MainFunction (RteEventToTaskMapping):
        RteImmediateRestart = false
        RtePositionInTask = 2
        RteEventRef = Timer_BswM_MainFunction
        RteMappedToTaskRef = OsTask_Bsw_10ms_Core0
        RteUsedOsAlarmRef = Rte_Al_TE2_OsTask_Bsw_10ms_Core0_0_10ms
    Cdd_nm_EcuSwComposition (RteSwComponentInstance): RteSoftwareComponentInstanceRef=Cdd_nm
      TMT_Cdd_Nm_Runnable10ms (RteEventToTaskMapping):
        RteImmediateRestart = false
        RtePositionInTask = 8
        RteEventRef = TMT_Cdd_Nm_Runnable10ms
        RteMappedToTaskRef = OsTask_Asw_OsCore0
        RteUsedOsEventRef = Rte_Ev_Cyclic_OsTask_Asw_OsCore0_0_10ms
        RteUsedOsAlarmRef = Rte_Al_TE_OsTask_Asw_OsCore0_0_10ms
      Cdd_Nm_InitEvent (RteEventToTaskMapping): RteImmediateRestart=false, RtePositionInTask=4, RteEventRef=Cdd_Nm_InitEvent, RteMappedToTaskRef=OsTask_Init_OsCore0
    Cdd_Nm (RteSwComponentType): RteComponentTypeRef=Cdd_Nm, RteImplementationRef=Cdd_Nm_Implementation
      ComponentTypeCalibration (RteComponentTypeCalibration): RteCalibrationSupportEnabled=false
    5 x RteBswModuleInstance:
      Eth: RteBswImplementationRef=Eth_Impl, RteBswModuleConfigurationRef=Eth
        Eth_30_Tc3xx_MainFunctionTimingEvent0 (RteBswEventToTaskMapping):
          RteBswImmediateRestart = false
          RteBswPositionInTask = 4
          RteBswEventRef = Eth_30_Tc3xx_MainFunctionTimingEvent0
          RteBswMappedToTaskRef = OsTask_Bsw_5ms_Core0
          RteBswUsedOsAlarmRef = Rte_Al_TE2_OsTask_Bsw_5ms_Core0_0_5ms
          RteBswUsedOsEventRef = Rte_Ev_Cyclic2_OsTask_Bsw_5ms_Core0_0_5ms
        3 x RteBswExclusiveAreaImpl, all with RteExclusiveAreaImplMechanism=ALL_INTERRUPT_BLOCKING:
          ETH_30_TC3XX_EXCLUSIVE_AREA_DATA: RteBswExclusiveAreaRef=ETH_30_TC3XX_EXCLUSIVE_AREA_DATA
          ETH_30_TC3XX_EXCLUSIVE_AREA_MII: RteBswExclusiveAreaRef=ETH_30_TC3XX_EXCLUSIVE_AREA_MII
          ETH_30_TC3XX_EXCLUSIVE_AREA_DISABLE_MAC: RteBswExclusiveAreaRef=ETH_30_TC3XX_EXCLUSIVE_AREA_DISABLE_MAC
      Uart: RteBswImplementationRef=Uart_Impl, RteBswModuleConfigurationRef=Uart
        Uart_MainFunction_ReadTimingEvent0 (RteBswEventToTaskMapping):
          RteBswImmediateRestart = false
          RteBswPositionInTask = 0
          RteBswEventRef = Uart_MainFunction_ReadTimingEvent0
          RteBswMappedToTaskRef = OsTask_Bsw_5ms_Core0
          RteBswUsedOsEventRef = Rte_Ev_Cyclic2_OsTask_Bsw_5ms_Core0_0_5ms
          RteBswUsedOsAlarmRef = Rte_Al_TE2_OsTask_Bsw_5ms_Core0_0_5ms
        Uart_MainFunction_WriteTimingEvent0 (RteBswEventToTaskMapping): RteBswImmediateRestart=false, RteBswEventRef=Uart_MainFunction_WriteTimingEvent0
      EthTrcv: RteBswImplementationRef=EthTrcv_Impl, RteBswModuleConfigurationRef=EthTrcv
        EthTrcv_30_Tja1100_MainFunctionTimingEvent0 (RteBswEventToTaskMapping):
          RteBswImmediateRestart = false
          RteBswPositionInTask = 2
          RteBswEventRef = EthTrcv_30_Tja1100_MainFunctionTimingEvent0
          RteBswMappedToTaskRef = OsTask_Bsw_20ms_Core0
          RteBswUsedOsAlarmRef = Rte_Al_TE_EthTrcv_30_Tja1100_EthTrcv_30_Tja1100_MainFunction
        EthTrcv_30_Tja1100_MainFunctionLinkHandlingTimingEvent0 (RteBswEventToTaskMapping):
          RteBswImmediateRestart = false
          RteBswPositionInTask = 2
          RteBswEventRef = EthTrcv_30_Tja1100_MainFunctionLinkHandlingTimingEvent0
          RteBswMappedToTaskRef = OsTask_Bsw_5ms_Core0
          RteBswUsedOsAlarmRef = Rte_Al_TE2_OsTask_Bsw_5ms_Core0_0_5ms
          RteBswUsedOsEventRef = Rte_Ev_Cyclic2_OsTask_Bsw_5ms_Core0_0_5ms
        ETHTRCV_30_TJA1100_EXCLUSIVE_AREA_SEQUENCE (RteBswExclusiveAreaImpl): RteExclusiveAreaImplMechanism=ALL_INTERRUPT_BLOCKING, RteBswExclusiveAreaRef=ETHTRCV_30_TJA1100_EXCLUSIVE_AREA_SEQUENCE
      Crc: RteBswImplementationRef=Crc_Impl, RteBswModuleConfigurationRef=Crc
        CriticalSection (RteBswExclusiveAreaImpl): RteExclusiveAreaImplMechanism=ALL_INTERRUPT_BLOCKING, RteBswExclusiveAreaRef=CriticalSection
      Mcu: RteBswImplementationRef=Mcu_Impl, RteBswModuleConfigurationRef=Mcu
        TomTgcReg (RteBswExclusiveAreaImpl): RteExclusiveAreaImplMechanism=ALL_INTERRUPT_BLOCKING, RteBswExclusiveAreaRef=TomTgcReg
        AtomAgcReg (RteBswExclusiveAreaImpl): RteExclusiveAreaImplMechanism=ALL_INTERRUPT_BLOCKING, RteBswExclusiveAreaRef=AtomAgcReg
    Cdd_log_EcuSwComposition (RteSwComponentInstance): RteSoftwareComponentInstanceRef=Cdd_log
      Runnable_InitEvent (RteEventToTaskMapping): RteImmediateRestart=false, RtePositionInTask=0, RteEventRef=Runnable_InitEvent, RteMappedToTaskRef=OsTask_Init_OsCore0
      TMT_Cdd_Log_Runnable5ms (RteEventToTaskMapping):
        RteImmediateRestart = false
        RtePositionInTask = 10
        RteEventRef = TMT_Cdd_Log_Runnable5ms
        RteMappedToTaskRef = OsTask_Asw_OsCore0
        RteUsedOsEventRef = Rte_Ev_Cyclic_OsTask_Asw_OsCore0_0_5ms
        RteUsedOsAlarmRef = Rte_Al_TE_OsTask_Asw_OsCore0_0_5ms
    Cdd_Log (RteSwComponentType): RteComponentTypeRef=Cdd_Log, RteImplementationRef=Cdd_Log_Implementation
      ComponentTypeCalibration (RteComponentTypeCalibration): RteCalibrationSupportEnabled=false
    3 x RteBswModuleInstance:
      EthIf: RteBswImplementationRef=EthIf_Impl, RteBswModuleConfigurationRef=EthIf
        3 x RteBswEventToTaskMapping, all with RteBswImmediateRestart=false, RteBswMappedToTaskRef=OsTask_Bsw_5ms_Core0:
          EthIf_MainFunctionRxTimingEvent0: RteBswPositionInTask=10, RteBswEventRef=EthIf_MainFunctionRxTimingEvent0, RteBswUsedOsEventRef=Rte_Ev_Cyclic2_OsTask_Bsw_5ms_Core0_0_5ms, RteBswUsedOsAlarmRef=Rte_Al_TE2_OsTask_Bsw_5ms_Core0_0_5ms
          EthIf_MainFunctionTxTimingEvent0: RteBswPositionInTask=12, RteBswEventRef=EthIf_MainFunctionTxTimingEvent0, RteBswUsedOsEventRef=Rte_Ev_Cyclic2_OsTask_Bsw_5ms_Core0_0_5ms, RteBswUsedOsAlarmRef=Rte_Al_TE2_OsTask_Bsw_5ms_Core0_0_5ms
          EthIf_MainFunctionStateTimingEvent0: RteBswPositionInTask=11, RteBswEventRef=EthIf_MainFunctionStateTimingEvent0, RteBswUsedOsEventRef=Rte_Ev_Run_EthIf_EthIf_MainFunctionState, RteBswUsedOsAlarmRef=Rte_Al_TE_EthIf_EthIf_MainFunctionState
        5 x RteBswExclusiveAreaImpl, all with RteExclusiveAreaImplMechanism=ALL_INTERRUPT_BLOCKING:
          ETHIF_EXCLUSIVE_AREA_CTRL_INIT: RteBswExclusiveAreaRef=ETHIF_EXCLUSIVE_AREA_CTRL_INIT
          ETHIF_EXCLUSIVE_AREA_SET_CTRL_MODE: RteBswExclusiveAreaRef=ETHIF_EXCLUSIVE_AREA_SET_CTRL_MODE
          ETHIF_EXCLUSIVE_AREA_TX_MIRROR_ELEMENT: RteBswExclusiveAreaRef=ETHIF_EXCLUSIVE_AREA_TX_MIRROR_ELEMENT
          ETHIF_EXCLUSIVE_AREA_RXTX_STATS: RteBswExclusiveAreaRef=ETHIF_EXCLUSIVE_AREA_RXTX_STATS
          ETHIF_EXCLUSIVE_AREA_SIGNAL_QUALITY: RteBswExclusiveAreaRef=ETHIF_EXCLUSIVE_AREA_SIGNAL_QUALITY
      EthTSyn: RteBswImplementationRef=EthTSyn_Impl, RteBswModuleConfigurationRef=EthTSyn
        EthTSyn_MainFunctionTimingEvent0 (RteBswEventToTaskMapping):
          RteBswImmediateRestart = false
          RteBswPositionInTask = 20
          RteBswEventRef = EthTSyn_MainFunctionTimingEvent0
          RteBswMappedToTaskRef = OsTask_Bsw_5ms_Core0
          RteBswUsedOsEventRef = Rte_Ev_Cyclic2_OsTask_Bsw_5ms_Core0_0_5ms
          RteBswUsedOsAlarmRef = Rte_Al_TE2_OsTask_Bsw_5ms_Core0_0_5ms
        3 x RteBswExclusiveAreaImpl, all with RteExclusiveAreaImplMechanism=ALL_INTERRUPT_BLOCKING:
          ETHTSYN_EXCLUSIVE_AREA_0: RteBswExclusiveAreaRef=ETHTSYN_EXCLUSIVE_AREA_0
          ETHTSYN_EXCLUSIVE_AREA_GET_TS: RteBswExclusiveAreaRef=ETHTSYN_EXCLUSIVE_AREA_GET_TS
          ETHTSYN_EXCLUSIVE_AREA_TIME_VALID: RteBswExclusiveAreaRef=ETHTSYN_EXCLUSIVE_AREA_TIME_VALID
      StbM: RteBswImplementationRef=StbM_Impl, RteBswModuleConfigurationRef=StbM
        StbM_MainFunctionTimingEvent0 (RteBswEventToTaskMapping):
          RteBswImmediateRestart = false
          RteBswPositionInTask = 21
          RteBswEventRef = StbM_MainFunctionTimingEvent0
          RteBswMappedToTaskRef = OsTask_Bsw_5ms_Core0
          RteBswUsedOsEventRef = Rte_Ev_Cyclic2_OsTask_Bsw_5ms_Core0_0_10ms
          RteBswUsedOsAlarmRef = Rte_Al_TE2_OsTask_Bsw_5ms_Core0_0_10ms
        STBM_EXCLUSIVE_AREA_0 (RteBswExclusiveAreaImpl): RteExclusiveAreaImplMechanism=ALL_INTERRUPT_BLOCKING, RteBswExclusiveAreaRef=STBM_EXCLUSIVE_AREA_0
    StbM_EcuSwComposition (RteSwComponentInstance): RteSoftwareComponentInstanceRef=StbM
      14 x RteEventToTaskMapping, all with RteImmediateRestart=false:
        Timer_StbM_MainFunction: RtePositionInTask=21, RteEventRef=Timer_StbM_MainFunction, RteMappedToTaskRef=OsTask_Bsw_5ms_Core0, RteUsedOsEventRef=Rte_Ev_Cyclic2_OsTask_Bsw_5ms_Core0_0_10ms, RteUsedOsAlarmRef=Rte_Al_TE2_OsTask_Bsw_5ms_Core0_0_10ms
        OpEventGetCurrentTime_GetCurrentTime_GlobalTime_Slave_StbMSynchronizedTimeBase_MAIN0: RteEventRef=OpEventGetCurrentTime_GetCurrentTime_GlobalTime_Slave_StbMSynchronizedTimeBase_MAIN0
        OpEventGetCurrentTime_GetCurrentTime_GlobalTime_Slave_StbMSynchronizedTimeBase_MAIN6: RteEventRef=OpEventGetCurrentTime_GetCurrentTime_GlobalTime_Slave_StbMSynchronizedTimeBase_MAIN6
        OpEventGetRateDeviation_GetRateDeviation_GlobalTime_Slave_StbMSynchronizedTimeBase_MAIN0: RteEventRef=OpEventGetRateDeviation_GetRateDeviation_GlobalTime_Slave_StbMSynchronizedTimeBase_MAIN0
        OpEventGetRateDeviation_GetRateDeviation_GlobalTime_Slave_StbMSynchronizedTimeBase_MAIN6: RteEventRef=OpEventGetRateDeviation_GetRateDeviation_GlobalTime_Slave_StbMSynchronizedTimeBase_MAIN6
        OpEventGetTimeLeap_GetTimeLeap_GlobalTime_Slave_StbMSynchronizedTimeBase_MAIN0: RteEventRef=OpEventGetTimeLeap_GetTimeLeap_GlobalTime_Slave_StbMSynchronizedTimeBase_MAIN0
        OpEventGetTimeLeap_GetTimeLeap_GlobalTime_Slave_StbMSynchronizedTimeBase_MAIN6: RteEventRef=OpEventGetTimeLeap_GetTimeLeap_GlobalTime_Slave_StbMSynchronizedTimeBase_MAIN6
        OpEventGetTimeBaseStatus_GetTimeBaseStatus_GlobalTime_Slave_StbMSynchronizedTimeBase_MAIN0: RteEventRef=OpEventGetTimeBaseStatus_GetTimeBaseStatus_GlobalTime_Slave_StbMSynchronizedTimeBase_MAIN0
        OpEventGetTimeBaseStatus_GetTimeBaseStatus_GlobalTime_Slave_StbMSynchronizedTimeBase_MAIN6: RteEventRef=OpEventGetTimeBaseStatus_GetTimeBaseStatus_GlobalTime_Slave_StbMSynchronizedTimeBase_MAIN6
        OpEventSetGlobalTime_SetGlobalTime_GlobalTime_Master_StbMSynchronizedTimeBase_MAIN6: RteEventRef=OpEventSetGlobalTime_SetGlobalTime_GlobalTime_Master_StbMSynchronizedTimeBase_MAIN6
        OpEventSetUserData_SetUserData_GlobalTime_Master_StbMSynchronizedTimeBase_MAIN6: RteEventRef=OpEventSetUserData_SetUserData_GlobalTime_Master_StbMSynchronizedTimeBase_MAIN6
        OpEventSetRateCorrection_SetRateCorrection_GlobalTime_Master_StbMSynchronizedTimeBase_MAIN6: RteEventRef=OpEventSetRateCorrection_SetRateCorrection_GlobalTime_Master_StbMSynchronizedTimeBase_MAIN6
        OpEventTriggerTimeTransmission_TriggerTimeTransmission_GlobalTime_Master_StbMSynchronizedTimeBase_MAIN6: RteEventRef=OpEventTriggerTimeTransmission_TriggerTimeTransmission_GlobalTime_Master_StbMSynchronizedTimeBase_MAIN6
        OpEventUpdateGlobalTime_UpdateGlobalTime_GlobalTime_Master_StbMSynchronizedTimeBase_MAIN6: RteEventRef=OpEventUpdateGlobalTime_UpdateGlobalTime_GlobalTime_Master_StbMSynchronizedTimeBase_MAIN6
    6 x RteBswModuleInstance:
      TcpIp: RteBswImplementationRef=TcpIp_Impl, RteBswModuleConfigurationRef=TcpIp
        TcpIp_MainFunctionTimingEvent0 (RteBswEventToTaskMapping):
          RteBswImmediateRestart = false
          RteBswPositionInTask = 17
          RteBswEventRef = TcpIp_MainFunctionTimingEvent0
          RteBswMappedToTaskRef = OsTask_Bsw_5ms_Core0
          RteBswUsedOsEventRef = Rte_Ev_Cyclic2_OsTask_Bsw_5ms_Core0_0_5ms
          RteBswUsedOsAlarmRef = Rte_Al_TE2_OsTask_Bsw_5ms_Core0_0_5ms
        TCPIP_EXCLUSIVE_AREA_0 (RteBswExclusiveAreaImpl): RteExclusiveAreaImplMechanism=ALL_INTERRUPT_BLOCKING, RteBswExclusiveAreaRef=TCPIP_EXCLUSIVE_AREA_0
      EthSM: RteBswImplementationRef=EthSM_Impl, RteBswModuleConfigurationRef=EthSM
        EthSM_MainFunctionTimingEvent0 (RteBswEventToTaskMapping):
          RteBswImmediateRestart = false
          RteBswPositionInTask = 6
          RteBswEventRef = EthSM_MainFunctionTimingEvent0
          RteBswMappedToTaskRef = OsTask_Bsw_5ms_Core0
          RteBswUsedOsEventRef = Rte_Ev_Cyclic2_OsTask_Bsw_5ms_Core0_0_20ms
          RteBswUsedOsAlarmRef = Rte_Al_TE2_OsTask_Bsw_5ms_Core0_0_20ms
      ComM: RteBswImplementationRef=ComM_Impl, RteBswModuleConfigurationRef=ComM
        ComM_MainFunction_0TimingEvent0 (RteBswEventToTaskMapping):
          RteBswImmediateRestart = false
          RteBswPositionInTask = 8
          RteBswEventRef = ComM_MainFunction_0TimingEvent0
          RteBswMappedToTaskRef = OsTask_Bsw_5ms_Core0
          RteBswUsedOsEventRef = Rte_Ev_Cyclic2_OsTask_Bsw_5ms_Core0_0_20ms
          RteBswUsedOsAlarmRef = Rte_Al_TE2_OsTask_Bsw_5ms_Core0_0_20ms
        COMM_EXCLUSIVE_AREA_0 (RteBswExclusiveAreaImpl): RteExclusiveAreaImplMechanism=ALL_INTERRUPT_BLOCKING, RteBswExclusiveAreaRef=COMM_EXCLUSIVE_AREA_0
        COMM_EXCLUSIVE_AREA_1 (RteBswExclusiveAreaImpl): RteExclusiveAreaImplMechanism=ALL_INTERRUPT_BLOCKING, RteBswExclusiveAreaRef=COMM_EXCLUSIVE_AREA_1
        ComM_MainFunction_1TimingEvent0 (RteBswEventToTaskMapping):
          RteBswImmediateRestart = false
          RteBswPositionInTask = 7
          RteBswEventRef = ComM_MainFunction_1TimingEvent0
          RteBswMappedToTaskRef = OsTask_Bsw_5ms_Core0
          RteBswUsedOsEventRef = Rte_Ev_Cyclic2_OsTask_Bsw_5ms_Core0_0_20ms
          RteBswUsedOsAlarmRef = Rte_Al_TE2_OsTask_Bsw_5ms_Core0_0_20ms
        ComM_MainFunction_2TimingEvent0 (RteBswEventToTaskMapping):
          RteBswImmediateRestart = false
          RteBswPositionInTask = 9
          RteBswEventRef = ComM_MainFunction_2TimingEvent0
          RteBswMappedToTaskRef = OsTask_Bsw_5ms_Core0
          RteBswUsedOsEventRef = Rte_Ev_Cyclic2_OsTask_Bsw_5ms_Core0_0_20ms
          RteBswUsedOsAlarmRef = Rte_Al_TE2_OsTask_Bsw_5ms_Core0_0_20ms
      SoAd: RteBswImplementationRef=SoAd_Impl, RteBswModuleConfigurationRef=SoAd
        SoAd_MainFunctionTimingEvent0 (RteBswEventToTaskMapping):
          RteBswImmediateRestart = false
          RteBswPositionInTask = 14
          RteBswEventRef = SoAd_MainFunctionTimingEvent0
          RteBswMappedToTaskRef = OsTask_Bsw_5ms_Core0
          RteBswUsedOsEventRef = Rte_Ev_Cyclic2_OsTask_Bsw_5ms_Core0_0_5ms
          RteBswUsedOsAlarmRef = Rte_Al_TE2_OsTask_Bsw_5ms_Core0_0_5ms
        SOAD_EXCLUSIVE_AREA_0 (RteBswExclusiveAreaImpl): RteExclusiveAreaImplMechanism=ALL_INTERRUPT_BLOCKING, RteBswExclusiveAreaRef=SOAD_EXCLUSIVE_AREA_0
        SOAD_EXCLUSIVE_AREA_1 (RteBswExclusiveAreaImpl): RteExclusiveAreaImplMechanism=ALL_INTERRUPT_BLOCKING, RteBswExclusiveAreaRef=SOAD_EXCLUSIVE_AREA_1
      PduR: RteBswImplementationRef=PduR_Impl, RteBswModuleConfigurationRef=PduR
        PDUR_EXCLUSIVE_AREA_0 (RteBswExclusiveAreaImpl): RteExclusiveAreaImplMechanism=ALL_INTERRUPT_BLOCKING, RteBswExclusiveAreaRef=PDUR_EXCLUSIVE_AREA_0
      LdCom: RteBswImplementationRef=LdCom_Impl, RteBswModuleConfigurationRef=LdCom
    3 x RteSwComponentInstance:
      ComM_EcuSwComposition: RteSoftwareComponentInstanceRef=ComM
        31 x RteEventToTaskMapping, all with RteImmediateRestart=false:
          Timer_ComM_MainFunction_0: RtePositionInTask=8, RteEventRef=Timer_ComM_MainFunction_0, RteMappedToTaskRef=OsTask_Bsw_5ms_Core0, RteUsedOsEventRef=Rte_Ev_Cyclic2_OsTask_Bsw_5ms_Core0_0_20ms, RteUsedOsAlarmRef=Rte_Al_TE2_OsTask_Bsw_5ms_Core0_0_20ms
          OpEventLimitECUToNoComMode_LimitECUToNoComMode_modeLimitation: RteEventRef=OpEventLimitECUToNoComMode_LimitECUToNoComMode_modeLimitation
          OpEventReadInhibitCounter_ReadInhibitCounter_modeLimitation: RteEventRef=OpEventReadInhibitCounter_ReadInhibitCounter_modeLimitation
          OpEventResetInhibitCounter_ResetInhibitCounter_modeLimitation: RteEventRef=OpEventResetInhibitCounter_ResetInhibitCounter_modeLimitation
          OpEventSetECUGroupClassification_SetECUGroupClassification_modeLimitation: RteEventRef=OpEventSetECUGroupClassification_SetECUGroupClassification_modeLimitation
          OpEventGetInhibitionStatus_GetInhibitionStatus_CL_ComMChannel_untagged: RteEventRef=OpEventGetInhibitionStatus_GetInhibitionStatus_CL_ComMChannel_untagged
          OpEventGetInhibitionStatus_GetInhibitionStatus_CW_ComMChannel_untagged: RteEventRef=OpEventGetInhibitionStatus_GetInhibitionStatus_CW_ComMChannel_untagged
          OpEventLimitChannelToNoComMode_LimitChannelToNoComMode_CL_ComMChannel_untagged: RteEventRef=OpEventLimitChannelToNoComMode_LimitChannelToNoComMode_CL_ComMChannel_untagged
          OpEventPreventWakeUp_PreventWakeUp_CW_ComMChannel_untagged: RteEventRef=OpEventPreventWakeUp_PreventWakeUp_CW_ComMChannel_untagged
          OpEventRequestComMode_RequestComMode_UR_ComMUser_untagged: RteEventRef=OpEventRequestComMode_RequestComMode_UR_ComMUser_untagged
          OpEventGetCurrentComMode_GetCurrentComMode_UR_ComMUser_untagged: RteEventRef=OpEventGetCurrentComMode_GetCurrentComMode_UR_ComMUser_untagged
          OpEventGetMaxComMode_GetMaxComMode_UR_ComMUser_untagged: RteEventRef=OpEventGetMaxComMode_GetMaxComMode_UR_ComMUser_untagged
          OpEventGetRequestedComMode_GetRequestedComMode_UR_ComMUser_untagged: RteEventRef=OpEventGetRequestedComMode_GetRequestedComMode_UR_ComMUser_untagged
          Timer_ComM_MainFunction_1: RtePositionInTask=7, RteEventRef=Timer_ComM_MainFunction_1, RteMappedToTaskRef=OsTask_Bsw_5ms_Core0, RteUsedOsEventRef=Rte_Ev_Cyclic2_OsTask_Bsw_5ms_Core0_0_20ms, RteUsedOsAlarmRef=Rte_Al_TE2_OsTask_Bsw_5ms_Core0_0_20ms
          OpEventGetInhibitionStatus_GetInhibitionStatus_CL_ComMChannel_Vlan1: RteEventRef=OpEventGetInhibitionStatus_GetInhibitionStatus_CL_ComMChannel_Vlan1
          OpEventGetInhibitionStatus_GetInhibitionStatus_CW_ComMChannel_Vlan1: RteEventRef=OpEventGetInhibitionStatus_GetInhibitionStatus_CW_ComMChannel_Vlan1
          OpEventLimitChannelToNoComMode_LimitChannelToNoComMode_CL_ComMChannel_Vlan1: RteEventRef=OpEventLimitChannelToNoComMode_LimitChannelToNoComMode_CL_ComMChannel_Vlan1
          OpEventPreventWakeUp_PreventWakeUp_CW_ComMChannel_Vlan1: RteEventRef=OpEventPreventWakeUp_PreventWakeUp_CW_ComMChannel_Vlan1
          OpEventRequestComMode_RequestComMode_UR_ComMUser_Vlan1: RteEventRef=OpEventRequestComMode_RequestComMode_UR_ComMUser_Vlan1
          OpEventGetCurrentComMode_GetCurrentComMode_UR_ComMUser_Vlan1: RteEventRef=OpEventGetCurrentComMode_GetCurrentComMode_UR_ComMUser_Vlan1
          OpEventGetMaxComMode_GetMaxComMode_UR_ComMUser_Vlan1: RteEventRef=OpEventGetMaxComMode_GetMaxComMode_UR_ComMUser_Vlan1
          OpEventGetRequestedComMode_GetRequestedComMode_UR_ComMUser_Vlan1: RteEventRef=OpEventGetRequestedComMode_GetRequestedComMode_UR_ComMUser_Vlan1
          Timer_ComM_MainFunction_2: RtePositionInTask=9, RteEventRef=Timer_ComM_MainFunction_2, RteMappedToTaskRef=OsTask_Bsw_5ms_Core0, RteUsedOsEventRef=Rte_Ev_Cyclic2_OsTask_Bsw_5ms_Core0_0_20ms, RteUsedOsAlarmRef=Rte_Al_TE2_OsTask_Bsw_5ms_Core0_0_20ms
          OpEventGetInhibitionStatus_GetInhibitionStatus_CL_ComMChannel_Vlan23: RteEventRef=OpEventGetInhibitionStatus_GetInhibitionStatus_CL_ComMChannel_Vlan23
          OpEventGetInhibitionStatus_GetInhibitionStatus_CW_ComMChannel_Vlan23: RteEventRef=OpEventGetInhibitionStatus_GetInhibitionStatus_CW_ComMChannel_Vlan23
          OpEventLimitChannelToNoComMode_LimitChannelToNoComMode_CL_ComMChannel_Vlan23: RteEventRef=OpEventLimitChannelToNoComMode_LimitChannelToNoComMode_CL_ComMChannel_Vlan23
          OpEventPreventWakeUp_PreventWakeUp_CW_ComMChannel_Vlan23: RteEventRef=OpEventPreventWakeUp_PreventWakeUp_CW_ComMChannel_Vlan23
          OpEventRequestComMode_RequestComMode_UR_ComMUser_Vlan23: RteEventRef=OpEventRequestComMode_RequestComMode_UR_ComMUser_Vlan23
          OpEventGetCurrentComMode_GetCurrentComMode_UR_ComMUser_Vlan23: RteEventRef=OpEventGetCurrentComMode_GetCurrentComMode_UR_ComMUser_Vlan23
          OpEventGetMaxComMode_GetMaxComMode_UR_ComMUser_Vlan23: RteEventRef=OpEventGetMaxComMode_GetMaxComMode_UR_ComMUser_Vlan23
          OpEventGetRequestedComMode_GetRequestedComMode_UR_ComMUser_Vlan23: RteEventRef=OpEventGetRequestedComMode_GetRequestedComMode_UR_ComMUser_Vlan23
      Cdd_StbM_EcuSwComposition: RteSoftwareComponentInstanceRef=Cdd_StbM
        3 x RteEventToTaskMapping, all with RteImmediateRestart=false:
          TMT_Cdd_StbM_Runnable5ms: RtePositionInTask=14, RteEventRef=TMT_Cdd_StbM_Runnable100ms, RteMappedToTaskRef=OsTask_Asw_OsCore0, RteUsedOsEventRef=Rte_Ev_Cyclic_OsTask_Asw_OsCore0_0_100ms, RteUsedOsAlarmRef=Rte_Al_TE_OsTask_Asw_OsCore0_0_100ms
          Cdd_StbM_InitEvent: RtePositionInTask=8, RteEventRef=Cdd_StbM_InitEvent, RteMappedToTaskRef=OsTask_Init_OsCore0
          TMT_Cdd_StbM_Runnable5ms_001: RtePositionInTask=13, RteEventRef=TMT_Cdd_StbM_Runnable5ms, RteMappedToTaskRef=OsTask_Asw_OsCore0, RteUsedOsEventRef=Rte_Ev_Cyclic_OsTask_Asw_OsCore0_0_5ms, RteUsedOsAlarmRef=Rte_Al_TE_OsTask_Asw_OsCore0_0_5ms
      Cdd_PPS_EcuSwComposition: RteSoftwareComponentInstanceRef=Cdd_PPS
        TMT_Cdd_PPS_Runnable5ms (RteEventToTaskMapping):
          RteImmediateRestart = false
          RtePositionInTask = 12
          RteEventRef = TMT_Cdd_PPS_Runnable5ms
          RteMappedToTaskRef = OsTask_Asw_OsCore0
          RteUsedOsEventRef = Rte_Ev_Cyclic_OsTask_Asw_OsCore0_0_5ms
          RteUsedOsAlarmRef = Rte_Al_TE_OsTask_Asw_OsCore0_0_5ms
        Cdd_PPS_InitEvent (RteEventToTaskMapping): RteImmediateRestart=false, RtePositionInTask=6, RteEventRef=Cdd_PPS_InitEvent, RteMappedToTaskRef=OsTask_Init_OsCore0
    Cdd_StbM (RteSwComponentType): RteComponentTypeRef=Cdd_StbM, RteImplementationRef=Cdd_StbM_Implementation
      ComponentTypeCalibration (RteComponentTypeCalibration): RteCalibrationSupportEnabled=false
    Cdd_PPS (RteSwComponentType): RteComponentTypeRef=Cdd_PPS, RteImplementationRef=Cdd_PPS_Implementation
      ComponentTypeCalibration (RteComponentTypeCalibration): RteCalibrationSupportEnabled=false
    3 x RteBswModuleInstance:
      Com: RteBswImplementationRef=Com_Impl, RteBswModuleConfigurationRef=Com
        Com_MainFunctionTxTimingEvent0 (RteBswEventToTaskMapping):
          RteBswImmediateRestart = false
          RteBswPositionInTask = 7
          RteBswEventRef = Com_MainFunctionTxTimingEvent0
          RteBswMappedToTaskRef = OsTask_Bsw_1ms_Core0
          RteBswUsedOsAlarmRef = Rte_Al_TE2_OsTask_Bsw_1ms_Core0_0_1ms
        Com_MainFunctionRxTimingEvent0 (RteBswEventToTaskMapping):
          RteBswImmediateRestart = false
          RteBswPositionInTask = 6
          RteBswEventRef = Com_MainFunctionRxTimingEvent0
          RteBswMappedToTaskRef = OsTask_Bsw_1ms_Core0
          RteBswUsedOsAlarmRef = Rte_Al_TE2_OsTask_Bsw_1ms_Core0_0_1ms
        3 x RteBswExclusiveAreaImpl, all with RteExclusiveAreaImplMechanism=ALL_INTERRUPT_BLOCKING:
          COM_EXCLUSIVE_AREA_TX: RteBswExclusiveAreaRef=COM_EXCLUSIVE_AREA_TX
          COM_EXCLUSIVE_AREA_RX: RteBswExclusiveAreaRef=COM_EXCLUSIVE_AREA_RX
          COM_EXCLUSIVE_AREA_BOTH: RteBswExclusiveAreaRef=COM_EXCLUSIVE_AREA_BOTH
      DoIP: RteBswImplementationRef=DoIP_Impl, RteBswModuleConfigurationRef=DoIP
        DoIP_MainFunctionTimingEvent0 (RteBswEventToTaskMapping):
          RteBswImmediateRestart = false
          RteBswPositionInTask = 18
          RteBswEventRef = DoIP_MainFunctionTimingEvent0
          RteBswMappedToTaskRef = OsTask_Bsw_5ms_Core0
          RteBswUsedOsEventRef = Rte_Ev_Cyclic2_OsTask_Bsw_5ms_Core0_0_5ms
          RteBswUsedOsAlarmRef = Rte_Al_TE2_OsTask_Bsw_5ms_Core0_0_5ms
        DOIP_EXCLUSIVE_AREA_0 (RteBswExclusiveAreaImpl): RteExclusiveAreaImplMechanism=ALL_INTERRUPT_BLOCKING, RteBswExclusiveAreaRef=DOIP_EXCLUSIVE_AREA_0
      Dcm: RteBswImplementationRef=Dcm_Impl, RteBswModuleConfigurationRef=Dcm
        Dcm_MainFunctionTimingEvent0 (RteBswEventToTaskMapping):
          RteBswImmediateRestart = false
          RteBswPositionInTask = 19
          RteBswEventRef = Dcm_MainFunctionTimingEvent0
          RteBswMappedToTaskRef = OsTask_Bsw_5ms_Core0
          RteBswUsedOsEventRef = Rte_Ev_Cyclic2_OsTask_Bsw_5ms_Core0_0_5ms
          RteBswUsedOsAlarmRef = Rte_Al_TE2_OsTask_Bsw_5ms_Core0_0_5ms
        DCM_EXCLUSIVE_AREA_0 (RteBswExclusiveAreaImpl): RteExclusiveAreaImplMechanism=ALL_INTERRUPT_BLOCKING, RteBswExclusiveAreaRef=DCM_EXCLUSIVE_AREA_0
    Dcm_EcuSwComposition (RteSwComponentInstance): RteSoftwareComponentInstanceRef=Dcm
      6 x RteEventToTaskMapping, all with RteImmediateRestart=false:
        Timer_Dcm_MainFunction: RtePositionInTask=19, RteEventRef=Timer_Dcm_MainFunction, RteMappedToTaskRef=OsTask_Bsw_5ms_Core0, RteUsedOsEventRef=Rte_Ev_Cyclic2_OsTask_Bsw_5ms_Core0_0_5ms, RteUsedOsAlarmRef=Rte_Al_TE2_OsTask_Bsw_5ms_Core0_0_5ms
        OpEventGetActiveProtocol_GetActiveProtocol_DCMServices: RteEventRef=OpEventGetActiveProtocol_GetActiveProtocol_DCMServices
        OpEventGetSesCtrlType_GetSesCtrlType_DCMServices: RteEventRef=OpEventGetSesCtrlType_GetSesCtrlType_DCMServices
        OpEventResetToDefaultSession_ResetToDefaultSession_DCMServices: RteEventRef=OpEventResetToDefaultSession_ResetToDefaultSession_DCMServices
        OpEventSetActiveDiagnostic_SetActiveDiagnostic_DCMServices: RteEventRef=OpEventSetActiveDiagnostic_SetActiveDiagnostic_DCMServices
        OpEventGetRequestKind_GetRequestKind_DCMServices: RteEventRef=OpEventGetRequestKind_GetRequestKind_DCMServices
    Cdd_UDS (RteSwComponentType): RteComponentTypeRef=Cdd_UDS, RteImplementationRef=Cdd_UDS_Implementation
      ComponentTypeCalibration (RteComponentTypeCalibration): RteCalibrationSupportEnabled=false
    Cdd_UDS_EcuSwComposition (RteSwComponentInstance): RteSoftwareComponentInstanceRef=Cdd_UDS
      7 x RteEventToTaskMapping, all with RteImmediateRestart=false:
        Cdd_UDS_InitEvent: RtePositionInTask=10, RteEventRef=Cdd_UDS_InitEvent, RteMappedToTaskRef=OsTask_Init_OsCore0
        TMT_Cdd_Uds_Runnable10ms: RtePositionInTask=16, RteEventRef=TMT_Cdd_Uds_Runnable10ms, RteMappedToTaskRef=OsTask_Asw_OsCore0, RteUsedOsEventRef=Rte_Ev_Cyclic_OsTask_Asw_OsCore0_0_10ms, RteUsedOsAlarmRef=Rte_Al_TE_OsTask_Asw_OsCore0_0_10ms
        OIT_Runnable_DID_0x16F_DataServices_DcmDspData_NetPara_ConditionCheckRead: RteEventRef=OIT_Runnable_DID_0x16F_DataServices_DcmDspData_NetPara_ConditionCheckRead
        OIT_Runnable_DID_0x16F_DataServices_DcmDspData_NetPara_ReadData: RteEventRef=OIT_Runnable_DID_0x16F_DataServices_DcmDspData_NetPara_ReadData
        OIT_Runnable_DID_0x16F_DataServices_DcmDspData_NetPara_WriteData: RteEventRef=OIT_Runnable_DID_0x16F_DataServices_DcmDspData_NetPara_WriteData
        OIT_Runnable_RID_0x250_RoutineServices_DcmDspRoutine_0x250_SetPhyTxMode_RequestResults: RteEventRef=OIT_Runnable_RID_0x250_RoutineServices_DcmDspRoutine_0x250_SetPhyTxMode_RequestResults
        OIT_Runnable_RID_0x250_RoutineServices_DcmDspRoutine_0x250_SetPhyTxMode_Start: RteEventRef=OIT_Runnable_RID_0x250_RoutineServices_DcmDspRoutine_0x250_SetPhyTxMode_Start
    Sd (RteBswModuleInstance): RteBswImplementationRef=Sd_Impl, RteBswModuleConfigurationRef=Sd
      Sd_MainFunctionTimingEvent0 (RteBswEventToTaskMapping):
        RteBswImmediateRestart = false
        RteBswPositionInTask = 13
        RteBswEventRef = Sd_MainFunctionTimingEvent0
        RteBswMappedToTaskRef = OsTask_Bsw_5ms_Core0
        RteBswUsedOsEventRef = Rte_Ev_Cyclic2_OsTask_Bsw_5ms_Core0_0_5ms
        RteBswUsedOsAlarmRef = Rte_Al_TE2_OsTask_Bsw_5ms_Core0_0_5ms
      SD_EXCLUSIVE_AREA_0 (RteBswExclusiveAreaImpl): RteExclusiveAreaImplMechanism=ALL_INTERRUPT_BLOCKING, RteBswExclusiveAreaRef=SD_EXCLUSIVE_AREA_0
    Cdd_SomeIP_EcuSwComposition (RteSwComponentInstance): RteSoftwareComponentInstanceRef=Cdd_SomeIP
      Cdd_SomeIP_InitEvent (RteEventToTaskMapping): RteImmediateRestart=false, RtePositionInTask=12, RteEventRef=Cdd_SomeIP_InitEvent, RteMappedToTaskRef=OsTask_Init_OsCore0
      TMT_Cdd_SomeIP_Runnable_100ms (RteEventToTaskMapping):
        RteImmediateRestart = false
        RtePositionInTask = 18
        RteEventRef = TMT_Cdd_SomeIP_Runnable_100ms
        RteMappedToTaskRef = OsTask_Asw_OsCore0
        RteUsedOsEventRef = Rte_Ev_Cyclic_OsTask_Asw_OsCore0_0_100ms
        RteUsedOsAlarmRef = Rte_Al_TE_OsTask_Asw_OsCore0_0_100ms
    Cdd_SomeIP (RteSwComponentType): RteComponentTypeRef=Cdd_SomeIP, RteImplementationRef=Cdd_SomeIP_Implementation
      ComponentTypeCalibration (RteComponentTypeCalibration): RteCalibrationSupportEnabled=false
