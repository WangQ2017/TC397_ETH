AUTOSAR XML (schema 00048)
package /ActiveEcuC
  module config Rte: implementation-config-variant=VARIANT-PRE-COMPILE, module-description=Rte_Impl
    RteOsInteraction
      21 x RteUsedOsActivation, all with RteExpectedActivationOffset=0, RteExpectedTickDuration=0:
        Rte_Al_TE_Cdd_Core{1..5}_Cdd_Core{1..5}_Runnable10ms: RteActivationOsAlarmRef=Rte_Al_TE_Cdd_Core{1..5}_Cdd_Core{1..5}_Runnable10ms, RteActivationOsTaskRef=OsTask_Asw_OsCore{1..5}
        Rte_Al_TE2_EcuM_EcuM_MainFunction: RteActivationOsAlarmRef=Rte_Al_TE2_EcuM_EcuM_MainFunction, RteActivationOsTaskRef=OsTask_Bsw_OsCore1
        Rte_Al_TE3_EcuM_EcuM_MainFunction: RteActivationOsAlarmRef=Rte_Al_TE3_EcuM_EcuM_MainFunction, RteActivationOsTaskRef=OsTask_Bsw_OsCore2
        Rte_Al_TE4_EcuM_EcuM_MainFunction: RteActivationOsAlarmRef=Rte_Al_TE4_EcuM_EcuM_MainFunction, RteActivationOsTaskRef=OsTask_Bsw_OsCore3
        Rte_Al_TE5_EcuM_EcuM_MainFunction: RteActivationOsAlarmRef=Rte_Al_TE5_EcuM_EcuM_MainFunction, RteActivationOsTaskRef=OsTask_Bsw_OsCore4
        Rte_Al_TE6_EcuM_EcuM_MainFunction: RteActivationOsAlarmRef=Rte_Al_TE6_EcuM_EcuM_MainFunction, RteActivationOsTaskRef=OsTask_Bsw_OsCore5
        Rte_Al_TE2_OsTask_Bsw_10ms_Core0_0_10ms: RteActivationOsAlarmRef=Rte_Al_TE2_OsTask_Bsw_10ms_Core0_0_10ms, RteActivationOsTaskRef=OsTask_Bsw_10ms_Core0
        Rte_Al_TE_EthIf_EthIf_MainFunctionState: RteActivationOsAlarmRef=Rte_Al_TE_EthIf_EthIf_MainFunctionState, RteActivationOsTaskRef=OsTask_Bsw_5ms_Core0
        Rte_Al_TE2_OsTask_Bsw_1ms_Core0_0_1ms: RteActivationOsAlarmRef=Rte_Al_TE2_OsTask_Bsw_1ms_Core0_0_1ms, RteActivationOsTaskRef=OsTask_Bsw_1ms_Core0
        Rte_Al_TE_Eth_30_Tc3xx_Eth_30_Tc3xx_MainFunction: RteActivationOsAlarmRef=Rte_Al_TE_Eth_30_Tc3xx_Eth_30_Tc3xx_MainFunction, RteActivationOsTaskRef=OsTask_Bsw_20ms_Core0
        Rte_Al_TE2_OsTask_Bsw_5ms_Core0_0_5ms: RteActivationOsAlarmRef=Rte_Al_TE2_OsTask_Bsw_5ms_Core0_0_5ms, RteActivationOsTaskRef=OsTask_Bsw_5ms_Core0
        Rte_Al_TE_EthTrcv_30_Tja1100_EthTrcv_30_Tja1100_MainFunction: RteActivationOsAlarmRef=Rte_Al_TE_EthTrcv_30_Tja1100_EthTrcv_30_Tja1100_MainFunction, RteActivationOsTaskRef=OsTask_Bsw_5ms_Core0
        Rte_Al_TE_Cdd_Core0_Cdd_Core0_Runnable20ms: RteActivationOsAlarmRef=Rte_Al_TE_Cdd_Core0_Cdd_Core0_Runnable20ms, RteActivationOsTaskRef=OsTask_Asw_OsCore0
        Rte_Al_TE_OsTask_Asw_OsCore0_0_10ms: RteActivationOsAlarmRef=Rte_Al_TE_OsTask_Asw_OsCore0_0_10ms, RteActivationOsTaskRef=OsTask_Asw_OsCore0
        Rte_Al_TE2_OsTask_Bsw_5ms_Core0_0_10ms: RteActivationOsAlarmRef=Rte_Al_TE2_OsTask_Bsw_5ms_Core0_0_10ms, RteActivationOsTaskRef=OsTask_Bsw_5ms_Core0
        Rte_Al_TE_OsTask_Asw_OsCore0_0_5ms: RteActivationOsAlarmRef=Rte_Al_TE_OsTask_Asw_OsCore0_0_5ms, RteActivationOsTaskRef=OsTask_Asw_OsCore0
        Rte_Al_TE_Cdd_Core0_Cdd_Core0_Runnable1ms: RteActivationOsAlarmRef=Rte_Al_TE_Cdd_Core0_Cdd_Core0_Runnable1ms, RteActivationOsTaskRef=OsTask_Asw_OsCore0
    RteGeneration:
      RteGenerationMode = COMPATIBILITY_MODE
      RteIocInteractionReturnValue = RTE_IOC
      RteValueRangeCheckEnabled = false
      RteCalibrationSupport = NONE
      RteCodeVendorId = 30
      RteDevErrorDetect = false
      RteDevErrorDetectUninit = false
      RteMeasurementSupport = false
      RteOptimizationMode = MEMORY
      RteVfbTraceEnabled = false
    RteInitializationBehavior: RteInitializationStrategy=RTE_INITIALIZATION_STRATEGY_AT_DATA_DECLARATION, RteSectionInitializationPolicy=INIT
    RteBswGeneral: RteSchMVersionInfoApi=false, RteUseComShadowSignalApi=false
    5 x RteBswModuleInstance:
      Dio: RteBswImplementationRef=Dio_Impl, RteBswModuleConfigurationRef=Dio
      McalLib: RteBswImplementationRef=McalLib_Impl, RteBswModuleConfigurationRef=McalLib
        4 x RteBswExclusiveAreaImpl, all with RteExclusiveAreaImplMechanism=ALL_INTERRUPT_BLOCKING:
          PeripheralEndInit: RteBswExclusiveAreaRef=PeripheralEndInit
          SafetyEndInit: RteBswExclusiveAreaRef=SafetyEndInit
          CpuEndInit: RteBswExclusiveAreaRef=CpuEndInit
          StmTimerResolution: RteBswExclusiveAreaRef=StmTimerResolution
      Port: RteBswImplementationRef=Port_Impl, RteBswModuleConfigurationRef=Port
      Irq: RteBswImplementationRef=Irq_Impl, RteBswModuleConfigurationRef=Irq
      BswM: RteBswImplementationRef=BswM_Impl, RteBswModuleConfigurationRef=BswM
        BSWM_EXCLUSIVE_AREA_0 (RteBswExclusiveAreaImpl): RteExclusiveAreaImplMechanism=ALL_INTERRUPT_BLOCKING, RteBswExclusiveAreaRef=BSWM_EXCLUSIVE_AREA_0
        BswM_MainFunctionTimingEvent0 (RteBswEventToTaskMapping):
          RteBswImmediateRestart = false
          RteBswPositionInTask = 2
          RteBswEventRef = BswM_MainFunctionTimingEvent0
          RteBswMappedToTaskRef = OsTask_Bsw_10ms_Core0
          RteBswUsedOsAlarmRef = Rte_Al_TE2_OsTask_Bsw_10ms_Core0_0_10ms
    3 x RteSwComponentInstance:
      Det_EcuSwComposition: RteSoftwareComponentInstanceRef=Det
      EcuM_EcuSwComposition: RteSoftwareComponentInstanceRef=EcuM
        8 x RteEventToTaskMapping, all with RteImmediateRestart=false:
          Timer_EcuM_MainFunction: RtePositionInTask=0, RteEventRef=Timer_EcuM_MainFunction, RteMappedToTaskRef=OsTask_Bsw_10ms_Core0, RteUsedOsAlarmRef=Rte_Al_TE2_OsTask_Bsw_10ms_Core0_0_10ms
          OpEventSelectShutdownTarget_SelectShutdownTarget_EcuM_ShutdownTarget: RteEventRef=OpEventSelectShutdownTarget_SelectShutdownTarget_EcuM_ShutdownTarget
          OpEventGetShutdownTarget_GetShutdownTarget_EcuM_ShutdownTarget: RteEventRef=OpEventGetShutdownTarget_GetShutdownTarget_EcuM_ShutdownTarget
          OpEventGetLastShutdownTarget_GetLastShutdownTarget_EcuM_ShutdownTarget: RteEventRef=OpEventGetLastShutdownTarget_GetLastShutdownTarget_EcuM_ShutdownTarget
          OpEventSelectShutdownCause_SelectShutdownCause_EcuM_ShutdownTarget: RteEventRef=OpEventSelectShutdownCause_SelectShutdownCause_EcuM_ShutdownTarget
          OpEventGetShutdownCause_GetShutdownCause_EcuM_ShutdownTarget: RteEventRef=OpEventGetShutdownCause_GetShutdownCause_EcuM_ShutdownTarget
          OpEventSelectBootTarget_SelectBootTarget_EcuM_BootTarget: RteEventRef=OpEventSelectBootTarget_SelectBootTarget_EcuM_BootTarget
          OpEventGetBootTarget_GetBootTarget_EcuM_BootTarget: RteEventRef=OpEventGetBootTarget_GetBootTarget_EcuM_BootTarget
      Os_OsCore0_swc_EcuSwComposition: RteSoftwareComponentInstanceRef=Os_OsCore0_swc
        OpEventGetCounterValue_GetCounterValue_OsService_SystemTimer_OsCore0 (RteEventToTaskMapping): RteImmediateRestart=false, RteEventRef=OpEventGetCounterValue_GetCounterValue_OsService_SystemTimer_OsCore0
        OpEventGetElapsedValue_GetElapsedValue_OsService_SystemTimer_OsCore0 (RteEventToTaskMapping): RteImmediateRestart=false, RteEventRef=OpEventGetElapsedValue_GetElapsedValue_OsService_SystemTimer_OsCore0
    3 x RteBswModuleInstance:
      Det: RteBswImplementationRef=Det_Impl, RteBswModuleConfigurationRef=Det
        DET_EXCLUSIVE_AREA_0 (RteBswExclusiveAreaImpl): RteExclusiveAreaImplMechanism=ALL_INTERRUPT_BLOCKING, RteBswExclusiveAreaRef=DET_EXCLUSIVE_AREA_0
      EcuM: RteBswImplementationRef=EcuM_Impl, RteBswModuleConfigurationRef=EcuM
        4 x RteBswExclusiveAreaImpl, all with RteExclusiveAreaImplMechanism=ALL_INTERRUPT_BLOCKING:
          ECUM_EXCLUSIVE_AREA_{0..3}: RteBswExclusiveAreaRef=ECUM_EXCLUSIVE_AREA_{0..3}
        6 x RteBswEventToTaskMapping, all with RteBswImmediateRestart=false, RteBswPositionInTask=0:
          EcuM_MainFunctionTimingEvent0: RteBswEventRef=EcuM_MainFunctionTimingEvent0, RteBswMappedToTaskRef=OsTask_Bsw_10ms_Core0, RteBswUsedOsAlarmRef=Rte_Al_TE2_OsTask_Bsw_10ms_Core0_0_10ms
          EcuM_MainFunctionTimingEvent1: RteBswEventRef=EcuM_MainFunctionTimingEvent1, RteBswMappedToTaskRef=OsTask_Bsw_OsCore1, RteBswUsedOsAlarmRef=Rte_Al_TE2_EcuM_EcuM_MainFunction
          EcuM_MainFunctionTimingEvent2: RteBswEventRef=EcuM_MainFunctionTimingEvent2, RteBswMappedToTaskRef=OsTask_Bsw_OsCore2, RteBswUsedOsAlarmRef=Rte_Al_TE3_EcuM_EcuM_MainFunction
          EcuM_MainFunctionTimingEvent3: RteBswEventRef=EcuM_MainFunctionTimingEvent3, RteBswMappedToTaskRef=OsTask_Bsw_OsCore3, RteBswUsedOsAlarmRef=Rte_Al_TE4_EcuM_EcuM_MainFunction
          EcuM_MainFunctionTimingEvent4: RteBswEventRef=EcuM_MainFunctionTimingEvent4, RteBswMappedToTaskRef=OsTask_Bsw_OsCore4, RteBswUsedOsAlarmRef=Rte_Al_TE5_EcuM_EcuM_MainFunction
          EcuM_MainFunctionTimingEvent5: RteBswEventRef=EcuM_MainFunctionTimingEvent5, RteBswMappedToTaskRef=OsTask_Bsw_OsCore5, RteBswUsedOsAlarmRef=Rte_Al_TE6_EcuM_EcuM_MainFunction
      Rte: RteBswImplementationRef=Rte_Impl, RteBswModuleConfigurationRef=Rte
        Rte_ComSendSignalProxyPeriodicTimingEvent0 (RteBswEventToTaskMapping):
          RteBswImmediateRestart = false
          RteBswPositionInTask = 14
          RteBswEventRef = Rte_ComSendSignalProxyPeriodicTimingEvent0
          RteBswMappedToTaskRef = OsTask_Bsw_1ms_Core0
    11 x RteSwComponentInstance:
      Os_OsCore1_swc_EcuSwComposition: RteSoftwareComponentInstanceRef=Os_OsCore1_swc
        OpEventGetCounterValue_GetCounterValue_OsService_SystemTimer_OsCore1 (RteEventToTaskMapping): RteImmediateRestart=false, RteEventRef=OpEventGetCounterValue_GetCounterValue_OsService_SystemTimer_OsCore1
        OpEventGetElapsedValue_GetElapsedValue_OsService_SystemTimer_OsCore1 (RteEventToTaskMapping): RteImmediateRestart=false, RteEventRef=OpEventGetElapsedValue_GetElapsedValue_OsService_SystemTimer_OsCore1
      Os_OsCore2_swc_EcuSwComposition: RteSoftwareComponentInstanceRef=Os_OsCore2_swc
        OpEventGetCounterValue_GetCounterValue_OsService_SystemTimer_OsCore2 (RteEventToTaskMapping): RteImmediateRestart=false, RteEventRef=OpEventGetCounterValue_GetCounterValue_OsService_SystemTimer_OsCore2
        OpEventGetElapsedValue_GetElapsedValue_OsService_SystemTimer_OsCore2 (RteEventToTaskMapping): RteImmediateRestart=false, RteEventRef=OpEventGetElapsedValue_GetElapsedValue_OsService_SystemTimer_OsCore2
      Os_OsCore3_swc_EcuSwComposition: RteSoftwareComponentInstanceRef=Os_OsCore3_swc
        OpEventGetCounterValue_GetCounterValue_OsService_SystemTimer_OsCore3 (RteEventToTaskMapping): RteImmediateRestart=false, RteEventRef=OpEventGetCounterValue_GetCounterValue_OsService_SystemTimer_OsCore3
        OpEventGetElapsedValue_GetElapsedValue_OsService_SystemTimer_OsCore3 (RteEventToTaskMapping): RteImmediateRestart=false, RteEventRef=OpEventGetElapsedValue_GetElapsedValue_OsService_SystemTimer_OsCore3
      Os_OsCore4_swc_EcuSwComposition: RteSoftwareComponentInstanceRef=Os_OsCore4_swc
        OpEventGetCounterValue_GetCounterValue_OsService_SystemTimer_OsCore4 (RteEventToTaskMapping): RteImmediateRestart=false, RteEventRef=OpEventGetCounterValue_GetCounterValue_OsService_SystemTimer_OsCore4
        OpEventGetElapsedValue_GetElapsedValue_OsService_SystemTimer_OsCore4 (RteEventToTaskMapping): RteImmediateRestart=false, RteEventRef=OpEventGetElapsedValue_GetElapsedValue_OsService_SystemTimer_OsCore4
      Os_OsCore5_swc_EcuSwComposition: RteSoftwareComponentInstanceRef=Os_OsCore5_swc
        OpEventGetCounterValue_GetCounterValue_OsService_SystemTimer_OsCore5 (RteEventToTaskMapping): RteImmediateRestart=false, RteEventRef=OpEventGetCounterValue_GetCounterValue_OsService_SystemTimer_OsCore5
        OpEventGetElapsedValue_GetElapsedValue_OsService_SystemTimer_OsCore5 (RteEventToTaskMapping): RteImmediateRestart=false, RteEventRef=OpEventGetElapsedValue_GetElapsedValue_OsService_SystemTimer_OsCore5
      Cdd_Core0_EcuSwComposition: RteSoftwareComponentInstanceRef=Cdd_Core0
        5 x RteEventToTaskMapping, all with RteImmediateRestart=false:
          Cdd_Core0_InitEvent: RtePositionInTask=0, RteEventRef=Cdd_Core0_InitEvent, RteMappedToTaskRef=OsTask_Init_OsCore0
          TMT_Runnable_5ms: RtePositionInTask=5, RteEventRef=TMT_Cdd_Core0_Runnable10ms, RteMappedToTaskRef=OsTask_Asw_OsCore0, RteUsedOsEventRef=Rte_Ev_Cyclic_OsTask_Asw_OsCore0_0_10ms, RteUsedOsAlarmRef=Rte_Al_TE_OsTask_Asw_OsCore0_0_10ms
          TMT_Runnable_20: RtePositionInTask=6, RteEventRef=TMT_Cdd_Core0_Runnable20ms, RteMappedToTaskRef=OsTask_Asw_OsCore0, RteUsedOsEventRef=Rte_Ev_Run_Cdd_Core0_Cdd_Core0_Runnable20ms, RteUsedOsAlarmRef=Rte_Al_TE_Cdd_Core0_Cdd_Core0_Runnable20ms
          TMT_Cdd_Nm_Runnable5ms: RtePositionInTask=4, RteEventRef=TMT_Cdd_Core0_Runnable5ms, RteMappedToTaskRef=OsTask_Asw_OsCore0, RteUsedOsEventRef=Rte_Ev_Cyclic_OsTask_Asw_OsCore0_0_5ms, RteUsedOsAlarmRef=Rte_Al_TE_OsTask_Asw_OsCore0_0_5ms
          TMT_Cdd_Core0_Runnable1ms: RtePositionInTask=0, RteEventRef=TMT_Cdd_Core0_Runnable1ms, RteMappedToTaskRef=OsTask_Asw_OsCore0, RteUsedOsEventRef=Rte_Ev_Run_Cdd_Core0_Cdd_Core0_Runnable1ms, RteUsedOsAlarmRef=Rte_Al_TE_Cdd_Core0_Cdd_Core0_Runnable1ms
      Cdd_Core1_EcuSwComposition: RteSoftwareComponentInstanceRef=Cdd_Core1
        Cdd_Core1_InitEvent (RteEventToTaskMapping): RteImmediateRestart=false, RtePositionInTask=0, RteEventRef=Cdd_Core1_InitEvent, RteMappedToTaskRef=OsTask_Init_OsCore1
        TMT_Cdd_Core1_Runnable10ms (RteEventToTaskMapping):
          RteImmediateRestart = false
          RtePositionInTask = 0
          RteEventRef = TMT_Cdd_Core1_Runnable10ms
          RteMappedToTaskRef = OsTask_Asw_OsCore1
          RteUsedOsAlarmRef = Rte_Al_TE_Cdd_Core1_Cdd_Core1_Runnable10ms
      Cdd_Core2_EcuSwComposition: RteSoftwareComponentInstanceRef=Cdd_Core2
        Cdd_Core2_InitEvent (RteEventToTaskMapping): RteImmediateRestart=false, RtePositionInTask=0, RteEventRef=Cdd_Core2_InitEvent, RteMappedToTaskRef=OsTask_Init_OsCore2
        TMT_Cdd_Core2_Runnable10ms (RteEventToTaskMapping):
          RteImmediateRestart = false
          RtePositionInTask = 0
          RteEventRef = TMT_Cdd_Core2_Runnable10ms
          RteMappedToTaskRef = OsTask_Asw_OsCore2
          RteUsedOsAlarmRef = Rte_Al_TE_Cdd_Core2_Cdd_Core2_Runnable10ms
      Cdd_Core3_EcuSwComposition: RteSoftwareComponentInstanceRef=Cdd_Core3
        Cdd_Core3_InitEvent (RteEventToTaskMapping): RteImmediateRestart=false, RtePositionInTask=0, RteEventRef=Cdd_Core3_InitEvent, RteMappedToTaskRef=OsTask_Init_OsCore3
        TMT_Cdd_Core3_Runnable10ms (RteEventToTaskMapping):
          RteImmediateRestart = false
          RtePositionInTask = 0
          RteEventRef = TMT_Cdd_Core3_Runnable10ms
          RteMappedToTaskRef = OsTask_Asw_OsCore3
          RteUsedOsAlarmRef = Rte_Al_TE_Cdd_Core3_Cdd_Core3_Runnable10ms
      Cdd_Core4_EcuSwComposition: RteSoftwareComponentInstanceRef=Cdd_Core4
        Cdd_Core4_InitEvent (RteEventToTaskMapping): RteImmediateRestart=false, RtePositionInTask=0, RteEventRef=Cdd_Core4_InitEvent, RteMappedToTaskRef=OsTask_Init_OsCore4
        TMT_Cdd_Core4_Runnable10ms (RteEventToTaskMapping):
          RteImmediateRestart = false
          RtePositionInTask = 0
          RteEventRef = TMT_Cdd_Core4_Runnable10ms
          RteMappedToTaskRef = OsTask_Asw_OsCore4
          RteUsedOsAlarmRef = Rte_Al_TE_Cdd_Core4_Cdd_Core4_Runnable10ms
      Cdd_Core5_EcuSwComposition: RteSoftwareComponentInstanceRef=Cdd_Core5
        Cdd_Core5_InitEvent (RteEventToTaskMapping): RteImmediateRestart=false, RtePositionInTask=0, RteEventRef=Cdd_Core5_InitEvent, RteMappedToTaskRef=OsTask_Init_OsCore5
        TMT_Cdd_Core5_Runnable10ms (RteEventToTaskMapping):
          RteImmediateRestart = false
          RtePositionInTask = 0
          RteEventRef = TMT_Cdd_Core5_Runnable10ms
          RteMappedToTaskRef = OsTask_Asw_OsCore5
          RteUsedOsAlarmRef = Rte_Al_TE_Cdd_Core5_Cdd_Core5_Runnable10ms
    6 x RteSwComponentType:
      Cdd_Core0: RteComponentTypeRef=Cdd_Core0, RteImplementationRef=Cdd_Core0_Implementation
        ComponentTypeCalibration (RteComponentTypeCalibration): RteCalibrationSupportEnabled=false
      Cdd_Core1: RteComponentTypeRef=Cdd_Core1, RteImplementationRef=Cdd_Core1_Implementation
        ComponentTypeCalibration (RteComponentTypeCalibration): RteCalibrationSupportEnabled=false
      Cdd_Core2: RteComponentTypeRef=Cdd_Core2, RteImplementationRef=Cdd_Core2_Implementation
        ComponentTypeCalibration (RteComponentTypeCalibration): RteCalibrationSupportEnabled=false
      Cdd_Core3: RteComponentTypeRef=Cdd_Core3, RteImplementationRef=Cdd_Core3_Implementation
        ComponentTypeCalibration (RteComponentTypeCalibration): RteCalibrationSupportEnabled=false
      Cdd_Core4: RteComponentTypeRef=Cdd_Core4, RteImplementationRef=Cdd_Core4_Implementation
        ComponentTypeCalibration (RteComponentTypeCalibration): RteCalibrationSupportEnabled=false
      Cdd_Core5: RteComponentTypeRef=Cdd_Core5, RteImplementationRef=Cdd_Core5_Implementation
        ComponentTypeCalibration (RteComponentTypeCalibration): RteCalibrationSupportEnabled=false
    BswM_EcuSwComposition (RteSwComponentInstance): RteSoftwareComponentInstanceRef=BswM
      Timer_BswM_MainFunction (RteEventToTaskMapping):
        RteImmediateRestart = false
        RtePositionInTask = 2
        RteEventRef = Timer_BswM_MainFunction
        RteMappedToTaskRef = OsTask_Bsw_10ms_Core0
        RteUsedOsAlarmRef = Rte_Al_TE2_OsTask_Bsw_10ms_Core0_0_10ms
    Cdd_nm_EcuSwComposition (RteSwComponentInstance): RteSoftwareComponentInstanceRef=Cdd_nm
      TMT_Cdd_Nm_Runnable10ms (RteEventToTaskMapping):
        RteImmediateRestart = false
        RtePositionInTask = 8
        RteEventRef = TMT_Cdd_Nm_Runnable10ms
        RteMappedToTaskRef = OsTask_Asw_OsCore0
        RteUsedOsEventRef = Rte_Ev_Cyclic_OsTask_Asw_OsCore0_0_10ms
        RteUsedOsAlarmRef = Rte_Al_TE_OsTask_Asw_OsCore0_0_10ms
      Cdd_Nm_InitEvent (RteEventToTaskMapping): RteImmediateRestart=false, RtePositionInTask=2, RteEventRef=Cdd_Nm_InitEvent, RteMappedToTaskRef=OsTask_Init_OsCore0
    Cdd_Nm (RteSwComponentType): RteComponentTypeRef=Cdd_Nm, RteImplementationRef=Cdd_Nm_Implementation
      ComponentTypeCalibration (RteComponentTypeCalibration): RteCalibrationSupportEnabled=false
    4 x RteBswModuleInstance:
      Eth: RteBswImplementationRef=Eth_Impl, RteBswModuleConfigurationRef=Eth
        Eth_30_Tc3xx_MainFunctionTimingEvent0 (RteBswEventToTaskMapping):
          RteBswImmediateRestart = false
          RteBswPositionInTask = 4
          RteBswEventRef = Eth_30_Tc3xx_MainFunctionTimingEvent0
          RteBswMappedToTaskRef = OsTask_Bsw_20ms_Core0
          RteBswUsedOsAlarmRef = Rte_Al_TE_Eth_30_Tc3xx_Eth_30_Tc3xx_MainFunction
        3 x RteBswExclusiveAreaImpl, all with RteExclusiveAreaImplMechanism=ALL_INTERRUPT_BLOCKING:
          ETH_30_TC3XX_EXCLUSIVE_AREA_DATA: RteBswExclusiveAreaRef=ETH_30_TC3XX_EXCLUSIVE_AREA_DATA
          ETH_30_TC3XX_EXCLUSIVE_AREA_MII: RteBswExclusiveAreaRef=ETH_30_TC3XX_EXCLUSIVE_AREA_MII
          ETH_30_TC3XX_EXCLUSIVE_AREA_DISABLE_MAC: RteBswExclusiveAreaRef=ETH_30_TC3XX_EXCLUSIVE_AREA_DISABLE_MAC
      EthTSyn: RteBswImplementationRef=EthTSyn_Impl, RteBswModuleConfigurationRef=EthTSyn
        EthTSyn_MainFunctionTimingEvent0 (RteBswEventToTaskMapping):
          RteBswImmediateRestart = false
          RteBswPositionInTask = 27
          RteBswEventRef = EthTSyn_MainFunctionTimingEvent0
          RteBswMappedToTaskRef = OsTask_Bsw_5ms_Core0
          RteBswUsedOsAlarmRef = Rte_Al_TE2_OsTask_Bsw_5ms_Core0_0_5ms
          RteBswUsedOsEventRef = Rte_Ev_Cyclic2_OsTask_Bsw_5ms_Core0_0_5ms
        3 x RteBswExclusiveAreaImpl, all with RteExclusiveAreaImplMechanism=ALL_INTERRUPT_BLOCKING:
          ETHTSYN_EXCLUSIVE_AREA_0: RteBswExclusiveAreaRef=ETHTSYN_EXCLUSIVE_AREA_0
          ETHTSYN_EXCLUSIVE_AREA_GET_TS: RteBswExclusiveAreaRef=ETHTSYN_EXCLUSIVE_AREA_GET_TS
          ETHTSYN_EXCLUSIVE_AREA_TIME_VALID: RteBswExclusiveAreaRef=ETHTSYN_EXCLUSIVE_AREA_TIME_VALID
      ComM: RteBswImplementationRef=ComM_Impl, RteBswModuleConfigurationRef=ComM
        ComM_MainFunction_0TimingEvent0 (RteBswEventToTaskMapping):
          RteBswImmediateRestart = false
          RteBswPositionInTask = 9
          RteBswEventRef = ComM_MainFunction_0TimingEvent0
          RteBswMappedToTaskRef = OsTask_Bsw_5ms_Core0
          RteBswUsedOsAlarmRef = Rte_Al_TE2_OsTask_Bsw_5ms_Core0_0_5ms
          RteBswUsedOsEventRef = Rte_Ev_Cyclic2_OsTask_Bsw_5ms_Core0_0_5ms
        COMM_EXCLUSIVE_AREA_0 (RteBswExclusiveAreaImpl): RteExclusiveAreaImplMechanism=ALL_INTERRUPT_BLOCKING, RteBswExclusiveAreaRef=COMM_EXCLUSIVE_AREA_0
        COMM_EXCLUSIVE_AREA_1 (RteBswExclusiveAreaImpl): RteExclusiveAreaImplMechanism=ALL_INTERRUPT_BLOCKING, RteBswExclusiveAreaRef=COMM_EXCLUSIVE_AREA_1
        ComM_MainFunction_1TimingEvent0 (RteBswEventToTaskMapping):
          RteBswImmediateRestart = false
          RteBswPositionInTask = 12
          RteBswEventRef = ComM_MainFunction_1TimingEvent0
          RteBswMappedToTaskRef = OsTask_Bsw_5ms_Core0
          RteBswUsedOsEventRef = Rte_Ev_Cyclic2_OsTask_Bsw_5ms_Core0_0_5ms
          RteBswUsedOsAlarmRef = Rte_Al_TE2_OsTask_Bsw_5ms_Core0_0_5ms
        ComM_MainFunction_2TimingEvent0 (RteBswEventToTaskMapping):
          RteBswImmediateRestart = false
          RteBswPositionInTask = 13
          RteBswEventRef = ComM_MainFunction_2TimingEvent0
          RteBswMappedToTaskRef = OsTask_Bsw_5ms_Core0
          RteBswUsedOsEventRef = Rte_Ev_Cyclic2_OsTask_Bsw_5ms_Core0_0_5ms
          RteBswUsedOsAlarmRef = Rte_Al_TE2_OsTask_Bsw_5ms_Core0_0_5ms
      StbM: RteBswImplementationRef=StbM_Impl, RteBswModuleConfigurationRef=StbM
        StbM_MainFunctionTimingEvent0 (RteBswEventToTaskMapping):
          RteBswImmediateRestart = false
          RteBswPositionInTask = 29
          RteBswEventRef = StbM_MainFunctionTimingEvent0
          RteBswMappedToTaskRef = OsTask_Bsw_5ms_Core0
          RteBswUsedOsAlarmRef = Rte_Al_TE2_OsTask_Bsw_5ms_Core0_0_5ms
          RteBswUsedOsEventRef = Rte_Ev_Cyclic2_OsTask_Bsw_5ms_Core0_0_5ms
        STBM_EXCLUSIVE_AREA_0 (RteBswExclusiveAreaImpl): RteExclusiveAreaImplMechanism=ALL_INTERRUPT_BLOCKING, RteBswExclusiveAreaRef=STBM_EXCLUSIVE_AREA_0
    ComM_EcuSwComposition (RteSwComponentInstance): RteSoftwareComponentInstanceRef=ComM
      35 x RteEventToTaskMapping, all with RteImmediateRestart=false:
        Timer_ComM_MainFunction_0: RtePositionInTask=9, RteEventRef=Timer_ComM_MainFunction_0, RteMappedToTaskRef=OsTask_Bsw_5ms_Core0, RteUsedOsAlarmRef=Rte_Al_TE2_OsTask_Bsw_5ms_Core0_0_5ms, RteUsedOsEventRef=Rte_Ev_Cyclic2_OsTask_Bsw_5ms_Core0_0_5ms
        OpEventLimitECUToNoComMode_LimitECUToNoComMode_modeLimitation: RteEventRef=OpEventLimitECUToNoComMode_LimitECUToNoComMode_modeLimitation
        OpEventReadInhibitCounter_ReadInhibitCounter_modeLimitation: RteEventRef=OpEventReadInhibitCounter_ReadInhibitCounter_modeLimitation
        OpEventResetInhibitCounter_ResetInhibitCounter_modeLimitation: RteEventRef=OpEventResetInhibitCounter_ResetInhibitCounter_modeLimitation
        OpEventSetECUGroupClassification_SetECUGroupClassification_modeLimitation: RteEventRef=OpEventSetECUGroupClassification_SetECUGroupClassification_modeLimitation
        OpEventGetInhibitionStatus_GetInhibitionStatus_CL_ComMChannel_Vlan10: RteEventRef=OpEventGetInhibitionStatus_GetInhibitionStatus_CL_ComMChannel_Vlan10
        OpEventGetInhibitionStatus_GetInhibitionStatus_CW_ComMChannel_Vlan10: RteEventRef=OpEventGetInhibitionStatus_GetInhibitionStatus_CW_ComMChannel_Vlan10
        OpEventLimitChannelToNoComMode_LimitChannelToNoComMode_CL_ComMChannel_Vlan10: RteEventRef=OpEventLimitChannelToNoComMode_LimitChannelToNoComMode_CL_ComMChannel_Vlan10
        OpEventPreventWakeUp_PreventWakeUp_CW_ComMChannel_Vlan10: RteEventRef=OpEventPreventWakeUp_PreventWakeUp_CW_ComMChannel_Vlan10
        OpEventRequestComMode_RequestComMode_UR_ComMUser_Channel_Vlan10: RteEventRef=OpEventRequestComMode_RequestComMode_UR_ComMUser_Channel_Vlan10
        OpEventRequestComMode_RequestComMode_UR_ComMUser_Pnc00: RteEventRef=OpEventRequestComMode_RequestComMode_UR_ComMUser_Pnc00
        OpEventGetCurrentComMode_GetCurrentComMode_UR_ComMUser_Channel_Vlan10: RteEventRef=OpEventGetCurrentComMode_GetCurrentComMode_UR_ComMUser_Channel_Vlan10
        OpEventGetCurrentComMode_GetCurrentComMode_UR_ComMUser_Pnc00: RteEventRef=OpEventGetCurrentComMode_GetCurrentComMode_UR_ComMUser_Pnc00
        OpEventGetMaxComMode_GetMaxComMode_UR_ComMUser_Channel_Vlan10: RteEventRef=OpEventGetMaxComMode_GetMaxComMode_UR_ComMUser_Channel_Vlan10
        OpEventGetMaxComMode_GetMaxComMode_UR_ComMUser_Pnc00: RteEventRef=OpEventGetMaxComMode_GetMaxComMode_UR_ComMUser_Pnc00
        OpEventGetRequestedComMode_GetRequestedComMode_UR_ComMUser_Channel_Vlan10: RteEventRef=OpEventGetRequestedComMode_GetRequestedComMode_UR_ComMUser_Channel_Vlan10
        OpEventGetRequestedComMode_GetRequestedComMode_UR_ComMUser_Pnc00: RteEventRef=OpEventGetRequestedComMode_GetRequestedComMode_UR_ComMUser_Pnc00
        Timer_ComM_MainFunction_1: RtePositionInTask=12, RteEventRef=Timer_ComM_MainFunction_1, RteMappedToTaskRef=OsTask_Bsw_5ms_Core0, RteUsedOsEventRef=Rte_Ev_Cyclic2_OsTask_Bsw_5ms_Core0_0_5ms, RteUsedOsAlarmRef=Rte_Al_TE2_OsTask_Bsw_5ms_Core0_0_5ms
        OpEventGetInhibitionStatus_GetInhibitionStatus_CL_ComMChannel_Vlan23: RteEventRef=OpEventGetInhibitionStatus_GetInhibitionStatus_CL_ComMChannel_Vlan23
        OpEventGetInhibitionStatus_GetInhibitionStatus_CW_ComMChannel_Vlan23: RteEventRef=OpEventGetInhibitionStatus_GetInhibitionStatus_CW_ComMChannel_Vlan23
        OpEventLimitChannelToNoComMode_LimitChannelToNoComMode_CL_ComMChannel_Vlan23: RteEventRef=OpEventLimitChannelToNoComMode_LimitChannelToNoComMode_CL_ComMChannel_Vlan23
        OpEventPreventWakeUp_PreventWakeUp_CW_ComMChannel_Vlan23: RteEventRef=OpEventPreventWakeUp_PreventWakeUp_CW_ComMChannel_Vlan23
        OpEventRequestComMode_RequestComMode_UR_ComMUser_Channel_Vlan23: RteEventRef=OpEventRequestComMode_RequestComMode_UR_ComMUser_Channel_Vlan23
        OpEventGetCurrentComMode_GetCurrentComMode_UR_ComMUser_Channel_Vlan23: RteEventRef=OpEventGetCurrentComMode_GetCurrentComMode_UR_ComMUser_Channel_Vlan23
        OpEventGetMaxComMode_GetMaxComMode_UR_ComMUser_Channel_Vlan23: RteEventRef=OpEventGetMaxComMode_GetMaxComMode_UR_ComMUser_Channel_Vlan23
        OpEventGetRequestedComMode_GetRequestedComMode_UR_ComMUser_Channel_Vlan23: RteEventRef=OpEventGetRequestedComMode_GetRequestedComMode_UR_ComMUser_Channel_Vlan23
        Timer_ComM_MainFunction_2: RtePositionInTask=13, RteEventRef=Timer_ComM_MainFunction_2, RteMappedToTaskRef=OsTask_Bsw_5ms_Core0, RteUsedOsEventRef=Rte_Ev_Cyclic2_OsTask_Bsw_5ms_Core0_0_5ms, RteUsedOsAlarmRef=Rte_Al_TE2_OsTask_Bsw_5ms_Core0_0_5ms
        OpEventGetInhibitionStatus_GetInhibitionStatus_CL_ComMChannel_Vlan1: RteEventRef=OpEventGetInhibitionStatus_GetInhibitionStatus_CL_ComMChannel_Vlan1
        OpEventGetInhibitionStatus_GetInhibitionStatus_CW_ComMChannel_Vlan1: RteEventRef=OpEventGetInhibitionStatus_GetInhibitionStatus_CW_ComMChannel_Vlan1
        OpEventLimitChannelToNoComMode_LimitChannelToNoComMode_CL_ComMChannel_Vlan1: RteEventRef=OpEventLimitChannelToNoComMode_LimitChannelToNoComMode_CL_ComMChannel_Vlan1
        OpEventPreventWakeUp_PreventWakeUp_CW_ComMChannel_Vlan1: RteEventRef=OpEventPreventWakeUp_PreventWakeUp_CW_ComMChannel_Vlan1
        OpEventRequestComMode_RequestComMode_UR_ComMUser_Channel_Vlan1: RteEventRef=OpEventRequestComMode_RequestComMode_UR_ComMUser_Channel_Vlan1
        OpEventGetCurrentComMode_GetCurrentComMode_UR_ComMUser_Channel_Vlan1: RteEventRef=OpEventGetCurrentComMode_GetCurrentComMode_UR_ComMUser_Channel_Vlan1
        OpEventGetMaxComMode_GetMaxComMode_UR_ComMUser_Channel_Vlan1: RteEventRef=OpEventGetMaxComMode_GetMaxComMode_UR_ComMUser_Channel_Vlan1
        OpEventGetRequestedComMode_GetRequestedComMode_UR_ComMUser_Channel_Vlan1: RteEventRef=OpEventGetRequestedComMode_GetRequestedComMode_UR_ComMUser_Channel_Vlan1
    4 x RteBswModuleInstance:
      Uart: RteBswImplementationRef=Uart_Impl, RteBswModuleConfigurationRef=Uart
        Uart_MainFunction_ReadTimingEvent0 (RteBswEventToTaskMapping):
          RteBswImmediateRestart = false
          RteBswPositionInTask = 32
          RteBswEventRef = Uart_MainFunction_ReadTimingEvent0
          RteBswMappedToTaskRef = OsTask_Bsw_5ms_Core0
          RteBswUsedOsEventRef = Rte_Ev_Cyclic2_OsTask_Bsw_5ms_Core0_0_5ms
          RteBswUsedOsAlarmRef = Rte_Al_TE2_OsTask_Bsw_5ms_Core0_0_5ms
        Uart_MainFunction_WriteTimingEvent0 (RteBswEventToTaskMapping):
          RteBswImmediateRestart = false
          RteBswPositionInTask = 31
          RteBswEventRef = Uart_MainFunction_WriteTimingEvent0
          RteBswMappedToTaskRef = OsTask_Bsw_5ms_Core0
          RteBswUsedOsEventRef = Rte_Ev_Cyclic2_OsTask_Bsw_5ms_Core0_0_5ms
          RteBswUsedOsAlarmRef = Rte_Al_TE2_OsTask_Bsw_5ms_Core0_0_5ms
      UdpNm: RteBswImplementationRef=UdpNm_Impl, RteBswModuleConfigurationRef=UdpNm
        UdpNm_MainFunction_0TimingEvent0 (RteBswEventToTaskMapping):
          RteBswImmediateRestart = false
          RteBswPositionInTask = 6
          RteBswEventRef = UdpNm_MainFunction_0TimingEvent0
          RteBswMappedToTaskRef = OsTask_Bsw_5ms_Core0
          RteBswUsedOsAlarmRef = Rte_Al_TE2_OsTask_Bsw_5ms_Core0_0_5ms
          RteBswUsedOsEventRef = Rte_Ev_Cyclic2_OsTask_Bsw_5ms_Core0_0_5ms
        7 x RteBswExclusiveAreaImpl, all with RteExclusiveAreaImplMechanism=ALL_INTERRUPT_BLOCKING:
          UDPNM_EXCLUSIVE_AREA_{0..6}: RteBswExclusiveAreaRef=UDPNM_EXCLUSIVE_AREA_{0..6}
      Nm: RteBswImplementationRef=Nm_Impl, RteBswModuleConfigurationRef=Nm
        NM_EXCLUSIVE_AREA_0 (RteBswExclusiveAreaImpl): RteExclusiveAreaImplMechanism=ALL_INTERRUPT_BLOCKING, RteBswExclusiveAreaRef=NM_EXCLUSIVE_AREA_0
        NM_EXCLUSIVE_AREA_1 (RteBswExclusiveAreaImpl): RteExclusiveAreaImplMechanism=ALL_INTERRUPT_BLOCKING, RteBswExclusiveAreaRef=NM_EXCLUSIVE_AREA_1
      Com: RteBswImplementationRef=Com_Impl, RteBswModuleConfigurationRef=Com
        Com_MainFunctionTxTimingEvent0 (RteBswEventToTaskMapping):
          RteBswImmediateRestart = false
          RteBswPositionInTask = 3
          RteBswEventRef = Com_MainFunctionTxTimingEvent0
          RteBswMappedToTaskRef = OsTask_Bsw_1ms_Core0
          RteBswUsedOsAlarmRef = Rte_Al_TE2_OsTask_Bsw_1ms_Core0_0_1ms
        Com_MainFunctionRxTimingEvent0 (RteBswEventToTaskMapping):
          RteBswImmediateRestart = false
          RteBswPositionInTask = 2
          RteBswEventRef = Com_MainFunctionRxTimingEvent0
          RteBswMappedToTaskRef = OsTask_Bsw_1ms_Core0
          RteBswUsedOsAlarmRef = Rte_Al_TE2_OsTask_Bsw_1ms_Core0_0_1ms
        3 x RteBswExclusiveAreaImpl, all with RteExclusiveAreaImplMechanism=ALL_INTERRUPT_BLOCKING:
          COM_EXCLUSIVE_AREA_TX: RteBswExclusiveAreaRef=COM_EXCLUSIVE_AREA_TX
          COM_EXCLUSIVE_AREA_RX: RteBswExclusiveAreaRef=COM_EXCLUSIVE_AREA_RX
          COM_EXCLUSIVE_AREA_BOTH: RteBswExclusiveAreaRef=COM_EXCLUSIVE_AREA_BOTH
    StbM_EcuSwComposition (RteSwComponentInstance): RteSoftwareComponentInstanceRef=StbM
      5 x RteEventToTaskMapping, all with RteImmediateRestart=false:
        Timer_StbM_MainFunction: RtePositionInTask=29, RteEventRef=Timer_StbM_MainFunction, RteMappedToTaskRef=OsTask_Bsw_5ms_Core0, RteUsedOsAlarmRef=Rte_Al_TE2_OsTask_Bsw_5ms_Core0_0_5ms, RteUsedOsEventRef=Rte_Ev_Cyclic2_OsTask_Bsw_5ms_Core0_0_5ms
        OpEventGetCurrentTime_GetCurrentTime_GlobalTime_Slave_StbMSynchronizedTimeBase: RteEventRef=OpEventGetCurrentTime_GetCurrentTime_GlobalTime_Slave_StbMSynchronizedTimeBase
        OpEventGetRateDeviation_GetRateDeviation_GlobalTime_Slave_StbMSynchronizedTimeBase: RteEventRef=OpEventGetRateDeviation_GetRateDeviation_GlobalTime_Slave_StbMSynchronizedTimeBase
        OpEventGetTimeLeap_GetTimeLeap_GlobalTime_Slave_StbMSynchronizedTimeBase: RteEventRef=OpEventGetTimeLeap_GetTimeLeap_GlobalTime_Slave_StbMSynchronizedTimeBase
        OpEventGetTimeBaseStatus_GetTimeBaseStatus_GlobalTime_Slave_StbMSynchronizedTimeBase: RteEventRef=OpEventGetTimeBaseStatus_GetTimeBaseStatus_GlobalTime_Slave_StbMSynchronizedTimeBase
    12 x RteBswModuleInstance:
      PduR: RteBswImplementationRef=PduR_Impl, RteBswModuleConfigurationRef=PduR
        PDUR_EXCLUSIVE_AREA_0 (RteBswExclusiveAreaImpl): RteExclusiveAreaImplMechanism=ALL_INTERRUPT_BLOCKING, RteBswExclusiveAreaRef=PDUR_EXCLUSIVE_AREA_0
      EthIf: RteBswImplementationRef=EthIf_Impl, RteBswModuleConfigurationRef=EthIf
        3 x RteBswEventToTaskMapping, all with RteBswImmediateRestart=false, RteBswMappedToTaskRef=OsTask_Bsw_5ms_Core0:
          EthIf_MainFunctionRxTimingEvent0: RteBswPositionInTask=4, RteBswEventRef=EthIf_MainFunctionRxTimingEvent0, RteBswUsedOsAlarmRef=Rte_Al_TE2_OsTask_Bsw_5ms_Core0_0_5ms, RteBswUsedOsEventRef=Rte_Ev_Cyclic2_OsTask_Bsw_5ms_Core0_0_5ms
          EthIf_MainFunctionTxTimingEvent0: RteBswPositionInTask=28, RteBswEventRef=EthIf_MainFunctionTxTimingEvent0, RteBswUsedOsAlarmRef=Rte_Al_TE2_OsTask_Bsw_5ms_Core0_0_5ms, RteBswUsedOsEventRef=Rte_Ev_Cyclic2_OsTask_Bsw_5ms_Core0_0_5ms
          EthIf_MainFunctionStateTimingEvent0: RteBswPositionInTask=5, RteBswEventRef=EthIf_MainFunctionStateTimingEvent0, RteBswUsedOsEventRef=Rte_Ev_Run_EthIf_EthIf_MainFunctionState, RteBswUsedOsAlarmRef=Rte_Al_TE_EthIf_EthIf_MainFunctionState
        5 x RteBswExclusiveAreaImpl, all with RteExclusiveAreaImplMechanism=ALL_INTERRUPT_BLOCKING:
          ETHIF_EXCLUSIVE_AREA_CTRL_INIT: RteBswExclusiveAreaRef=ETHIF_EXCLUSIVE_AREA_CTRL_INIT
          ETHIF_EXCLUSIVE_AREA_SET_CTRL_MODE: RteBswExclusiveAreaRef=ETHIF_EXCLUSIVE_AREA_SET_CTRL_MODE
          ETHIF_EXCLUSIVE_AREA_TX_MIRROR_ELEMENT: RteBswExclusiveAreaRef=ETHIF_EXCLUSIVE_AREA_TX_MIRROR_ELEMENT
          ETHIF_EXCLUSIVE_AREA_RXTX_STATS: RteBswExclusiveAreaRef=ETHIF_EXCLUSIVE_AREA_RXTX_STATS
          ETHIF_EXCLUSIVE_AREA_SIGNAL_QUALITY: RteBswExclusiveAreaRef=ETHIF_EXCLUSIVE_AREA_SIGNAL_QUALITY
      EthSM: RteBswImplementationRef=EthSM_Impl, RteBswModuleConfigurationRef=EthSM
        EthSM_MainFunctionTimingEvent0 (RteBswEventToTaskMapping):
          RteBswImmediateRestart = false
          RteBswPositionInTask = 16
          RteBswEventRef = EthSM_MainFunctionTimingEvent0
          RteBswMappedToTaskRef = OsTask_Bsw_5ms_Core0
          RteBswUsedOsAlarmRef = Rte_Al_TE2_OsTask_Bsw_5ms_Core0_0_5ms
          RteBswUsedOsEventRef = Rte_Ev_Cyclic2_OsTask_Bsw_5ms_Core0_0_5ms
      EthTrcv: RteBswImplementationRef=EthTrcv_Impl, RteBswModuleConfigurationRef=EthTrcv
        EthTrcv_30_Tja1100_MainFunctionTimingEvent0 (RteBswEventToTaskMapping):
          RteBswImmediateRestart = false
          RteBswPositionInTask = 0
          RteBswEventRef = EthTrcv_30_Tja1100_MainFunctionTimingEvent0
          RteBswMappedToTaskRef = OsTask_Bsw_5ms_Core0
          RteBswUsedOsEventRef = Rte_Ev_Run_EthTrcv_30_Tja1100_EthTrcv_30_Tja1100_MainFunction
          RteBswUsedOsAlarmRef = Rte_Al_TE_EthTrcv_30_Tja1100_EthTrcv_30_Tja1100_MainFunction
        EthTrcv_30_Tja1100_MainFunctionLinkHandlingTimingEvent0 (RteBswEventToTaskMapping):
          RteBswImmediateRestart = false
          RteBswPositionInTask = 2
          RteBswEventRef = EthTrcv_30_Tja1100_MainFunctionLinkHandlingTimingEvent0
          RteBswMappedToTaskRef = OsTask_Bsw_5ms_Core0
          RteBswUsedOsAlarmRef = Rte_Al_TE2_OsTask_Bsw_5ms_Core0_0_5ms
          RteBswUsedOsEventRef = Rte_Ev_Cyclic2_OsTask_Bsw_5ms_Core0_0_5ms
        ETHTRCV_30_TJA1100_EXCLUSIVE_AREA_SEQUENCE (RteBswExclusiveAreaImpl): RteExclusiveAreaImplMechanism=ALL_INTERRUPT_BLOCKING, RteBswExclusiveAreaRef=ETHTRCV_30_TJA1100_EXCLUSIVE_AREA_SEQUENCE
      SoAd: RteBswImplementationRef=SoAd_Impl, RteBswModuleConfigurationRef=SoAd
        SoAd_MainFunctionTimingEvent0 (RteBswEventToTaskMapping):
          RteBswImmediateRestart = false
          RteBswPositionInTask = 23
          RteBswEventRef = SoAd_MainFunctionTimingEvent0
          RteBswMappedToTaskRef = OsTask_Bsw_5ms_Core0
          RteBswUsedOsAlarmRef = Rte_Al_TE2_OsTask_Bsw_5ms_Core0_0_5ms
          RteBswUsedOsEventRef = Rte_Ev_Cyclic2_OsTask_Bsw_5ms_Core0_0_5ms
        SOAD_EXCLUSIVE_AREA_0 (RteBswExclusiveAreaImpl): RteExclusiveAreaImplMechanism=ALL_INTERRUPT_BLOCKING, RteBswExclusiveAreaRef=SOAD_EXCLUSIVE_AREA_0
        SOAD_EXCLUSIVE_AREA_1 (RteBswExclusiveAreaImpl): RteExclusiveAreaImplMechanism=ALL_INTERRUPT_BLOCKING, RteBswExclusiveAreaRef=SOAD_EXCLUSIVE_AREA_1
      TcpIp: RteBswImplementationRef=TcpIp_Impl, RteBswModuleConfigurationRef=TcpIp
        TcpIp_MainFunctionTimingEvent0 (RteBswEventToTaskMapping):
          RteBswImmediateRestart = false
          RteBswPositionInTask = 25
          RteBswEventRef = TcpIp_MainFunctionTimingEvent0
          RteBswMappedToTaskRef = OsTask_Bsw_5ms_Core0
          RteBswUsedOsAlarmRef = Rte_Al_TE2_OsTask_Bsw_5ms_Core0_0_5ms
          RteBswUsedOsEventRef = Rte_Ev_Cyclic2_OsTask_Bsw_5ms_Core0_0_5ms
        TCPIP_EXCLUSIVE_AREA_0 (RteBswExclusiveAreaImpl): RteExclusiveAreaImplMechanism=ALL_INTERRUPT_BLOCKING, RteBswExclusiveAreaRef=TCPIP_EXCLUSIVE_AREA_0
      Crc: RteBswImplementationRef=Crc_Impl, RteBswModuleConfigurationRef=Crc
        CriticalSection (RteBswExclusiveAreaImpl): RteExclusiveAreaImplMechanism=ALL_INTERRUPT_BLOCKING, RteBswExclusiveAreaRef=CriticalSection
      Mcu: RteBswImplementationRef=Mcu_Impl, RteBswModuleConfigurationRef=Mcu
        TomTgcReg (RteBswExclusiveAreaImpl): RteExclusiveAreaImplMechanism=ALL_INTERRUPT_BLOCKING, RteBswExclusiveAreaRef=TomTgcReg
        AtomAgcReg (RteBswExclusiveAreaImpl): RteExclusiveAreaImplMechanism=ALL_INTERRUPT_BLOCKING, RteBswExclusiveAreaRef=AtomAgcReg
      Sd: RteBswImplementationRef=Sd_Impl, RteBswModuleConfigurationRef=Sd
        Sd_MainFunctionTimingEvent0 (RteBswEventToTaskMapping):
          RteBswImmediateRestart = false
          RteBswPositionInTask = 22
          RteBswEventRef = Sd_MainFunctionTimingEvent0
          RteBswMappedToTaskRef = OsTask_Bsw_5ms_Core0
          RteBswUsedOsEventRef = Rte_Ev_Cyclic2_OsTask_Bsw_5ms_Core0_0_5ms
          RteBswUsedOsAlarmRef = Rte_Al_TE2_OsTask_Bsw_5ms_Core0_0_5ms
        SD_EXCLUSIVE_AREA_0 (RteBswExclusiveAreaImpl): RteExclusiveAreaImplMechanism=ALL_INTERRUPT_BLOCKING, RteBswExclusiveAreaRef=SD_EXCLUSIVE_AREA_0
      LdCom: RteBswImplementationRef=LdCom_Impl, RteBswModuleConfigurationRef=LdCom
      DoIP: RteBswImplementationRef=DoIP_Impl, RteBswModuleConfigurationRef=DoIP
        DoIP_MainFunctionTimingEvent0 (RteBswEventToTaskMapping):
          RteBswImmediateRestart = false
          RteBswPositionInTask = 26
          RteBswEventRef = DoIP_MainFunctionTimingEvent0
          RteBswMappedToTaskRef = OsTask_Bsw_5ms_Core0
          RteBswUsedOsEventRef = Rte_Ev_Cyclic2_OsTask_Bsw_5ms_Core0_0_5ms
          RteBswUsedOsAlarmRef = Rte_Al_TE2_OsTask_Bsw_5ms_Core0_0_5ms
        DOIP_EXCLUSIVE_AREA_0 (RteBswExclusiveAreaImpl): RteExclusiveAreaImplMechanism=ALL_INTERRUPT_BLOCKING, RteBswExclusiveAreaRef=DOIP_EXCLUSIVE_AREA_0
      Dcm: RteBswImplementationRef=Dcm_Impl, RteBswModuleConfigurationRef=Dcm
        Dcm_MainFunctionTimingEvent0 (RteBswEventToTaskMapping):
          RteBswImmediateRestart = false
          RteBswPositionInTask = 18
          RteBswEventRef = Dcm_MainFunctionTimingEvent0
          RteBswMappedToTaskRef = OsTask_Bsw_5ms_Core0
          RteBswUsedOsEventRef = Rte_Ev_Cyclic2_OsTask_Bsw_5ms_Core0_0_5ms
          RteBswUsedOsAlarmRef = Rte_Al_TE2_OsTask_Bsw_5ms_Core0_0_5ms
        DCM_EXCLUSIVE_AREA_0 (RteBswExclusiveAreaImpl): RteExclusiveAreaImplMechanism=ALL_INTERRUPT_BLOCKING, RteBswExclusiveAreaRef=DCM_EXCLUSIVE_AREA_0
    Dcm_EcuSwComposition (RteSwComponentInstance): RteSoftwareComponentInstanceRef=Dcm
      7 x RteEventToTaskMapping, all with RteImmediateRestart=false:
        Timer_Dcm_MainFunction: RtePositionInTask=18, RteEventRef=Timer_Dcm_MainFunction, RteMappedToTaskRef=OsTask_Bsw_5ms_Core0, RteUsedOsEventRef=Rte_Ev_Cyclic2_OsTask_Bsw_5ms_Core0_0_5ms, RteUsedOsAlarmRef=Rte_Al_TE2_OsTask_Bsw_5ms_Core0_0_5ms
        OpEventGetActiveProtocol_GetActiveProtocol_DCMServices: RteEventRef=OpEventGetActiveProtocol_GetActiveProtocol_DCMServices
        OpEventGetSesCtrlType_GetSesCtrlType_DCMServices: RteEventRef=OpEventGetSesCtrlType_GetSesCtrlType_DCMServices
        OpEventResetToDefaultSession_ResetToDefaultSession_DCMServices: RteEventRef=OpEventResetToDefaultSession_ResetToDefaultSession_DCMServices
        OpEventSetActiveDiagnostic_SetActiveDiagnostic_DCMServices: RteEventRef=OpEventSetActiveDiagnostic_SetActiveDiagnostic_DCMServices
        OpEventGetRequestKind_GetRequestKind_DCMServices: RteEventRef=OpEventGetRequestKind_GetRequestKind_DCMServices
        OpEventGetSecurityLevel_GetSecurityLevel_DCMServices: RteEventRef=OpEventGetSecurityLevel_GetSecurityLevel_DCMServices
    3 x RteBswModuleInstance:
      Fee: RteBswImplementationRef=Fee_Impl, RteBswModuleConfigurationRef=Fee
        Fee_MainFunctionTimingEvent0 (RteBswEventToTaskMapping):
          RteBswImmediateRestart = false
          RteBswPositionInTask = 35
          RteBswEventRef = Fee_MainFunctionTimingEvent0
          RteBswMappedToTaskRef = OsTask_Bsw_5ms_Core0
          RteBswUsedOsEventRef = Rte_Ev_Cyclic2_OsTask_Bsw_5ms_Core0_0_10ms
          RteBswUsedOsAlarmRef = Rte_Al_TE2_OsTask_Bsw_5ms_Core0_0_10ms
      Fls: RteBswImplementationRef=Fls_Impl, RteBswModuleConfigurationRef=Fls
        Fls_17_Dmu_MainFunctionTimingEvent0 (RteBswEventToTaskMapping):
          RteBswImmediateRestart = false
          RteBswPositionInTask = 37
          RteBswEventRef = Fls_17_Dmu_MainFunctionTimingEvent0
          RteBswMappedToTaskRef = OsTask_Bsw_5ms_Core0
          RteBswUsedOsEventRef = Rte_Ev_Cyclic2_OsTask_Bsw_5ms_Core0_0_5ms
          RteBswUsedOsAlarmRef = Rte_Al_TE2_OsTask_Bsw_5ms_Core0_0_5ms
        6 x RteBswExclusiveAreaImpl, all with RteExclusiveAreaImplMechanism=ALL_INTERRUPT_BLOCKING:
          Init: RteBswExclusiveAreaRef=Init
          Erase: RteBswExclusiveAreaRef=Erase
          Write: RteBswExclusiveAreaRef=Write
          Main: RteBswExclusiveAreaRef=Main
          ResumeErase: RteBswExclusiveAreaRef=ResumeErase
          UserContentCount: RteBswExclusiveAreaRef=UserContentCount
      NvM: RteBswImplementationRef=NvM_Impl, RteBswModuleConfigurationRef=NvM
        NvM_MainFunctionTimingEvent0 (RteBswEventToTaskMapping):
          RteBswImmediateRestart = false
          RteBswPositionInTask = 34
          RteBswEventRef = NvM_MainFunctionTimingEvent0
          RteBswMappedToTaskRef = OsTask_Bsw_5ms_Core0
          RteBswUsedOsEventRef = Rte_Ev_Cyclic2_OsTask_Bsw_5ms_Core0_0_10ms
          RteBswUsedOsAlarmRef = Rte_Al_TE2_OsTask_Bsw_5ms_Core0_0_10ms
        NVM_EXCLUSIVE_AREA_0 (RteBswExclusiveAreaImpl): RteExclusiveAreaImplMechanism=ALL_INTERRUPT_BLOCKING, RteBswExclusiveAreaRef=NVM_EXCLUSIVE_AREA_0
    NvM_EcuSwComposition (RteSwComponentInstance): RteSoftwareComponentInstanceRef=NvM
      Timer_NvM_MainFunction (RteEventToTaskMapping):
        RteImmediateRestart = false
        RtePositionInTask = 34
        RteEventRef = Timer_NvM_MainFunction
        RteMappedToTaskRef = OsTask_Bsw_5ms_Core0
        RteUsedOsEventRef = Rte_Ev_Cyclic2_OsTask_Bsw_5ms_Core0_0_10ms
        RteUsedOsAlarmRef = Rte_Al_TE2_OsTask_Bsw_5ms_Core0_0_10ms
    Cdd_log_EcuSwComposition (RteSwComponentInstance): RteSoftwareComponentInstanceRef=Cdd_log
      Runnable_InitEvent (RteEventToTaskMapping): RteImmediateRestart=false, RtePositionInTask=4, RteEventRef=Runnable_InitEvent, RteMappedToTaskRef=OsTask_Init_OsCore0
      TMT_Cdd_Log_Runnable5ms (RteEventToTaskMapping):
        RteImmediateRestart = false
        RtePositionInTask = 2
        RteEventRef = TMT_Cdd_Log_Runnable5ms
        RteMappedToTaskRef = OsTask_Asw_OsCore0
        RteUsedOsEventRef = Rte_Ev_Cyclic_OsTask_Asw_OsCore0_0_5ms
        RteUsedOsAlarmRef = Rte_Al_TE_OsTask_Asw_OsCore0_0_5ms
    Cdd_Log (RteSwComponentType): RteComponentTypeRef=Cdd_Log, RteImplementationRef=Cdd_Log_Implementation
      ComponentTypeCalibration (RteComponentTypeCalibration): RteCalibrationSupportEnabled=false
    Dem (RteBswModuleInstance): RteBswImplementationRef=Dem_Impl, RteBswModuleConfigurationRef=Dem
      Dem_MasterMainFunctionTimingEvent0 (RteBswEventToTaskMapping):
        RteBswImmediateRestart = false
        RteBswPositionInTask = 20
        RteBswEventRef = Dem_MasterMainFunctionTimingEvent0
        RteBswMappedToTaskRef = OsTask_Bsw_5ms_Core0
        RteBswUsedOsEventRef = Rte_Ev_Cyclic2_OsTask_Bsw_5ms_Core0_0_10ms
        RteBswUsedOsAlarmRef = Rte_Al_TE2_OsTask_Bsw_5ms_Core0_0_10ms
      Dem_SatelliteMainFunctionTimingEvent0 (RteBswEventToTaskMapping):
        RteBswImmediateRestart = false
        RteBswPositionInTask = 19
        RteBswEventRef = Dem_SatelliteMainFunctionTimingEvent0
        RteBswMappedToTaskRef = OsTask_Bsw_5ms_Core0
        RteBswUsedOsEventRef = Rte_Ev_Cyclic2_OsTask_Bsw_5ms_Core0_0_10ms
        RteBswUsedOsAlarmRef = Rte_Al_TE2_OsTask_Bsw_5ms_Core0_0_10ms
      5 x RteBswExclusiveAreaImpl, all with RteExclusiveAreaImplMechanism=ALL_INTERRUPT_BLOCKING:
        DEM_EXCLUSIVE_AREA_{0..4}: RteBswExclusiveAreaRef=DEM_EXCLUSIVE_AREA_{0..4}
    3 x RteSwComponentInstance:
      DemMaster_0_EcuSwComposition: RteSoftwareComponentInstanceRef=DemMaster_0
        31 x RteEventToTaskMapping, all with RteImmediateRestart=false:
          Timer_Dem_MasterMainFunction: RtePositionInTask=20, RteEventRef=Timer_Dem_MasterMainFunction, RteMappedToTaskRef=OsTask_Bsw_5ms_Core0, RteUsedOsEventRef=Rte_Ev_Cyclic2_OsTask_Bsw_5ms_Core0_0_10ms, RteUsedOsAlarmRef=Rte_Al_TE2_OsTask_Bsw_5ms_Core0_0_10ms
          OpEventPostRunRequested_GetPostRunRequested_DemServices: RteEventRef=OpEventPostRunRequested_GetPostRunRequested_DemServices
          OpEventGetDTCStatusAvailabilityMask_GetDTCStatusAvailabilityMask_DemServices: RteEventRef=OpEventGetDTCStatusAvailabilityMask_GetDTCStatusAvailabilityMask_DemServices
          OpEventGetEventUdsStatus_GetEventUdsStatus_GeneralEvtInfo: RteEventRef=OpEventGetEventUdsStatus_GetEventUdsStatus_GeneralEvtInfo
          OpEventGetEventStatus_GetEventStatus_GeneralEvtInfo: RteEventRef=OpEventGetEventStatus_GetEventStatus_GeneralEvtInfo
          OpEventGetEventFailed_GetEventFailed_GeneralEvtInfo: RteEventRef=OpEventGetEventFailed_GetEventFailed_GeneralEvtInfo
          OpEventGetEventTested_GetEventTested_GeneralEvtInfo: RteEventRef=OpEventGetEventTested_GetEventTested_GeneralEvtInfo
          OpEventGetDTCOfEvent_GetDTCOfEvent_GeneralEvtInfo: RteEventRef=OpEventGetDTCOfEvent_GetDTCOfEvent_GeneralEvtInfo
          OpEventGetFaultDetectionCounter_GetFaultDetectionCounter_GeneralEvtInfo: RteEventRef=OpEventGetFaultDetectionCounter_GetFaultDetectionCounter_GeneralEvtInfo
          OpEventGetEventFreezeFrameDataEx_GetEventFreezeFrameDataEx_GeneralEvtInfo: RteEventRef=OpEventGetEventFreezeFrameDataEx_GetEventFreezeFrameDataEx_GeneralEvtInfo
          OpEventGetEventExtendedDataRecordEx_GetEventExtendedDataRecordEx_GeneralEvtInfo: RteEventRef=OpEventGetEventExtendedDataRecordEx_GetEventExtendedDataRecordEx_GeneralEvtInfo
          OpEventGetEventEnableCondition_GetEventEnableCondition_GeneralEvtInfo: RteEventRef=OpEventGetEventEnableCondition_GetEventEnableCondition_GeneralEvtInfo
          OpEventGetDebouncingOfEvent_GetDebouncingOfEvent_GeneralEvtInfo: RteEventRef=OpEventGetDebouncingOfEvent_GetDebouncingOfEvent_GeneralEvtInfo
          OpEventGetMonitorStatus_GetMonitorStatus_GeneralEvtInfo: RteEventRef=OpEventGetMonitorStatus_GetMonitorStatus_GeneralEvtInfo
          OpEventGetOperationCycleState_GetOperationCycleState_OpCycle_PowerCycle: RteEventRef=OpEventGetOperationCycleState_GetOperationCycleState_OpCycle_PowerCycle
          OpEventSetOperationCycleState_SetOperationCycleState_OpCycle_PowerCycle: RteEventRef=OpEventSetOperationCycleState_SetOperationCycleState_OpCycle_PowerCycle
          OpEventClearDTC_ClearDTC_ClearDTC_DemClient: RteEventRef=OpEventClearDTC_ClearDTC_ClearDTC_DemClient
          OpEventSelectDTC_SelectDTC_ClearDTC_DemClient: RteEventRef=OpEventSelectDTC_SelectDTC_ClearDTC_DemClient
          OpEventGetEventMemoryOverflow_GetEventMemoryOverflow_OverflowIndPrimaryMemory_DemClient: RteEventRef=OpEventGetEventMemoryOverflow_GetEventMemoryOverflow_OverflowIndPrimaryMemory_DemClient
          OpEventGetNumberOfEventMemoryEntries_GetNumberOfEventMemoryEntries_OverflowIndPrimaryMemory_DemClient: RteEventRef=OpEventGetNumberOfEventMemoryEntries_GetNumberOfEventMemoryEntries_OverflowIndPrimaryMemory_DemClient
          OpEventGetOperationCycleState_GetOperationCycleState_OpCycle_POWER_MODE: RteEventRef=OpEventGetOperationCycleState_GetOperationCycleState_OpCycle_POWER_MODE
          OpEventSetOperationCycleState_SetOperationCycleState_OpCycle_POWER_MODE: RteEventRef=OpEventSetOperationCycleState_SetOperationCycleState_OpCycle_POWER_MODE
          OpEventSetEnableCondition_SetEnableCondition_EnableCond_SC1_Control_DTC_Setting: RteEventRef=OpEventSetEnableCondition_SetEnableCondition_EnableCond_SC1_Control_DTC_Setting
          OpEventSetEnableCondition_SetEnableCondition_EnableCond_SC3_Local_Voltage: RteEventRef=OpEventSetEnableCondition_SetEnableCondition_EnableCond_SC3_Local_Voltage
          OpEventSetEnableCondition_SetEnableCondition_EnableCond_SC4_System_Voltage: RteEventRef=OpEventSetEnableCondition_SetEnableCondition_EnableCond_SC4_System_Voltage
          OpEventSetEnableCondition_SetEnableCondition_EnableCond_Sc5_Transportation_Mode: RteEventRef=OpEventSetEnableCondition_SetEnableCondition_EnableCond_Sc5_Transportation_Mode
          OpEventSetEnableCondition_SetEnableCondition_EnableCond_SC8_Communication_Status: RteEventRef=OpEventSetEnableCondition_SetEnableCondition_EnableCond_SC8_Communication_Status
          OpEventSetEnableCondition_SetEnableCondition_EnableCond_SC10_Debounce_Timer: RteEventRef=OpEventSetEnableCondition_SetEnableCondition_EnableCond_SC10_Debounce_Timer
          OpEventSetEnableCondition_SetEnableCondition_EnableCond_SC11_Debounce_Timer_Com: RteEventRef=OpEventSetEnableCondition_SetEnableCondition_EnableCond_SC11_Debounce_Timer_Com
          OpEventSetEnableCondition_SetEnableCondition_EnableCond_SC12_Production_Mode: RteEventRef=OpEventSetEnableCondition_SetEnableCondition_EnableCond_SC12_Production_Mode
          OpEventSetEnableCondition_SetEnableCondition_EnableCond_SC14_Battery_CutOff_Switch: RteEventRef=OpEventSetEnableCondition_SetEnableCondition_EnableCond_SC14_Battery_CutOff_Switch
      DemSatellite_0_EcuSwComposition: RteSoftwareComponentInstanceRef=DemSatellite_0
        56 x RteEventToTaskMapping, all with RteImmediateRestart=false:
          Timer_Dem_SatelliteMainFunction: RtePositionInTask=19, RteEventRef=Timer_Dem_SatelliteMainFunction, RteMappedToTaskRef=OsTask_Bsw_5ms_Core0, RteUsedOsEventRef=Rte_Ev_Cyclic2_OsTask_Bsw_5ms_Core0_0_10ms, RteUsedOsAlarmRef=Rte_Al_TE2_OsTask_Bsw_5ms_Core0_0_10ms
          OpEventGetEventUdsStatus_GetEventUdsStatus_EvtInfo_EVTID_WDG_FAULT: RteEventRef=OpEventGetEventUdsStatus_GetEventUdsStatus_EvtInfo_EVTID_WDG_FAULT
          OpEventGetEventUdsStatus_GetEventUdsStatus_Event_EVTID_WDG_FAULT: RteEventRef=OpEventGetEventUdsStatus_GetEventUdsStatus_Event_EVTID_WDG_FAULT
          OpEventGetEventUdsStatus_GetEventUdsStatus_GeneralEvtInfo: RteEventRef=OpEventGetEventUdsStatus_GetEventUdsStatus_GeneralEvtInfo
          OpEventGetEventStatus_GetEventStatus_EvtInfo_EVTID_WDG_FAULT: RteEventRef=OpEventGetEventStatus_GetEventStatus_EvtInfo_EVTID_WDG_FAULT
          OpEventGetEventStatus_GetEventStatus_Event_EVTID_WDG_FAULT: RteEventRef=OpEventGetEventStatus_GetEventStatus_Event_EVTID_WDG_FAULT
          OpEventGetEventStatus_GetEventStatus_GeneralEvtInfo: RteEventRef=OpEventGetEventStatus_GetEventStatus_GeneralEvtInfo
          OpEventGetEventFailed_GetEventFailed_EvtInfo_EVTID_WDG_FAULT: RteEventRef=OpEventGetEventFailed_GetEventFailed_EvtInfo_EVTID_WDG_FAULT
          OpEventGetEventFailed_GetEventFailed_Event_EVTID_WDG_FAULT: RteEventRef=OpEventGetEventFailed_GetEventFailed_Event_EVTID_WDG_FAULT
          OpEventGetEventFailed_GetEventFailed_GeneralEvtInfo: RteEventRef=OpEventGetEventFailed_GetEventFailed_GeneralEvtInfo
          OpEventGetEventTested_GetEventTested_EvtInfo_EVTID_WDG_FAULT: RteEventRef=OpEventGetEventTested_GetEventTested_EvtInfo_EVTID_WDG_FAULT
          OpEventGetEventTested_GetEventTested_Event_EVTID_WDG_FAULT: RteEventRef=OpEventGetEventTested_GetEventTested_Event_EVTID_WDG_FAULT
          OpEventGetEventTested_GetEventTested_GeneralEvtInfo: RteEventRef=OpEventGetEventTested_GetEventTested_GeneralEvtInfo
          OpEventGetDTCOfEvent_GetDTCOfEvent_EvtInfo_EVTID_WDG_FAULT: RteEventRef=OpEventGetDTCOfEvent_GetDTCOfEvent_EvtInfo_EVTID_WDG_FAULT
          OpEventGetDTCOfEvent_GetDTCOfEvent_Event_EVTID_WDG_FAULT: RteEventRef=OpEventGetDTCOfEvent_GetDTCOfEvent_Event_EVTID_WDG_FAULT
          OpEventGetDTCOfEvent_GetDTCOfEvent_GeneralEvtInfo: RteEventRef=OpEventGetDTCOfEvent_GetDTCOfEvent_GeneralEvtInfo
          OpEventGetFaultDetectionCounter_GetFaultDetectionCounter_EvtInfo_EVTID_WDG_FAULT: RteEventRef=OpEventGetFaultDetectionCounter_GetFaultDetectionCounter_EvtInfo_EVTID_WDG_FAULT
          OpEventGetFaultDetectionCounter_GetFaultDetectionCounter_Event_EVTID_WDG_FAULT: RteEventRef=OpEventGetFaultDetectionCounter_GetFaultDetectionCounter_Event_EVTID_WDG_FAULT
          OpEventGetFaultDetectionCounter_GetFaultDetectionCounter_GeneralEvtInfo: RteEventRef=OpEventGetFaultDetectionCounter_GetFaultDetectionCounter_GeneralEvtInfo
          OpEventGetEventFreezeFrameDataEx_GetEventFreezeFrameDataEx_EvtInfo_EVTID_WDG_FAULT: RteEventRef=OpEventGetEventFreezeFrameDataEx_GetEventFreezeFrameDataEx_EvtInfo_EVTID_WDG_FAULT
          OpEventGetEventFreezeFrameDataEx_GetEventFreezeFrameDataEx_Event_EVTID_WDG_FAULT: RteEventRef=OpEventGetEventFreezeFrameDataEx_GetEventFreezeFrameDataEx_Event_EVTID_WDG_FAULT
          OpEventGetEventFreezeFrameDataEx_GetEventFreezeFrameDataEx_GeneralEvtInfo: RteEventRef=OpEventGetEventFreezeFrameDataEx_GetEventFreezeFrameDataEx_GeneralEvtInfo
          OpEventGetEventExtendedDataRecordEx_GetEventExtendedDataRecordEx_EvtInfo_EVTID_WDG_FAULT: RteEventRef=OpEventGetEventExtendedDataRecordEx_GetEventExtendedDataRecordEx_EvtInfo_EVTID_WDG_FAULT
          OpEventGetEventExtendedDataRecordEx_GetEventExtendedDataRecordEx_Event_EVTID_WDG_FAULT: RteEventRef=OpEventGetEventExtendedDataRecordEx_GetEventExtendedDataRecordEx_Event_EVTID_WDG_FAULT
          OpEventGetEventExtendedDataRecordEx_GetEventExtendedDataRecordEx_GeneralEvtInfo: RteEventRef=OpEventGetEventExtendedDataRecordEx_GetEventExtendedDataRecordEx_GeneralEvtInfo
          OpEventGetEventEnableCondition_GetEventEnableCondition_EvtInfo_EVTID_WDG_FAULT: RteEventRef=OpEventGetEventEnableCondition_GetEventEnableCondition_EvtInfo_EVTID_WDG_FAULT
          OpEventGetEventEnableCondition_GetEventEnableCondition_GeneralEvtInfo: RteEventRef=OpEventGetEventEnableCondition_GetEventEnableCondition_GeneralEvtInfo
          OpEventGetDebouncingOfEvent_GetDebouncingOfEvent_EvtInfo_EVTID_WDG_FAULT: RteEventRef=OpEventGetDebouncingOfEvent_GetDebouncingOfEvent_EvtInfo_EVTID_WDG_FAULT
          OpEventGetDebouncingOfEvent_GetDebouncingOfEvent_GeneralEvtInfo: RteEventRef=OpEventGetDebouncingOfEvent_GetDebouncingOfEvent_GeneralEvtInfo
          OpEventGetMonitorStatus_GetMonitorStatus_EvtInfo_EVTID_WDG_FAULT: RteEventRef=OpEventGetMonitorStatus_GetMonitorStatus_EvtInfo_EVTID_WDG_FAULT
          OpEventGetMonitorStatus_GetMonitorStatus_GeneralEvtInfo: RteEventRef=OpEventGetMonitorStatus_GetMonitorStatus_GeneralEvtInfo
          OpEventSetEventStatus_SetEventStatus_Event_EVTID_WDG_FAULT: RteEventRef=OpEventSetEventStatus_SetEventStatus_Event_EVTID_WDG_FAULT
          OpEventResetEventStatus_ResetEventStatus_Event_EVTID_WDG_FAULT: RteEventRef=OpEventResetEventStatus_ResetEventStatus_Event_EVTID_WDG_FAULT
          OpEventResetEventDebounceStatus_ResetEventDebounceStatus_Event_EVTID_WDG_FAULT: RteEventRef=OpEventResetEventDebounceStatus_ResetEventDebounceStatus_Event_EVTID_WDG_FAULT
          OpEventGetEventUdsStatus_GetEventUdsStatus_EvtInfo_DTC_0xDDD094_Event: RteEventRef=OpEventGetEventUdsStatus_GetEventUdsStatus_EvtInfo_DTC_0xDDD094_Event
          OpEventGetEventUdsStatus_GetEventUdsStatus_Event_DTC_0xDDD094_Event: RteEventRef=OpEventGetEventUdsStatus_GetEventUdsStatus_Event_DTC_0xDDD094_Event
          OpEventGetEventStatus_GetEventStatus_EvtInfo_DTC_0xDDD094_Event: RteEventRef=OpEventGetEventStatus_GetEventStatus_EvtInfo_DTC_0xDDD094_Event
          OpEventGetEventStatus_GetEventStatus_Event_DTC_0xDDD094_Event: RteEventRef=OpEventGetEventStatus_GetEventStatus_Event_DTC_0xDDD094_Event
          OpEventGetEventFailed_GetEventFailed_EvtInfo_DTC_0xDDD094_Event: RteEventRef=OpEventGetEventFailed_GetEventFailed_EvtInfo_DTC_0xDDD094_Event
          OpEventGetEventFailed_GetEventFailed_Event_DTC_0xDDD094_Event: RteEventRef=OpEventGetEventFailed_GetEventFailed_Event_DTC_0xDDD094_Event
          OpEventGetEventTested_GetEventTested_EvtInfo_DTC_0xDDD094_Event: RteEventRef=OpEventGetEventTested_GetEventTested_EvtInfo_DTC_0xDDD094_Event
          OpEventGetEventTested_GetEventTested_Event_DTC_0xDDD094_Event: RteEventRef=OpEventGetEventTested_GetEventTested_Event_DTC_0xDDD094_Event
          OpEventGetDTCOfEvent_GetDTCOfEvent_EvtInfo_DTC_0xDDD094_Event: RteEventRef=OpEventGetDTCOfEvent_GetDTCOfEvent_EvtInfo_DTC_0xDDD094_Event
          OpEventGetDTCOfEvent_GetDTCOfEvent_Event_DTC_0xDDD094_Event: RteEventRef=OpEventGetDTCOfEvent_GetDTCOfEvent_Event_DTC_0xDDD094_Event
          OpEventGetFaultDetectionCounter_GetFaultDetectionCounter_EvtInfo_DTC_0xDDD094_Event: RteEventRef=OpEventGetFaultDetectionCounter_GetFaultDetectionCounter_EvtInfo_DTC_0xDDD094_Event
          OpEventGetFaultDetectionCounter_GetFaultDetectionCounter_Event_DTC_0xDDD094_Event: RteEventRef=OpEventGetFaultDetectionCounter_GetFaultDetectionCounter_Event_DTC_0xDDD094_Event
          OpEventGetEventFreezeFrameDataEx_GetEventFreezeFrameDataEx_EvtInfo_DTC_0xDDD094_Event: RteEventRef=OpEventGetEventFreezeFrameDataEx_GetEventFreezeFrameDataEx_EvtInfo_DTC_0xDDD094_Event
          OpEventGetEventFreezeFrameDataEx_GetEventFreezeFrameDataEx_Event_DTC_0xDDD094_Event: RteEventRef=OpEventGetEventFreezeFrameDataEx_GetEventFreezeFrameDataEx_Event_DTC_0xDDD094_Event
          OpEventGetEventExtendedDataRecordEx_GetEventExtendedDataRecordEx_EvtInfo_DTC_0xDDD094_Event: RteEventRef=OpEventGetEventExtendedDataRecordEx_GetEventExtendedDataRecordEx_EvtInfo_DTC_0xDDD094_Event
          OpEventGetEventExtendedDataRecordEx_GetEventExtendedDataRecordEx_Event_DTC_0xDDD094_Event: RteEventRef=OpEventGetEventExtendedDataRecordEx_GetEventExtendedDataRecordEx_Event_DTC_0xDDD094_Event
          OpEventGetEventEnableCondition_GetEventEnableCondition_EvtInfo_DTC_0xDDD094_Event: RteEventRef=OpEventGetEventEnableCondition_GetEventEnableCondition_EvtInfo_DTC_0xDDD094_Event
          OpEventGetDebouncingOfEvent_GetDebouncingOfEvent_EvtInfo_DTC_0xDDD094_Event: RteEventRef=OpEventGetDebouncingOfEvent_GetDebouncingOfEvent_EvtInfo_DTC_0xDDD094_Event
          OpEventGetMonitorStatus_GetMonitorStatus_EvtInfo_DTC_0xDDD094_Event: RteEventRef=OpEventGetMonitorStatus_GetMonitorStatus_EvtInfo_DTC_0xDDD094_Event
          OpEventSetEventStatus_SetEventStatus_Event_DTC_0xDDD094_Event: RteEventRef=OpEventSetEventStatus_SetEventStatus_Event_DTC_0xDDD094_Event
          OpEventResetEventStatus_ResetEventStatus_Event_DTC_0xDDD094_Event: RteEventRef=OpEventResetEventStatus_ResetEventStatus_Event_DTC_0xDDD094_Event
          OpEventResetEventDebounceStatus_ResetEventDebounceStatus_Event_DTC_0xDDD094_Event: RteEventRef=OpEventResetEventDebounceStatus_ResetEventDebounceStatus_Event_DTC_0xDDD094_Event
      Cdd_UDS_EcuSwComposition: RteSoftwareComponentInstanceRef=Cdd_UDS
        7 x RteEventToTaskMapping, all with RteImmediateRestart=false:
          OIT_Runnable_CSDataServices_Data_Did_0x16E_MCU_Info_ReadData: RteEventRef=OIT_Runnable_CSDataServices_Data_Did_0x16E_MCU_Info_ReadData
          OIT_Runnable_DID_0x16F_DataServices_Version_Info_ConditionCheckRead: RteEventRef=OIT_Runnable_DID_0x16F_DataServices_Version_Info_ConditionCheckRead
          OIT_Runnable_DID_0x16F_DataServices_Version_Info_ReadData: RteEventRef=OIT_Runnable_DID_0x16F_DataServices_Version_Info_ReadData
          OIT_Runnable_DID_0x16F_DataServices_Version_Info_WriteData: RteEventRef=OIT_Runnable_DID_0x16F_DataServices_Version_Info_WriteData
          OIT_Runnable_RID_0x050_RoutineServices_DcmDspRoutine_Get_Link_Quality_Start_Start: RteEventRef=OIT_Runnable_RID_0x050_RoutineServices_DcmDspRoutine_Get_Link_Quality_Start_Start
          OIT_Runnable_RID_0x050_RoutineServices_DcmDspRoutine_Get_Link_Quality_Start_RequestResults: RteEventRef=OIT_Runnable_RID_0x050_RoutineServices_DcmDspRoutine_Get_Link_Quality_Start_RequestResults
          Cdd_UDS_InitEvent: RtePositionInTask=6, RteEventRef=Cdd_UDS_InitEvent, RteMappedToTaskRef=OsTask_Init_OsCore0
    Cdd_UDS (RteSwComponentType): RteComponentTypeRef=Cdd_UDS, RteImplementationRef=Cdd_UDS_Implementation
      ComponentTypeCalibration (RteComponentTypeCalibration): RteCalibrationSupportEnabled=false
