AUTOSAR XML (schema 00048)
package /ActiveEcuC
  module config Com: implementation-config-variant=VARIANT-PRE-COMPILE, module-description=Com_Impl
    ComConfig: ComConfigurationId=0, ComRxDeferredNotificationCacheSize=1, ComRxImmediateNotificationCacheSize=0
      ComTimeBase: ComRxTimeBase=0.001, ComTxTimeBase=0.001, ComGwTimeBase=0.001
      ComIPduPnc_EIRA_ETH_Rx (ComIPdu):
        ComIPduDirection = RECEIVE
        ComIPduHandleId = 0
        ComIPduSignalProcessing = DEFERRED
        ComIPduType = NORMAL
        ComIPduCancellationSupport = false
        ComPduIdRef = PncEiraEthRxPdu
        ComIPduSignalRef = ComSignalPnc_EIRA_ETH_Rx
        ComIPduGroupRef = ComIPduGroup_Rx_PNC00
        ComIPduGroupRef = ComIPduGroup_Rx_PNC_All_Active
      ComSignalPnc_EIRA_ETH_Rx (ComSignal):
        ComBitPosition = 0
        ComSignalEndianness = opaque
        ComSignalInitValue = 0 0 0 0 0 0 0
        ComSignalType = UINT8_N
        ComSignalAccess = ACCESS_NEEDED_BY_OTHER
        ComHandleId = 0
        ComNotification = ComM_ComCbk_ComSignalPnc_EIRA_ETH_Rx
        ComSignalLength = 7
      4 x ComIPduGroup:
        ComIPduGroup_Tx_PNC00: ComIPduGroupHandleId=2
        ComIPduGroup_Tx_PNC_All_Active: ComIPduGroupHandleId=3
        ComIPduGroup_Rx_PNC00: ComIPduGroupHandleId=1
        ComIPduGroup_Rx_PNC_All_Active: ComIPduGroupHandleId=0
      ComIPduPnc_EIRA_ETH_Tx (ComIPdu):
        ComIPduDirection = SEND
        ComIPduHandleId = 0
        ComIPduSignalProcessing = DEFERRED
        ComIPduType = NORMAL
        ComIPduCancellationSupport = false
        ComPduIdRef = PncEiraEthTxPdu
        ComIPduSignalRef = ComSignalPnc_EIRA_ETH_Tx
        ComIPduGroupRef = ComIPduGroup_Tx_PNC00
        ComIPduGroupRef = ComIPduGroup_Tx_PNC_All_Active
        ComTxIPdu: ComMinimumDelayTime=0, ComTxIPduUnusedAreasDefault=0
          ComTxModeFalse
            ComTxMode: ComTxModeMode=NONE
          ComTxModeTrue
            ComTxMode: ComTxModeMode=NONE
      ComSignalPnc_EIRA_ETH_Tx (ComSignal):
        ComBitPosition = 0
        ComSignalEndianness = opaque
        ComSignalInitValue = 0 0 0 0 0 0 0
        ComSignalType = UINT8_N
        ComSignalAccess = ACCESS_NEEDED_BY_OTHER
        ComHandleId = 0
        ComNotification = 
        ComSignalLength = 7
        ComTransferProperty = PENDING
    ComGeneral:
      ComConfigurationUseDet = true
      ComSafeBswChecks = false
      ComEnableSignalGroupArrayApi = false
      ComRetryFailedTransmitRequests = false
      ComSupportedIPduGroups = 4
      ComVersionInfoApi = false
      ComAdvancedIPduCallouts = true
      ComOptimizedIPduGroupHandling = false
      ComMetaDataSupport = false
      ComReceiveSignalMacroAPI = false
      ComDeferredEventCacheSupport = false
      ComMainfunctionTimingDomainSupport = false
      ComSignalGateway = false
      ComDescriptionGateway = false
      ComDescriptionRoutingCodeGeneration = false
      ComUserCbkHeaderFile = Appl_Cbk.h
    ComGeneration:
      ComOutOfBoundsWriteProtectionStrategy = NONE
      ComOutOfBoundsWriteSanitizer = false
      ComOutOfBoundsReadSanitizer = false
      ComReduceConstantData2Define = false
      ComBoolDataInArrayOfStructStrategy = BOOLEAN
      ComDeduplicateIndirectedData = true
      ComDataDeduplicationStrategy = WITH_CAST
      ComReduceBoolDataByNegationThreshold = 2
      ComReduceBoolDataByNumericalComparisonThreshold = 2
      ComReduceBoolDataByNumericalRelationThreshold = 2
      ComReduceBoolDataByNumericalOperandStrategy = WITH_ANY_VALUE
      ComReduceNumericalDataByOffsetThreshold = 2
      ComReduceNumericalDataByArraySubtractionThreshold = 2
      ComReduceDataByStreaming = false
      ComShortSymbols = false
      ComInterfacesForDeactivatedData = false
      ComReferringKeysInComments = false
    ComOptimization:
      ComTxCyclicProcessingISRLockThreshold = 1
      ComTxDeadlineMonitoringISRLockThreshold = 1
      ComTxProcessingISRLockThreshold = 1
      ComRxDeadlineMonitoringISRLockThreshold = 1
      ComRxDeferredProcessingISRLockThreshold = 1
      ComGatewayProcessingISRLockThreshold = 1
      ComGatewayDescriptionProcessingISRLockThreshold = 1
      ComIPduGroupISRLockThreshold = 1
