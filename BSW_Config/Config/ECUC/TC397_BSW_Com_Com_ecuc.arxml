AUTOSAR XML (schema 00048)
package /ActiveEcuC
  module config Com: implementation-config-variant=VARIANT-PRE-COMPILE, module-description=Com_Impl
    ComConfig: ComConfigurationId=0, ComRxDeferredNotificationCacheSize=1, ComRxImmediateNotificationCacheSize=0
      ComTimeBase: ComRxTimeBase=0.001, ComTxTimeBase=0.001, ComGwTimeBase=0.001
      ComIPdu_TimeSyncStatus_Tx (ComIPdu):
        ComIPduDirection = SEND
        ComIPduHandleId = 1
        ComIPduSignalProcessing = DEFERRED
        ComIPduType = NORMAL
        ComIPduCancellationSupport = false
        ComPduIdRef = TimeSyncStatus_TxPdu_Com
        ComIPduGroupRef = ComIPduGroup_Tx_All
        ComIPduSignalRef = ComSignal_TimeSyncStatus_Tx
        ComTxIPdu: ComMinimumDelayTime=0, ComTxIPduUnusedAreasDefault=0
          ComTxModeFalse
            ComTxMode: ComTxModeMode=DIRECT, ComTxModeNumberOfRepetitions=0
          ComTxModeTrue
            ComTxMode: ComTxModeMode=DIRECT, ComTxModeNumberOfRepetitions=0
      ComSignal_TimeSyncStatus_Tx (ComSignal):
        ComBitPosition = 0
        ComSignalEndianness = LITTLE_ENDIAN
        ComSignalInitValue = 0
        ComSignalType = UINT8
        ComSignalAccess = ACCESS_NEEDED_BY_OTHER
        ComHandleId = 4
        ComBitSize = 8
        ComTransferProperty = TRIGGERED
        ComSignalLength = 1
      ComIPduGroup_Tx_All (ComIPduGroup): ComIPduGroupHandleId=0
      ComIPdu_FaultInfoTx (ComIPdu):
        ComIPduDirection = SEND
        ComIPduHandleId = 0
        ComIPduSignalProcessing = DEFERRED
        ComIPduType = NORMAL
        ComIPduCancellationSupport = false
        ComPduIdRef = SomeIpFalutInfoTxPdu_Com
        ComIPduSignalGroupRef = ComSignalGroup_FaultInfoTx
        ComTxIPdu: ComMinimumDelayTime=0, ComTxIPduUnusedAreasDefault=0
          ComTxModeFalse
            ComTxMode: ComTxModeMode=NONE
          ComTxModeTrue
            ComTxMode: ComTxModeMode=NONE
      ComSignalGroup_FaultInfoTx (ComSignalGroup): ComSignalGroupAccess=ACCESS_NEEDED_BY_OTHER, ComHandleId=0, ComNotification=Com_Cbk_FaultInfoTx, ComTransferProperty=TRIGGERED
        4 x ComGroupSignal, all with ComSignalEndianness=LITTLE_ENDIAN, ComSignalInitValue=0, ComSignalType=UINT8, ComSignalAccess=ACCESS_NEEDED_BY_OTHER, ComBitSize=8, ComTransferProperty=TRIGGERED:
          ComGroupSignal_FaultInfoTx_Byte0: ComBitPosition=0, ComHandleId=0
          ComGroupSignal_FaultInfoTx_Byte1: ComBitPosition=8, ComHandleId=1
          ComGroupSignal_FaultInfoTx_Byte2: ComBitPosition=16, ComHandleId=2
          ComGroupSignal_FaultInfoTx_Byte3: ComBitPosition=24, ComHandleId=3
      ComIPdu_VechicleInfoRx (ComIPdu):
        ComIPduDirection = RECEIVE
        ComIPduHandleId = 0
        ComIPduSignalProcessing = DEFERRED
        ComIPduType = NORMAL
        ComIPduCancellationSupport = false
        ComPduIdRef = SomeIpVechicleInfoRxPdu_Com
        ComIPduSignalGroupRef = ComSignalGroup_VechicleInfoRx
      ComSignalGroup_VechicleInfoRx (ComSignalGroup): ComSignalGroupAccess=ACCESS_NEEDED_BY_OTHER, ComHandleId=0, ComNotification=Com_Cbk_VechicleInfoRx
        4 x ComGroupSignal, all with ComSignalEndianness=LITTLE_ENDIAN, ComSignalInitValue=0, ComSignalType=UINT8, ComSignalAccess=ACCESS_NEEDED_BY_OTHER, ComBitSize=8:
          ComGroupSignal_VechicleInfoRx_byte0: ComBitPosition=0, ComHandleId=0
          ComGroupSignal_VechicleInfoRx_byte1: ComBitPosition=8, ComHandleId=1
          ComGroupSignal_VechicleInfoRx_byte2: ComBitPosition=16, ComHandleId=2
          ComGroupSignal_VechicleInfoRx_byte3: ComBitPosition=24, ComHandleId=3
    ComGeneral:
      ComConfigurationUseDet = true
      ComSafeBswChecks = false
      ComEnableSignalGroupArrayApi = false
      ComRetryFailedTransmitRequests = false
      ComSupportedIPduGroups = 1
      ComVersionInfoApi = false
      ComAdvancedIPduCallouts = true
      ComOptimizedIPduGroupHandling = true
      ComMetaDataSupport = false
      ComReceiveSignalMacroAPI = false
      ComDeferredEventCacheSupport = false
      ComMainfunctionTimingDomainSupport = false
      ComSignalGateway = false
      ComDescriptionGateway = false
      ComDescriptionRoutingCodeGeneration = false
      ComUserCbkHeaderFile = Appl_Cbk.h
    ComGeneration:
      ComOutOfBoundsWriteProtectionStrategy = NONE
      ComOutOfBoundsWriteSanitizer = false
      ComOutOfBoundsReadSanitizer = false
      ComReduceConstantData2Define = false
      ComBoolDataInArrayOfStructStrategy = BOOLEAN
      ComDeduplicateIndirectedData = true
      ComDataDeduplicationStrategy = WITH_CAST
      ComReduceBoolDataByNegationThreshold = 2
      ComReduceBoolDataByNumericalComparisonThreshold = 2
      ComReduceBoolDataByNumericalRelationThreshold = 2
      ComReduceBoolDataByNumericalOperandStrategy = WITH_ANY_VALUE
      ComReduceNumericalDataByOffsetThreshold = 2
      ComReduceNumericalDataByArraySubtractionThreshold = 2
      ComReduceDataByStreaming = false
      ComShortSymbols = false
      ComInterfacesForDeactivatedData = false
      ComReferringKeysInComments = false
    ComOptimization:
      ComTxCyclicProcessingISRLockThreshold = 1
      ComTxDeadlineMonitoringISRLockThreshold = 1
      ComTxProcessingISRLockThreshold = 1
      ComRxDeadlineMonitoringISRLockThreshold = 1
      ComRxDeferredProcessingISRLockThreshold = 1
      ComGatewayProcessingISRLockThreshold = 1
      ComGatewayDescriptionProcessingISRLockThreshold = 1
      ComIPduGroupISRLockThreshold = 1
