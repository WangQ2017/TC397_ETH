AUTOSAR XML (schema 00048)
package /ActiveEcuC
  module config Com: implementation-config-variant=VARIANT-PRE-COMPILE, module-description=Com_Impl
    ComConfig: ComConfigurationId=0, ComRxDeferredNotificationCacheSize=1, ComRxImmediateNotificationCacheSize=0
      ComTimeBase: ComRxTimeBase=0.001, ComTxTimeBase=0.001, ComGwTimeBase=0.001
      ComIPduPnc_EIRA_ETH_Rx (ComIPdu):
        ComIPduDirection = RECEIVE
        ComIPduHandleId = 0
        ComIPduSignalProcessing = DEFERRED
        ComIPduType = NORMAL
        ComIPduCancellationSupport = false
        ComPduIdRef = PncEiraEthRxPdu
        ComIPduSignalRef = ComSignalPnc_EIRA_ETH_Rx
        ComIPduGroupRef = ComIPduGroup_Rx_PNC00
        ComIPduGroupRef = ComIPduGroup_Rx_PNC_All_Active
      ComSignalPnc_EIRA_ETH_Rx (ComSignal):
        ComBitPosition = 0
        ComSignalEndianness = opaque
        ComSignalInitValue = 0 0 0 0 0 0 0
        ComSignalType = UINT8_N
        ComSignalAccess = ACCESS_NEEDED_BY_OTHER
        ComHandleId = 4
        ComNotification = ComM_ComCbk_ComSignalPnc_EIRA_ETH_Rx
        ComSignalLength = 7
      4 x ComIPduGroup:
        ComIPduGroup_Tx_PNC00: ComIPduGroupHandleId=2
        ComIPduGroup_Tx_PNC_All_Active: ComIPduGroupHandleId=3
        ComIPduGroup_Rx_PNC00: ComIPduGroupHandleId=1
        ComIPduGroup_Rx_PNC_All_Active: ComIPduGroupHandleId=0
      ComIPduPnc_EIRA_ETH_Tx (ComIPdu):
        ComIPduDirection = SEND
        ComIPduHandleId = 0
        ComIPduSignalProcessing = DEFERRED
        ComIPduType = NORMAL
        ComIPduCancellationSupport = false
        ComPduIdRef = PncEiraEthTxPdu
        ComIPduSignalRef = ComSignalPnc_EIRA_ETH_Tx
        ComIPduGroupRef = ComIPduGroup_Tx_PNC00
        ComIPduGroupRef = ComIPduGroup_Tx_PNC_All_Active
        ComTxIPdu: ComMinimumDelayTime=0, ComTxIPduUnusedAreasDefault=0
          ComTxModeFalse
            ComTxMode: ComTxModeMode=NONE
          ComTxModeTrue
            ComTxMode: ComTxModeMode=NONE
      ComSignalPnc_EIRA_ETH_Tx (ComSignal):
        ComBitPosition = 0
        ComSignalEndianness = opaque
        ComSignalInitValue = 0 0 0 0 0 0 0
        ComSignalType = UINT8_N
        ComSignalAccess = ACCESS_NEEDED_BY_OTHER
        ComHandleId = 3
        ComNotification = 
        ComSignalLength = 7
        ComTransferProperty = PENDING
      ComIPdu_VechicleInfoRx (ComIPdu):
        ComIPduDirection = RECEIVE
        ComIPduHandleId = 1
        ComIPduSignalProcessing = DEFERRED
        ComIPduType = NORMAL
        ComIPduCancellationSupport = false
        ComPduIdRef = SomeIpVechicleInfoRxPdu_Com
        ComIPduSignalGroupRef = ComSignalGroup_VechicleInfoRx
      ComSignalGroup_VechicleInfoRx (ComSignalGroup): ComSignalGroupAccess=ACCESS_NEEDED_BY_OTHER, ComNotification=Com_Cbk_VechicleInfoRx, ComHandleId=0
        4 x ComGroupSignal, all with ComSignalEndianness=LITTLE_ENDIAN, ComSignalInitValue=0, ComSignalType=UINT8, ComSignalAccess=ACCESS_UNCLEAR, ComBitSize=8:
          ComGroupSignal_VechicleInfoRx_byte0: ComBitPosition=0, ComHandleId=0
          ComGroupSignal_VechicleInfoRx_byte1: ComBitPosition=8, ComHandleId=1
          ComGroupSignal_VechicleInfoRx_byte3: ComBitPosition=24, ComHandleId=3
          ComGroupSignal_VechicleInfoRx_byte2: ComBitPosition=16, ComHandleId=2
      ComIPdu_FalutInfoTx (ComIPdu):
        ComIPduDirection = SEND
        ComIPduHandleId = 1
        ComIPduSignalProcessing = DEFERRED
        ComIPduType = NORMAL
        ComIPduCancellationSupport = false
        ComPduIdRef = SomeIpFalutInfoTxPdu_Com
        ComIPduSignalGroupRef = ComSignalGroup_FalutInfoTx
        ComTxIPdu: ComMinimumDelayTime=0, ComTxIPduUnusedAreasDefault=0
          ComTxModeFalse
            ComTxMode: ComTxModeMode=NONE
          ComTxModeTrue
            ComTxMode: ComTxModeMode=DIRECT, ComTxModeNumberOfRepetitions=0
      ComSignalGroup_FalutInfoTx (ComSignalGroup): ComSignalGroupAccess=ACCESS_NEEDED_BY_OTHER, ComHandleId=0, ComTransferProperty=TRIGGERED_ON_CHANGE, ComNotification=Com_Cbk_FalutInfoTx
        4 x ComGroupSignal, all with ComSignalEndianness=LITTLE_ENDIAN, ComSignalInitValue=0, ComSignalType=UINT8, ComBitSize=8, ComTransferProperty=TRIGGERED:
          ComGroupSignal_FalutInfoTx_byte0: ComBitPosition=0, ComSignalAccess=ACCESS_UNCLEAR, ComHandleId=0
          ComGroupSignal_FalutInfoTx_byte1: ComBitPosition=8, ComSignalAccess=ACCESS_UNCLEAR, ComHandleId=1
          ComGroupSignal_FalutInfoTx_byte2: ComBitPosition=16, ComSignalAccess=ACCESS_UNCLEAR, ComHandleId=2
          ComGroupSignal_FalutInfoTx_byte3: ComBitPosition=24, ComSignalAccess=ACCESS_NOT_NEEDED
    ComGeneral:
      ComConfigurationUseDet = true
      ComSafeBswChecks = false
      ComEnableSignalGroupArrayApi = false
      ComRetryFailedTransmitRequests = false
      ComSupportedIPduGroups = 4
      ComVersionInfoApi = false
      ComAdvancedIPduCallouts = true
      ComOptimizedIPduGroupHandling = false
      ComMetaDataSupport = false
      ComReceiveSignalMacroAPI = false
      ComDeferredEventCacheSupport = false
      ComMainfunctionTimingDomainSupport = false
      ComSignalGateway = false
      ComDescriptionGateway = false
      ComDescriptionRoutingCodeGeneration = false
      ComUserCbkHeaderFile = Appl_Cbk.h
    ComGeneration:
      ComOutOfBoundsWriteProtectionStrategy = NONE
      ComOutOfBoundsWriteSanitizer = false
      ComOutOfBoundsReadSanitizer = false
      ComReduceConstantData2Define = false
      ComBoolDataInArrayOfStructStrategy = BOOLEAN
      ComDeduplicateIndirectedData = true
      ComDataDeduplicationStrategy = WITH_CAST
      ComReduceBoolDataByNegationThreshold = 2
      ComReduceBoolDataByNumericalComparisonThreshold = 2
      ComReduceBoolDataByNumericalRelationThreshold = 2
      ComReduceBoolDataByNumericalOperandStrategy = WITH_ANY_VALUE
      ComReduceNumericalDataByOffsetThreshold = 2
      ComReduceNumericalDataByArraySubtractionThreshold = 2
      ComReduceDataByStreaming = false
      ComShortSymbols = false
      ComInterfacesForDeactivatedData = false
      ComReferringKeysInComments = false
    ComOptimization:
      ComTxCyclicProcessingISRLockThreshold = 1
      ComTxDeadlineMonitoringISRLockThreshold = 1
      ComTxProcessingISRLockThreshold = 1
      ComRxDeadlineMonitoringISRLockThreshold = 1
      ComRxDeferredProcessingISRLockThreshold = 1
      ComGatewayProcessingISRLockThreshold = 1
      ComGatewayDescriptionProcessingISRLockThreshold = 1
      ComIPduGroupISRLockThreshold = 1
