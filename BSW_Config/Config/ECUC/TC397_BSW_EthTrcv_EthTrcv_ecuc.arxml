AUTOSAR XML (schema 00048)
package /ActiveEcuC
  module config EthTrcv: implementation-config-variant=VARIANT-PRE-COMPILE, module-description=EthTrcv_Impl
    EthTrcvGeneral:
      EthTrcvDevErrorDetect = false
      EthTrcvGetBaudRateApi = true
      EthTrcvGetDuplexModeApi = true
      EthTrcvGetLinkStateApi = true
      EthTrcvGetTransceiverModeApi = true
      EthTrcvMaxTrcvsSupported = 1
      EthTrcvSetTransceiverModeApi = true
      EthTrcvStartAutoNegotiationApi = true
      EthTrcvVersionInfoApi = false
      EthTrcvIndex = 0
      EthTrcvRuntimeMeasurementSupport = false
      EthTrcvWakeUpSupport = ETHTRCV_WAKEUP_NOT_SUPPORTED
      EthTrcvHwAccessLoopCount = 0
      EthTrcvSafeBswChecks = false
      EthTrcvCableDiagLoopCount = 10000
      EthTrcvMainFunctionPeriod = 0.001
      EthTrcvPreTrcvInitUserCallout = NULL_PTR
      EthTrcvPostTrcvInitUserCallout = NULL_PTR
      EthTrcvHwAccessMonitorPeriod = 0.001
      EthTrcvHwAccessMonitorFailureUserCallout = NULL_PTR
      EthTrcvHwAccessMonitorFailureDebounceValue = 0
      EthTrcvHwAccessMonitorRecoveryDebounceValue = 0
      EthTrcvMainFunctionLinkHandlingPeriod = 0.001
    EthTrcvConfigSet
      EthTrcvConfig:
        EthTrcvIdx = 0
        EthTrcvSpeed = TRCV_SPEED_100
        EthTrcvLinkFailCounterValueForReset = 1000
        EthTrcvDerivative = ETHTRCV_TJA1101
        EthTrcvMiiDriverReducedOutputStrengthEnabled = false
        EthTrcvConnNeg = ETHTRCV_CONN_NEG_MASTER
        EthTrcvPhySignalQualityMeanValueLength = 100
        EthTrcvLinkStartupDelay = 0.002
        EthTrcvExtendedLinkStateCheckEnabled = false
        EthTrcvSoftResetOnInit = false
        EthTrcvAutoNegotiationEnabled = false
        EthTrcvP0P1Selection = ETHTRCV_P0
        EthTrcvMgmtInterface
          EthTrcvMiiInterface: EthTrcvMiiIdx=0, EthTrcvMiiSelection=ETHTRCV_RMII_MODE, EthTrcvCtrlRef=EthCtrlConfig0
