AUTOSAR XML (schema 00048)
package /ActiveEcuC
  module config EthTrcv: implementation-config-variant=VARIANT-PRE-COMPILE, module-description=EthTrcv_Impl
    EthTrcvGeneral:
      EthTrcvDevErrorDetect = true
      EthTrcvGetBaudRateApi = true
      EthTrcvGetDuplexModeApi = true
      EthTrcvGetLinkStateApi = true
      EthTrcvGetTransceiverModeApi = true
      EthTrcvMaxTrcvsSupported = 1
      EthTrcvSetTransceiverModeApi = true
      EthTrcvStartAutoNegotiationApi = true
      EthTrcvVersionInfoApi = false
      EthTrcvIndex = 0
      EthTrcvRuntimeMeasurementSupport = false
      EthTrcvWakeUpSupport = ETHTRCV_WAKEUP_NOT_SUPPORTED
      EthTrcvHwAccessLoopCount = 0
      EthTrcvSafeBswChecks = false
      EthTrcvCableDiagLoopCount = 10000
      EthTrcvMainFunctionPeriod = 0.005
      EthTrcvPreTrcvInitUserCallout = EthTrcv_PreTrcvInitCallout
      EthTrcvPostTrcvInitUserCallout = EthTrcv_PostTrcvInitCallout
      EthTrcvHwAccessMonitorPeriod = 0.005
      EthTrcvHwAccessMonitorFailureUserCallout = NULL_PTR
      EthTrcvHwAccessMonitorFailureDebounceValue = 0
      EthTrcvHwAccessMonitorRecoveryDebounceValue = 0
      EthTrcvMainFunctionLinkHandlingPeriod = 0.005
      EthTrcvCalloutIncludeFiles = EthTrcv_Callout.h
    EthTrcvConfigSet
      EthTrcvConfig:
        EthTrcvIdx = 0
        EthTrcvSpeed = TRCV_SPEED_100
        EthTrcvLinkFailCounterValueForReset = 1000
        EthTrcvDerivative = ETHTRCV_TJA1101
        EthTrcvMiiDriverReducedOutputStrengthEnabled = false
        EthTrcvConnNeg = ETHTRCV_CONN_NEG_MASTER
        EthTrcvPhySignalQualityMeanValueLength = 100
        EthTrcvLinkStartupDelay = 0.02
        EthTrcvExtendedLinkStateCheckEnabled = false
        EthTrcvSoftResetOnInit = true
        EthTrcvAutoNegotiationEnabled = false
        EthTrcvP0P1Selection = ETHTRCV_P0
        EthTrcvSoftResetWaitCycles = 100
        EthTrcvClkMode = ETHTRCV_25_MHZ_EXT_CLOCK_INPUT
        EthTrcvMgmtInterface
          EthTrcvMiiInterface: EthTrcvMiiIdx=0, EthTrcvMiiSelection=ETHTRCV_MII_MODE, EthTrcvCtrlRef=EthCtrlConfig_MAIN
