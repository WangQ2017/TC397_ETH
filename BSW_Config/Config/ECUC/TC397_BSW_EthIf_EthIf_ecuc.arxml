AUTOSAR XML (schema 00048)
package /ActiveEcuC
  module config EthIf: implementation-config-variant=VARIANT-PRE-COMPILE, module-description=EthIf_Impl
    EthIfConfigSet
      EthIfFrameOwnerConfig_EthTsyn (EthIfFrameOwnerConfig): EthIfFrameType=35063, EthIfOwner=2, EthIfBswModuleRef=EthTSyn
      EthIfRxIndicationConfig_EthTsyn (EthIfRxIndicationConfig): EthIfRxIndicationFunction=EthTSyn_RxIndication, EthIfFrameOwnerConfigRef=EthIfFrameOwnerConfig_EthTsyn
      EthIfTrcvLinkStateChgConfig_EthTsyn (EthIfTrcvLinkStateChgConfig): EthIfTrcvLinkStateChgFunction=EthTSyn_TrcvLinkStateChg, EthIfFrameOwnerConfigRef=EthIfFrameOwnerConfig_EthTsyn
      EthIfTxConfirmationConfig_EthTsyn (EthIfTxConfirmationConfig): EthIfTxConfirmationFunction=EthTSyn_TxConfirmation, EthIfFrameOwnerConfigRef=EthIfFrameOwnerConfig_EthTsyn
      EthIfController_untagged (EthIfController):
        EthIfCtrlIdx = 0
        EthIfEnableVLAN = false
        EthIfVlanId = 0
        EthIfCtrlMtu = 1500
        EthIfEnableLaxLinkAggregation = false
        EthIfPhysControllerRef = EthCtrlConfig_MAIN
        EthIfTransceiverRef = EthTrcvConfig_MAIN
      EthSM_LinkStateChgCbk (EthIfTrcvLinkStateChgConfig): EthIfTrcvLinkStateChgFunction=EthSM_TrcvLinkStateChg
      EthIfFrameOwnerConfig_IPv4 (EthIfFrameOwnerConfig): EthIfFrameType=2048, EthIfOwner=0, EthIfBswModuleRef=TcpIp
      EthIfFrameOwnerConfig_IPv4_RxIndication (EthIfRxIndicationConfig): EthIfRxIndicationFunction=IpV4_Ip_RxIndication, EthIfFrameOwnerConfigRef=EthIfFrameOwnerConfig_IPv4
      EthIfFrameOwnerConfig_ARP (EthIfFrameOwnerConfig): EthIfFrameType=2054, EthIfOwner=1, EthIfBswModuleRef=TcpIp
      EthIfFrameOwnerConfig_IPv4_TxConfirmation (EthIfTxConfirmationConfig): EthIfTxConfirmationFunction=IpV4_Ip_TxConfirmation, EthIfFrameOwnerConfigRef=EthIfFrameOwnerConfig_IPv4
      EthIfFrameOwnerConfig_ARP_RxIndication (EthIfRxIndicationConfig): EthIfRxIndicationFunction=IpV4_Arp_RxIndication, EthIfFrameOwnerConfigRef=EthIfFrameOwnerConfig_ARP
      EthIfController_Vlan1 (EthIfController):
        EthIfCtrlIdx = 2
        EthIfEnableVLAN = true
        EthIfVlanId = 1
        EthIfCtrlMtu = 1500
        EthIfEnableLaxLinkAggregation = false
        EthIfPhysControllerRef = EthCtrlConfig_MAIN
        EthIfTransceiverRef = EthTrcvConfig_MAIN
      EthIfController_Valn23 (EthIfController):
        EthIfCtrlIdx = 1
        EthIfEnableVLAN = true
        EthIfVlanId = 23
        EthIfCtrlMtu = 1500
        EthIfEnableLaxLinkAggregation = false
        EthIfPhysControllerRef = EthCtrlConfig_MAIN
        EthIfTransceiverRef = EthTrcvConfig_MAIN
    EthIfGeneral:
      EthIfDevErrorDetect = true
      EthIfEnableRxInterrupt = false
      EthIfEnableTxInterrupt = true
      EthIfMaxTrcvsTotal = 1
      EthIfMaxTxBufsTotal = 8
      EthIfTrcvLinkStateChgMainReload = 5
      EthIfVersionInfoApi = false
      EthIfVersionInfoApiMacro = false
      EthIfEnableMainFunctionState = true
      EthIfMainFunctionPeriod = 0.005
      EthIfMainFunctionRxTimeout = 0.005
      EthIfRxIndicationIterations = 4
      EthIfUpdatePhysAddrFilter = true
      EthIfEnableZeroCopyExtensions = false
      EthIfMaxExtTxBufsTotal = 0
      EthIfGlobalTimeSupport = true
      EthIfEnableHeaderAccessApi = false
      EthIfWakeupSupport = false
      EthIfSwitchManagementSupport = false
      EthIfSafeBswChecks = false
      EthIfEnableSignalQualityApi = true
      EthIfGetAndResetMeasurementDataApi = false
      EthIfEnableSecurityEventReporting = false
