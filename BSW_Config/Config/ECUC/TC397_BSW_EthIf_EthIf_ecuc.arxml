AUTOSAR XML (schema 00048)
package /ActiveEcuC
  module config EthIf: implementation-config-variant=VARIANT-PRE-COMPILE, module-description=EthIf_Impl
    EthIfConfigSet
      EthIfFrameOwnerConfig_ARP (EthIfFrameOwnerConfig): EthIfFrameType=2054, EthIfOwner=1, EthIfBswModuleRef=TcpIp
      EthIfRxIndicationConfig_ARP (EthIfRxIndicationConfig): EthIfRxIndicationFunction=IpV4_Arp_RxIndication, EthIfFrameOwnerConfigRef=EthIfFrameOwnerConfig_ARP
      EthIfTrcvLinkStateChgConfig: EthIfTrcvLinkStateChgFunction=EthSM_TrcvLinkStateChg
      EthIfTxConfirmationConfig: EthIfTxConfirmationFunction=IpV4_Ip_TxConfirmation, EthIfFrameOwnerConfigRef=TcpIp_IPv4
      EthIfController_Vlan10 (EthIfController):
        EthIfCtrlIdx = 0
        EthIfEnableVLAN = true
        EthIfVlanId = 10
        EthIfCtrlMtu = 1500
        EthIfEnableLaxLinkAggregation = false
        EthIfPhysControllerRef = EthCtrlConfig_MAIN
        EthIfTransceiverRef = EthTrcvConfig_MAIN
      TcpIp_IPv4 (EthIfFrameOwnerConfig): EthIfFrameType=2048, EthIfOwner=0, EthIfBswModuleRef=TcpIp
      TcpIp_IPv4_RxIndication (EthIfRxIndicationConfig): EthIfRxIndicationFunction=IpV4_Ip_RxIndication, EthIfFrameOwnerConfigRef=TcpIp_IPv4
      EthTSyn_EthTSyn (EthIfFrameOwnerConfig): EthIfFrameType=35063, EthIfOwner=2, EthIfBswModuleRef=EthTSyn
      EthTSyn_TrcvLinkStateChg_EthTSyn (EthIfTrcvLinkStateChgConfig): EthIfTrcvLinkStateChgFunction=EthTSyn_TrcvLinkStateChg, EthIfFrameOwnerConfigRef=EthTSyn_EthTSyn
      EthTSyn_RxIndication_EthTSyn (EthIfRxIndicationConfig): EthIfRxIndicationFunction=EthTSyn_RxIndication, EthIfFrameOwnerConfigRef=EthTSyn_EthTSyn
      EthTSyn_TxConfirmation_EthTSyn (EthIfTxConfirmationConfig): EthIfTxConfirmationFunction=EthTSyn_TxConfirmation, EthIfFrameOwnerConfigRef=EthTSyn_EthTSyn
      EthIfController_Vlan23 (EthIfController):
        EthIfCtrlIdx = 1
        EthIfEnableVLAN = true
        EthIfVlanId = 23
        EthIfCtrlMtu = 1500
        EthIfEnableLaxLinkAggregation = false
        EthIfPhysControllerRef = EthCtrlConfig_MAIN
        EthIfTransceiverRef = EthTrcvConfig_MAIN
      EthIfController_Vlan1 (EthIfController):
        EthIfCtrlIdx = 2
        EthIfEnableVLAN = true
        EthIfVlanId = 1
        EthIfCtrlMtu = 1500
        EthIfEnableLaxLinkAggregation = false
        EthIfPhysControllerRef = EthCtrlConfig_MAIN
        EthIfTransceiverRef = EthTrcvConfig_MAIN
    EthIfGeneral:
      EthIfDevErrorDetect = true
      EthIfEnableRxInterrupt = false
      EthIfEnableTxInterrupt = true
      EthIfMaxTrcvsTotal = 1
      EthIfMaxTxBufsTotal = 12
      EthIfTrcvLinkStateChgMainReload = 5
      EthIfVersionInfoApi = false
      EthIfVersionInfoApiMacro = false
      EthIfEnableMainFunctionState = true
      EthIfMainFunctionPeriod = 0.005
      EthIfMainFunctionRxTimeout = 0.005
      EthIfRxIndicationIterations = 5
      EthIfUpdatePhysAddrFilter = true
      EthIfEnableZeroCopyExtensions = false
      EthIfMaxExtTxBufsTotal = 0
      EthIfGlobalTimeSupport = true
      EthIfEnableHeaderAccessApi = false
      EthIfWakeupSupport = false
      EthIfSwitchManagementSupport = false
      EthIfSafeBswChecks = false
      EthIfEnableSignalQualityApi = false
      EthIfGetAndResetMeasurementDataApi = false
      EthIfEnableSecurityEventReporting = false
