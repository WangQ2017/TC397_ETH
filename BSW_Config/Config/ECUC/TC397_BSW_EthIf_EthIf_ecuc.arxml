AUTOSAR XML (schema 00048)
package /ActiveEcuC
  module config EthIf: implementation-config-variant=VARIANT-PRE-COMPILE, module-description=EthIf_Impl
    EthIfConfigSet
      EthIfFrameOwnerConfig: EthIfFrameType=0, EthIfOwner=0
      EthIfRxIndicationConfig: EthIfRxIndicationFunction=Msn_RxIndication, EthIfFrameOwnerConfigRef=(unset)
      EthIfTrcvLinkStateChgConfig: EthIfTrcvLinkStateChgFunction=EthSM_TrcvLinkStateChg
      EthIfTxConfirmationConfig: EthIfTxConfirmationFunction=Msn_TxConfirmation, EthIfFrameOwnerConfigRef=(unset)
      EthIfController: EthIfCtrlIdx=0, EthIfEnableVLAN=false, EthIfVlanId=0, EthIfCtrlMtu=1500, EthIfEnableLaxLinkAggregation=false, EthIfPhysControllerRef=(unset)
    EthIfGeneral:
      EthIfDevErrorDetect = true
      EthIfEnableRxInterrupt = true
      EthIfEnableTxInterrupt = true
      EthIfMaxTrcvsTotal = 1
      EthIfMaxTxBufsTotal = 10
      EthIfTrcvLinkStateChgMainReload = 5
      EthIfVersionInfoApi = false
      EthIfVersionInfoApiMacro = false
      EthIfEnableMainFunctionState = true
      EthIfMainFunctionPeriod = 0.005
      EthIfMainFunctionRxTimeout = 0.005
      EthIfRxIndicationIterations = 5
      EthIfUpdatePhysAddrFilter = false
      EthIfEnableZeroCopyExtensions = false
      EthIfMaxExtTxBufsTotal = 0
      EthIfGlobalTimeSupport = false
      EthIfEnableHeaderAccessApi = false
      EthIfWakeupSupport = false
      EthIfSwitchManagementSupport = false
      EthIfSafeBswChecks = false
      EthIfEnableSignalQualityApi = false
      EthIfGetAndResetMeasurementDataApi = false
      EthIfEnableSecurityEventReporting = false
