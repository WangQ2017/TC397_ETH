AUTOSAR XML (schema 00048)
package /ActiveEcuC
  module config EthIf: implementation-config-variant=VARIANT-PRE-COMPILE, module-description=EthIf_Impl
    EthIfConfigSet
      EthTSyn (EthIfFrameOwnerConfig): EthIfFrameType=35063, EthIfOwner=2, EthIfBswModuleRef=EthTSyn
      EthTSync_RxIndication (EthIfRxIndicationConfig): EthIfRxIndicationFunction=EthTSyn_RxIndication, EthIfFrameOwnerConfigRef=EthTSyn
      EthSM_LinkStateChgCbk (EthIfTrcvLinkStateChgConfig): EthIfTrcvLinkStateChgFunction=EthSM_TrcvLinkStateChg
      EthTSyn_TxConfirmationCbk (EthIfTxConfirmationConfig): EthIfTxConfirmationFunction=EthTSyn_TxConfirmation, EthIfFrameOwnerConfigRef=EthTSyn
      EthIfController_Vlan10 (EthIfController):
        EthIfCtrlIdx = 0
        EthIfEnableVLAN = false
        EthIfCtrlMtu = 1500
        EthIfEnableLaxLinkAggregation = false
        EthIfVlanId = 0
        EthIfPhysControllerRef = EthCtrlConfig_MAIN
        EthIfTransceiverRef = EthTrcvConfig
      TcpIp_ARP (EthIfFrameOwnerConfig): EthIfFrameType=2054, EthIfOwner=1, EthIfBswModuleRef=TcpIp
      TcpIp_IPv4 (EthIfFrameOwnerConfig): EthIfFrameType=2048, EthIfOwner=0, EthIfBswModuleRef=TcpIp
      EthTSyn_LinkStateChgCbk (EthIfTrcvLinkStateChgConfig): EthIfTrcvLinkStateChgFunction=EthTSyn_TrcvLinkStateChg, EthIfFrameOwnerConfigRef=EthTSyn
      TcpIp_ARP_RxIndication (EthIfRxIndicationConfig): EthIfRxIndicationFunction=IpV4_Arp_RxIndication, EthIfFrameOwnerConfigRef=TcpIp_ARP
      TcpIp_IPv4_RxIndication (EthIfRxIndicationConfig): EthIfRxIndicationFunction=IpV4_Ip_RxIndication, EthIfFrameOwnerConfigRef=TcpIp_IPv4
      TcpIp_IPv4_TxConfirmationCbk (EthIfTxConfirmationConfig): EthIfTxConfirmationFunction=IpV4_Ip_TxConfirmation, EthIfFrameOwnerConfigRef=TcpIp_IPv4
    EthIfGeneral:
      EthIfDevErrorDetect = true
      EthIfEnableRxInterrupt = false
      EthIfEnableTxInterrupt = true
      EthIfMaxTrcvsTotal = 1
      EthIfMaxTxBufsTotal = 4
      EthIfTrcvLinkStateChgMainReload = 5
      EthIfVersionInfoApi = false
      EthIfVersionInfoApiMacro = false
      EthIfEnableMainFunctionState = true
      EthIfMainFunctionPeriod = 0.005
      EthIfMainFunctionRxTimeout = 0.005
      EthIfRxIndicationIterations = 5
      EthIfUpdatePhysAddrFilter = true
      EthIfEnableZeroCopyExtensions = false
      EthIfMaxExtTxBufsTotal = 0
      EthIfGlobalTimeSupport = true
      EthIfEnableHeaderAccessApi = false
      EthIfWakeupSupport = false
      EthIfSwitchManagementSupport = false
      EthIfSafeBswChecks = false
      EthIfEnableSignalQualityApi = false
      EthIfGetAndResetMeasurementDataApi = false
      EthIfEnableSecurityEventReporting = false
