AUTOSAR XML (schema 00048)
package /ActiveEcuC
  module config LdCom: implementation-config-variant=VARIANT-PRE-COMPILE, module-description=LdCom_Impl
    LdComGeneral: LdComDevErrorDetect=true, LdComVersionInfoApi=false, LdComSafeBswChecks=false
      LdComGeneration:
        LdComReduceConstantData2Define = false
        LdComReduceBoolDataByNumericalComparisonThreshold = 2
        LdComReduceDataByStreaming = false
        LdComReduceBoolDataByNumericalRelationThreshold = 2
        LdComOutOfBoundsReadSanitizer = false
        LdComShortSymbols = false
        LdComInterfacesForDeactivatedData = false
        LdComReferringKeysInComments = false
    LdComConfig
      5 x LdComIPdu, all with LdComApiType=LDCOM_IF, LdComSystemTemplateSignalRef=(unset):
        LdComIPdu_udplog_Tx: LdComHandleId=4, LdComIPduDirection=LDCOM_SEND, LdComPduRef=udplog_TxPdu_LdCom
        LdComIPdu_VechicleSpeedRx: LdComHandleId=2, LdComIPduDirection=LDCOM_RECEIVE, LdComRxIndication=Rte_LdComCbk_VechicleSpeedRx, LdComPduRef=SomeIpVechicleSpeedRxPdu_Ldcom
        LdComIPdu_VechicleStatusRx: LdComHandleId=3, LdComIPduDirection=LDCOM_RECEIVE, LdComRxIndication=Rte_LdComCbk_VechicleStatusRx, LdComPduRef=SomeIpVechicleStatusRxPdu_Ldcom
        LdComIPdu_SenStateTx: LdComHandleId=1, LdComIPduDirection=LDCOM_SEND, LdComTxConfirmation=Rte_LdComCbk_SenStateTx, LdComPduRef=SomeIpSenStateTxPdu_Ldcom
        LdComIPdu_EcuStateTx: LdComHandleId=0, LdComIPduDirection=LDCOM_SEND, LdComTxConfirmation=Rte_LdComCbk__EcuStateTx, LdComPduRef=SomeIpEcuStateTxPdu_Ldcom
