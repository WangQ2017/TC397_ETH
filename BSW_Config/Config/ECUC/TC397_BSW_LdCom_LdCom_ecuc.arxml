AUTOSAR XML (schema 00048)
package /ActiveEcuC
  module config LdCom: implementation-config-variant=VARIANT-PRE-COMPILE, module-description=LdCom_Impl
    LdComGeneral: LdComDevErrorDetect=true, LdComVersionInfoApi=false, LdComSafeBswChecks=false
      LdComGeneration:
        LdComReduceConstantData2Define = false
        LdComReduceBoolDataByNumericalComparisonThreshold = 2
        LdComReduceDataByStreaming = false
        LdComReduceBoolDataByNumericalRelationThreshold = 2
        LdComOutOfBoundsReadSanitizer = false
        LdComShortSymbols = false
        LdComInterfacesForDeactivatedData = false
        LdComReferringKeysInComments = false
    LdComConfig
      LdComIPdu_udplog_Tx (LdComIPdu): LdComHandleId=0, LdComApiType=LDCOM_IF, LdComIPduDirection=LDCOM_SEND, LdComPduRef=udplog_TxPdu_LdCom, LdComSystemTemplateSignalRef=(unset)
