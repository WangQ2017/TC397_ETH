AUTOSAR XML (schema 00048)
package /ActiveEcuC
  module config LdCom: implementation-config-variant=VARIANT-PRE-COMPILE, module-description=LdCom_Impl
    LdComGeneral: LdComDevErrorDetect=true, LdComVersionInfoApi=false, LdComSafeBswChecks=false
      LdComGeneration:
        LdComReduceConstantData2Define = false
        LdComReduceBoolDataByNumericalComparisonThreshold = 2
        LdComReduceDataByStreaming = false
        LdComReduceBoolDataByNumericalRelationThreshold = 2
        LdComOutOfBoundsReadSanitizer = false
        LdComShortSymbols = false
        LdComInterfacesForDeactivatedData = false
        LdComReferringKeysInComments = false
    LdComConfig
      4 x LdComIPdu, all with LdComApiType=LDCOM_IF, LdComSystemTemplateSignalRef=(unset):
        LdComIPdu_VechicleSpeedRx: LdComHandleId=2, LdComIPduDirection=LDCOM_RECEIVE, LdComRxIndication=Rte_LdComCbkRxIndication_VechicleSpeedRx, LdComPduRef=SomeIpVechicleSpeedRxPdu_Ldcom
        LdComIPdu_SenStateTx: LdComHandleId=1, LdComIPduDirection=LDCOM_SEND, LdComPduRef=SomeIpSenStateTxPdu_Ldcom
        LdComIPdu_VechicleStatusRx: LdComHandleId=3, LdComIPduDirection=LDCOM_RECEIVE, LdComRxIndication=Rte_LdComCbkRxIndication_VechicleStatusRx, LdComPduRef=SomeIpVechicleStatusRxPdu_Ldcom
        LdComIPdu_EcuStateTx: LdComHandleId=0, LdComIPduDirection=LDCOM_SEND, LdComPduRef=SomeIpEcuStateTxPdu_Ldcom
