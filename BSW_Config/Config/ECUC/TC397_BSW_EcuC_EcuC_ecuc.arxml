AUTOSAR XML (schema 00048)
package /ActiveEcuC
  module config EcuC: implementation-config-variant=VARIANT-PRE-COMPILE, module-description=EcuC_Impl
    EcucGeneral:
      DummyFunction = false
      DummyStatement = true
      StructAlignment = Auto
      ArrayAlignment = Align8Bit
      StructInArrayAlignment = Auto
      SizeOfEnum = Size32Bit
      SizeOfROMPointer = Size32Bit
      SizeOfRAMPointer = Size32Bit
      CPUType = CPU32Bit
      SizeOfInt = Size32Bit
      ByteOrder = LITTLE_ENDIAN
      BitOrder = LSB_to_MSB
      AtomicBitAccessInBitfield = false
      AtomicVariableAccess = Atomic32BitAccess
      BitFieldDataType = INT
      EcuCSafeBswChecks = false
      DummyStatementKind = None
      ConditionalGenerating = true
      EcucBswImplementationCodeType = EcuCSourceCode
      EcuCUseStdReturnTypeForRte = false
      PostbuildLoadable: AlignmentFillPattern=255, PBROMStartAddress=0, PBRAMStartAddress=0, PBROMEndAddress=0, PBRAMEndAddress=0
      BswInitialization
        24 x InitFunction:
          BswM_PreInit: Header=BswM.h, InitPhase=INIT_ONE, ConfigType=BswM_ConfigType, ConfigPtrName=BswM_Config_Ptr, ConfigPtrClass=BSWM_INIT_DATA, ModuleRef=BswM  # /ActiveEcuC/BswM PLAIN_TEXT PreInit function description of BswM in UnfilteredViewInInvariantProject (UnfilteredInvariantProjectModelView) .
          BswM_InitMemory: Header=BswM.h, InitPhase=INIT_MEMORY, ModuleRef=BswM  # /ActiveEcuC/BswM PLAIN_TEXT InitMemory function description of BswM in UnfilteredViewInInvariantProject (UnfilteredInvariantProjectModelView) .
          BswM_Init: Header=BswM.h, InitPhase=NO_INIT, ConfigType=BswM_ConfigType, ConfigPtrName=BswM_Config_Ptr, ConfigPtrClass=BSWM_INIT_DATA, ModuleRef=BswM  # /ActiveEcuC/BswM PLAIN_TEXT Init function description of BswM in UnfilteredViewInInvariantProject (UnfilteredInvariantProjectModelView) .
          Det_Init: Header=Det.h, InitPhase=INIT_ZERO, ConfigType=Det_ConfigType, ConfigPtrName=Det_Config_Ptr, ConfigPtrClass=DET_INIT_DATA, ModuleRef=Det  # /ActiveEcuC/Det PLAIN_TEXT Init function description of Det in UnfilteredViewInInvariantProject (UnfilteredInvariantProjectModelView) .
          Det_InitMemory: Header=Det.h, InitPhase=INIT_MEMORY, ModuleRef=Det  # /ActiveEcuC/Det PLAIN_TEXT InitMemory function description of Det in UnfilteredViewInInvariantProject (UnfilteredInvariantProjectModelView) .
          Dio_Init: Header=Dio.h, InitPhase=NO_INIT, ModuleRef=Dio  # /Dio/Dio PLAIN_TEXT Created Dio_Init by Extended Init XML Service
          EcuM_Init: Header=EcuM.h, InitPhase=NO_INIT, ConfigType=EcuM_PbConfigType, ConfigPtrName=EcuM_Config_Ptr, ConfigPtrClass=ECUM_INIT_DATA, ModuleRef=EcuM  # /ActiveEcuC/EcuM PLAIN_TEXT Init function description of EcuM in UnfilteredViewInInvariantProject (UnfilteredInvariantProjectModelView) .
          Irq_Init: Header=Irq.h, InitPhase=NO_INIT, ModuleRef=Irq  # /Irq/Irq PLAIN_TEXT Created Irq_Init by Extended Init XML Service
          McalLib_Init: Header=McalLib.h, InitPhase=NO_INIT, ModuleRef=McalLib  # /McalLib/McalLib PLAIN_TEXT Created McalLib_Init by Extended Init XML Service
          Port_Init: Header=Port.h, InitPhase=INIT_ONE_EARLY, ConfigType=Port_ConfigType, ConfigPtrName=&Port_Config, ConfigPtrClass=AUTOMATIC, ModuleRef=Port  # /Port/Port PLAIN_TEXT Created Port_Init by Extended Init XML Service
          SchM_Init: Header=Rte_Main.h, InitPhase=NO_INIT, ModuleRef=Rte  # /ActiveEcuC/Rte PLAIN_TEXT Automatically generated by EcuCBswInitFctConfigurationService.
          Rte_StartTiming: Header=Rte_Main.h, InitPhase=NO_INIT, ModuleRef=Rte  # /ActiveEcuC/Rte PLAIN_TEXT Automatically generated by EcuCBswInitFctConfigurationService.
          Rte_Start: Header=Rte_Main.h, InitPhase=INIT_THREE, ModuleRef=Rte  # /ActiveEcuC/Rte PLAIN_TEXT Automatically generated by EcuCBswInitFctConfigurationService.
          Rte_InitMemory: Header=Rte_Main.h, InitPhase=INIT_MEMORY, ModuleRef=Rte  # /ActiveEcuC/Rte PLAIN_TEXT Automatically generated by EcuCBswInitFctConfigurationService.
          Brs_Init: Header=, InitPhase=NO_INIT, ModuleRef=vBRS  # /ActiveEcuC/vBRS PLAIN_TEXT Automatically generated by EcuCBswInitFctConfigurationService.
          vBaseEnv_Init: Header=, InitPhase=NO_INIT, ModuleRef=vBaseEnv  # /ActiveEcuC/vBaseEnv PLAIN_TEXT Created vBaseEnv_Init by Extended Init XML Service
          vLinkGen_Init: Header=vLinkGen_Lcfg.h, InitPhase=NO_INIT, ModuleRef=vLinkGen  # /ActiveEcuC/vLinkGen PLAIN_TEXT Dummy initialization of the vLinkGen
          Uart_Init: Header=Uart.h, InitPhase=INIT_ONE_LATE, ConfigType=Uart_ConfigType, ConfigPtrName=&Uart_Config, ConfigPtrClass=AUTOMATIC, ModuleRef=Uart  # /ActiveEcuC/Uart PLAIN_TEXT Created Uart_Init by Extended Init XML Service
          Crc_Init: Header=Crc.h, InitPhase=NO_INIT, ModuleRef=Crc  # /Crc/Crc PLAIN_TEXT Created Crc_Init by Extended Init XML Service
          Mcu_Init: Header=Mcu.h, InitPhase=INIT_ONE_EARLY, ConfigType=Mcu_ConfigType, ConfigPtrName=&Mcu_Config, ConfigPtrClass=AUTOMATIC, AdditionalInitCode=Mcu_InitClock(0);while (MCU_PLL_LOCKED != Mcu_GetPllStatus());Mcu_DistributePllClock();, ModuleRef=Mcu  # /ActiveEcuC/Mcu PLAIN_TEXT Created Mcu_Init by Extended Init XML Service
          Eth_30_Tc3xx_InitMemory: Header=Eth_30_Tc3xx.h, InitPhase=INIT_MEMORY, ModuleRef=Eth  # /ActiveEcuC/Eth PLAIN_TEXT Memory Initialization function of module Eth_30_Tc3xx.
          Eth_30_Tc3xx_Init: Header=Eth_30_Tc3xx.h, InitPhase=INIT_TWO_DRV, ConfigType=Eth_30_Tc3xx_ConfigType, ConfigPtrName=Eth_30_Tc3xx_Config_Ptr, ConfigPtrClass=ETH_30_TC3XX_INIT_DATA, ModuleRef=Eth  # /ActiveEcuC/Eth PLAIN_TEXT Module Initialization function of module Eth_30_Tc3xx.
          EthTrcv_30_Tja1100_Init: Header=EthTrcv_30_Tja1100.h, InitPhase=INIT_TWO_TRCV, ConfigType=EthTrcv_30_Tja1100_ConfigType, ConfigPtrName=EthTrcv_30_Tja1100_Config_Ptr, ConfigPtrClass=ETHTRCV_30_TJA1100_INIT_DATA, ModuleRef=EthTrcv  # /ActiveEcuC/EthTrcv PLAIN_TEXT Module Initialization function of module EthTrcv_30_Tja1100.
          EthTrcv_30_Tja1100_InitMemory: Header=EthTrcv_30_Tja1100.h, InitPhase=INIT_MEMORY, ModuleRef=EthTrcv  # /ActiveEcuC/EthTrcv PLAIN_TEXT Memory Initialization function of module EthTrcv_30_Tja1100.
    EcucHardware
      6 x EcucCoreDefinition:
        EcucCoreDefinition_Core{0..5}: EcucCoreId={0..5}
    EcucPartitionCollection
      6 x EcucPartition, all with EcucPartitionBswModuleExecution=false, PartitionCanBeRestarted=false, ASIL=QM:
        EcucPartition_Core0: EcucPartitionSoftwareComponentInstanceRef=Os_OsCore0_swc, EcucPartitionSoftwareComponentInstanceRef=Det
        EcucPartition_Core{1..5}: EcucPartitionSoftwareComponentInstanceRef=Os_OsCore{1..5}_swc
    EcucPduCollection: PduIdTypeEnum=UINT8, PduLengthTypeEnum=UINT16
      32 x Pdu, all with J1939Requestable=false:
        UdpNmRxPdu: PduLength=8
        UdpNmTxPdu: PduLength=8
        PncEiraEthRxPdu: PduLength=7
        PncEiraEthTxPdu: PduLength=7
        SdCtrlMulticastRxPdu: PduLength=1464, DynamicLength=true
        SdCtrlTxPdu: PduLength=1464, DynamicLength=true
        SdCtrlRxPdu: PduLength=1464, DynamicLength=true
        SomeIpVechicleSpeedRxPdu_SoAd: PduLength=14
        SomeIpVechicleSpeedRxPdu_Ldcom: PduLength=14
        SomeIpFalutInfoTxPdu_Com: PduLength=8
        SomeIpFalutInfoTxPdu_SoAd: PduLength=8
        SomeIpSenStateTxPdu_Ldcom: PduLength=8
        SomeIpVechicleInfoRxPdu_Com: PduLength=8
        SomeIpVechicleInfoRxPdu_SoAd: PduLength=8
        SomeIpSenStateTxPdu_SoAd: PduLength=8
        SomeIpVechicleStatusRxPdu_Ldcom: PduLength=8
        SomeIpVechicleStatusRxPdu_SoAd: PduLength=8
        SomeIpEcuStateTxPdu_Ldcom: PduLength=8
        SomeIpEcuStateTxPdu_SoAd: PduLength=8
        DoIPPhyReqRxPdu_DoIP2PduR: PduLength=4095
        DoIPPhyReqRxPdu_PduR2Dcm: PduLength=4095
        DoIPPhyResTxPdu_PduR2DoIP: PduLength=4095
        DoIPPhyResTxPdu_Dcm2PduR: PduLength=4095
        DoIPFuncReqRxPdu_DoIP2PduR: PduLength=4095
        DoIPFuncReqRxPdu_PduR2Dcm: PduLength=4095
        DoIP_UDP_DISCOVERY_DoIP2SoAd_TxPdu: PduLength=1522
        DoIP_UDP_TEST_EQUIPMENT_REQUEST_DoIP2SoAd_TxPdu: PduLength=1522
        DoIP_UDP_TEST_EQUIPMENT_REQUEST_SoAd2DoIP_RxPdu: PduLength=1522
        DoIP_TCP_DATA0_SoAd2DoIP_RxPdu: PduLength=1522
        DoIP_TCP_DATA0_DoIP2SoAd_TxPdu: PduLength=1522
        DoIP_TCP_DATA1_DoIP2SoAd_TxPdu: PduLength=1522
        DoIP_TCP_DATA1_SoAd2DoIP_RxPdu: PduLength=1522
