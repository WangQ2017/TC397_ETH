AUTOSAR XML (schema 00048)
package /ActiveEcuC
  module config Eth: implementation-config-variant=VARIANT-PRE-COMPILE, module-description=Eth_Impl
    EthGeneral:
      EthDevErrorDetect = false
      EthVersionInfoApi = false
      EthIndex = 0
      EthMaxCtrlsSupported = 1
      EthUpdatePhysAddrFilter = true
      EthEnableRxInterrupt = false
      EthEnableTxInterrupt = true
      EthOsIsrCategory = CATEGORY_2
      EthRuntimeMeasurementSupport = false
      EthEnableZeroCopyExtensions = false
      EthEnableHeaderAccessApi = false
      EthUsePeripheralAccessApi = false
      EthRuntimeEnvironment = ETH_AUTOSAR_OS
      EthSafeBswChecks = false
      EthMainFunctionPeriod = 0.02
      EthGetEtherStatsApi = true
      EthPreCtrlInitUserCallout = NULL_PTR
      EthEnableExplicitBufferMapping = false
      EthGetAndResetMeasurementDataApi = true
      EthPostCtrlInitUserCallout = NULL_PTR
      EthAdditionalIncludes = EthIf_Cbk.h
    EthConfigSet
      EthCtrlConfig_MAIN (EthCtrlConfig):
        EthCtrlEnableMii = true
        EthCtrlEnableRxInterrupt = false
        EthCtrlEnableTxInterrupt = true
        EthCtrlIdx = 0
        EthCtrlRxBufLenByte = 1522
        EthCtrlTxBufLenByte = 1522
        EthRxBufTotal = 10
        EthTxBufTotal = 12
        EthCtrlEnableMacWriteAccess = false
        EthCtrlEnableQoS = false
        EthCtrlEnablePtp = true
        EthCtrlEnableTrafficShaping = NO_TRAFFIC_SHAPING
        EthEnableAVBConformance = false
        EthCtrlMiiInterface = ETH_MII_MODE
        EthCtrlResetLoopMaxCycles = 1000
        EthCtrlMiiLoopMaxCycles = 1000
        EthCtrlLoopMaxCycles = 1000
        EthEthSwtMgmtHdrLen = 0
        EthCtrlEnableOsfMode = true
        EthCtrlCsrClkRange = CLK_60_100_MHZ
        EthCtrlPrtSpdSel = PS_100_MBITS
        EthCtrlEnableVlanIDBasedFramesQueuing = false
        EthCtrlPhysAddr = 00:17:BE:00:17:BE
        EthCtrlEnablePpsEventOnTimeApi = false
        EthCtrlSkewRx = 0
        EthCtrlSkewTx = 0
        EthRxIndicationCallout = NULL_PTR
        EthTxConfirmationCallout = NULL_PTR
        EthPtpRefClock = GETH
        EthCtrlOffloading:
          EthCtrlEnableOffloadChecksumIPv4 = false
          EthCtrlEnableOffloadChecksumICMP = false
          EthCtrlEnableOffloadChecksumTCP = false
          EthCtrlEnableOffloadChecksumUDP = false
          EthCtrlEnableOffloadChecksumTCPv6 = false
          EthCtrlEnableOffloadChecksumICMPv6 = false
          EthCtrlEnableOffloadChecksumIPv6HeaderRouting = false
          EthCtrlEnableOffloadChecksumIPv6HeaderDestinationOptions = false
          EthCtrlEnableOffloadChecksumIPv6HeaderHopByHopOptions = false
          EthCtrlEnableOffloadChecksumUDPv6 = false
        EthRuntimeEnvironment
          EthAutosarOs: EthRegBaseAddress=4026650624
        EthInterruptMapping
          EthInterruptServiceRoutine_Q0Tx (EthInterruptServiceRoutine): EthPreIsrUserFunction=NULL_PTR, EthPostIsrUserFunction=NULL_PTR
            EthIrqEventList: EthIrqHandlerPos=0, EthIrqHandlerRef=IrqHdlrQ0Tx
          IrqHdlrQ0Tx (EthIrqEvent): EthIrqEventDescription=Ethernet Tx interrupt queue 0
        EthCtrlPinRouting:
          Eth_GPCTL_ALT0 = ETH_ALT_2
          Eth_GPCTL_ALT{1..10} = ETH_ALT_0
        EthTx0BufConfig (EthTxBufConfig): EthCtrlTxBufLenByte=1522, EthTxBufTotal=12
        EthRxQ0BufConfig (EthRxBufConfig): EthRxSegmentNumber=10, EthRxSegmentSize=1522, EthRxMaxFrameSize=1522
