AUTOSAR XML (schema 00048)
package /ActiveEcuC
  module config Eth: implementation-config-variant=VARIANT-PRE-COMPILE, module-description=Eth_Impl
    EthGeneral:
      EthDevErrorDetect = false
      EthVersionInfoApi = false
      EthIndex = 0
      EthMaxCtrlsSupported = 1
      EthUpdatePhysAddrFilter = true
      EthEnableRxInterrupt = false
      EthEnableTxInterrupt = true
      EthOsIsrCategory = CATEGORY_2
      EthRuntimeMeasurementSupport = false
      EthEnableZeroCopyExtensions = false
      EthEnableHeaderAccessApi = false
      EthUsePeripheralAccessApi = false
      EthRuntimeEnvironment = ETH_AUTOSAR_OS
      EthSafeBswChecks = false
      EthMainFunctionPeriod = 0.02
      EthGetEtherStatsApi = false
      EthPreCtrlInitUserCallout = NULL_PTR
      EthPostCtrlInitUserCallout = NULL_PTR
      EthEnableExplicitBufferMapping = true
      EthGetAndResetMeasurementDataApi = true
    EthConfigSet
      EthCtrlConfig:
        EthCtrlEnableMii = true
        EthCtrlEnableRxInterrupt = false
        EthCtrlEnableTxInterrupt = true
        EthCtrlIdx = 0
        EthCtrlRxBufLenByte = 1522
        EthCtrlTxBufLenByte = 1522
        EthRxBufTotal = 2
        EthTxBufTotal = 4
        EthCtrlEnableMacWriteAccess = false
        EthCtrlEnableQoS = false
        EthCtrlEnablePtp = true
        EthCtrlEnableTrafficShaping = NO_TRAFFIC_SHAPING
        EthEnableAVBConformance = false
        EthCtrlMiiInterface = ETH_RMII_MODE
        EthCtrlResetLoopMaxCycles = 1000
        EthCtrlMiiLoopMaxCycles = 1000
        EthCtrlLoopMaxCycles = 1000
        EthEthSwtMgmtHdrLen = 0
        EthCtrlEnableOsfMode = true
        EthCtrlCsrClkRange = CLK_250_300_MHZ
        EthCtrlPrtSpdSel = PS_100_MBITS
        EthCtrlSkewTx = 0
        EthCtrlSkewRx = 0
        EthCtrlEnableVlanIDBasedFramesQueuing = false
        EthCtrlPhysAddr = 3C:02:17:02:02:17
        EthCtrlEnablePpsEventOnTimeApi = true
        EthPtpRefClock = McuClockReferencePoint_GETH
        EthRxBufConfig: EthRxSegmentNumber=2, EthRxSegmentSize=1522, EthRxMaxFrameSize=1522
        EthTxBufConfig: EthCtrlTxBufLenByte=1522, EthTxBufTotal=4
        EthCtrlOffloading:
          EthCtrlEnableOffloadChecksumIPv4 = true
          EthCtrlEnableOffloadChecksumICMP = true
          EthCtrlEnableOffloadChecksumTCP = true
          EthCtrlEnableOffloadChecksumUDP = true
          EthCtrlEnableOffloadChecksumTCPv6 = true
          EthCtrlEnableOffloadChecksumICMPv6 = true
          EthCtrlEnableOffloadChecksumIPv6HeaderRouting = false
          EthCtrlEnableOffloadChecksumIPv6HeaderDestinationOptions = true
          EthCtrlEnableOffloadChecksumIPv6HeaderHopByHopOptions = true
          EthCtrlEnableOffloadChecksumUDPv6 = true
        EthRuntimeEnvironment
          EthAutosarOs: EthRegBaseAddress=4026650624
        EthInterruptMapping
          IrqHdlrQ0Tx (EthIrqEvent): EthIrqEventDescription=Ethernet Tx interrupt queue 0
          EthInterruptServiceRoutine: EthPreIsrUserFunction=NULL_PTR, EthPostIsrUserFunction=NULL_PTR
            EthIrqEventList: EthIrqHandlerPos=0, EthIrqHandlerRef=IrqHdlrQ0Tx
        EthCtrlPinRouting:
          Eth_GPCTL_ALT0 = ETH_ALT_3
          Eth_GPCTL_ALT1 = ETH_ALT_2
          Eth_GPCTL_ALT{2..10} = ETH_ALT_0
