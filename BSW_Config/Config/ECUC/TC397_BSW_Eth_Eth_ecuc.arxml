AUTOSAR XML (schema 00048)
package /ActiveEcuC
  module config Eth: implementation-config-variant=VARIANT-PRE-COMPILE, module-description=Eth_Impl
    EthGeneral:
      EthDevErrorDetect = false
      EthVersionInfoApi = false
      EthIndex = 0
      EthMaxCtrlsSupported = 1
      EthUpdatePhysAddrFilter = true
      EthEnableRxInterrupt = true
      EthEnableTxInterrupt = true
      EthOsIsrCategory = CATEGORY_2
      EthRuntimeMeasurementSupport = false
      EthEnableZeroCopyExtensions = false
      EthEnableHeaderAccessApi = false
      EthUsePeripheralAccessApi = false
      EthRuntimeEnvironment = ETH_AUTOSAR_OS
      EthSafeBswChecks = false
      EthMainFunctionPeriod = 0.02
      EthGetEtherStatsApi = false
      EthPreCtrlInitUserCallout = NULL_PTR
      EthPostCtrlInitUserCallout = NULL_PTR
      EthEnableExplicitBufferMapping = true
      EthGetAndResetMeasurementDataApi = true
    EthConfigSet
      EthCtrlConfig0 (EthCtrlConfig):
        EthCtrlEnableMii = true
        EthCtrlEnableRxInterrupt = true
        EthCtrlEnableTxInterrupt = true
        EthCtrlIdx = 0
        EthCtrlRxBufLenByte = 1522
        EthCtrlTxBufLenByte = 1522
        EthRxBufTotal = 2
        EthTxBufTotal = 2
        EthCtrlEnableMacWriteAccess = false
        EthCtrlEnableQoS = false
        EthCtrlEnablePtp = false
        EthCtrlEnableTrafficShaping = NO_TRAFFIC_SHAPING
        EthEnableAVBConformance = false
        EthCtrlMiiInterface = ETH_RMII_MODE
        EthCtrlResetLoopMaxCycles = 1000
        EthCtrlMiiLoopMaxCycles = 1000
        EthCtrlLoopMaxCycles = 1000
        EthEthSwtMgmtHdrLen = 0
        EthCtrlEnableOsfMode = true
        EthCtrlCsrClkRange = CLK_20_35_MHZ
        EthCtrlPrtSpdSel = PS_100_MBITS
        EthCtrlSkewTx = 0
        EthCtrlSkewRx = 0
        EthCtrlEnableVlanIDBasedFramesQueuing = false
        EthCtrlPhysAddr = 3C:CE:15:02:02:17
        EthCtrlEnablePpsEventOnTimeApi = true
        EthRxBufConfig: EthRxSegmentNumber=2, EthRxSegmentSize=1522, EthRxMaxFrameSize=1522
        EthTxBufConfig: EthCtrlTxBufLenByte=1522, EthTxBufTotal=2
        EthCtrlOffloading:
          EthCtrlEnableOffloadChecksumIPv4 = false
          EthCtrlEnableOffloadChecksumICMP = false
          EthCtrlEnableOffloadChecksumTCP = false
          EthCtrlEnableOffloadChecksumUDP = false
          EthCtrlEnableOffloadChecksumTCPv6 = false
          EthCtrlEnableOffloadChecksumICMPv6 = false
          EthCtrlEnableOffloadChecksumIPv6HeaderRouting = false
          EthCtrlEnableOffloadChecksumIPv6HeaderDestinationOptions = false
          EthCtrlEnableOffloadChecksumIPv6HeaderHopByHopOptions = false
          EthCtrlEnableOffloadChecksumUDPv6 = false
        EthRuntimeEnvironment
          EthAutosarOs: EthRegBaseAddress=0
        EthInterruptMapping
          IrqHdlrQ0Rx (EthIrqEvent): EthIrqEventDescription=Ethernet Rx interrupt queue 0
          IrqHdlrQ0Tx (EthIrqEvent): EthIrqEventDescription=Ethernet Tx interrupt queue 0
          EthInterruptServiceRoutine: EthPreIsrUserFunction=NULL_PTR, EthPostIsrUserFunction=NULL_PTR
            EthIrqEventList: EthIrqHandlerPos=0, EthIrqHandlerRef=IrqHdlrQ0Tx
          EthInterruptServiceRoutine_001 (EthInterruptServiceRoutine): EthPreIsrUserFunction=NULL_PTR, EthPostIsrUserFunction=NULL_PTR
            EthIrqEventList: EthIrqHandlerPos=0, EthIrqHandlerRef=IrqHdlrQ0Rx
        EthCtrlPinRouting:
          Eth_GPCTL_ALT0 = ETH_ALT_3
          Eth_GPCTL_ALT1 = ETH_ALT_2
          Eth_GPCTL_ALT{2..10} = ETH_ALT_0
