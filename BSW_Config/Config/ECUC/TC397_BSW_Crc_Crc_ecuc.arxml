AUTOSAR XML (schema 00048)
package /Crc
  module config Crc: implementation-config-variant=VARIANT-PRE-COMPILE, module-description=Crc_Impl
    CrcGeneral:
      CrcVersionInfoApi = false
      CrcSafetyEnable = true
      CrcRuntimeApiMode = CRC_MCAL_SUPERVISOR
      Crc8ReturnErrorValue = 0
      Crc8H2FReturnErrorValue = 0
      Crc16ReturnErrorValue = 0
      Crc32ReturnErrorValue = 0
      Crc32P4ReturnErrorValue = 0
    CrcPublishedInformation: CrcInitialValue16=65535, CrcInitialValue8=255, CrcInitialValue8H2F=255, CrcInitialValue32=4294967295, CrcInitialValue32P4=4294967295
    CommonPublishedInformation:
      ArMajorVersion = 4
      ArMinorVersion = 2
      ArPatchVersion = 2
      SwMajorVersion = 10
      SwMinorVersion = 40
      SwPatchVersion = 0
      ModuleId = 201
      VendorId = 17
      Release = _TRICORE_TC397
