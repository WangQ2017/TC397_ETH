AUTOSAR XML (schema 00048)
package /ActiveEcuC
  module config SoAd: implementation-config-variant=VARIANT-PRE-COMPILE, module-description=SoAd_Impl
    SoAdGeneral:
      SoAdDevErrorDetect = true
      SoAdVersionInfoApi = false
      SoAdIPv6AddressEnabled = false
      SoAdMainFunctionPeriod = 0.005
      SoAdRoutingGroupMax = 10
      SoAdSoConMax = 14
      SoAdShutdownFinishedWaitTime = 2
      SoAdTcpTlsEnabled = false
      SoAdTxDynamicLengthEnabled = false
      SoAdMainFunctionSplitEnabled = false
      SoAdSafeBswChecks = false
      SoAdGetAndResetMeasurementDataApi = false
      SoAdGeneration:
        SoAdBoolDataInArrayOfStructStrategy = BOOLEAN
        SoAdOutOfBoundsWriteProtectionStrategy = NONE
        SoAdOutOfBoundsWriteSanitizer = false
        SoAdOutOfBoundsReadSanitizer = false
        SoAdReduceConstantData2Define = false
        SoAdDeduplicateIndirectedData = false
        SoAdDataDeduplicationStrategy = NONE
        SoAdReduceBoolDataByNegationThreshold = 0
        SoAdReduceBoolDataByNumericalComparisonThreshold = 0
        SoAdReduceBoolDataByNumericalRelationThreshold = 0
        SoAdReduceBoolDataByNumericalOperandStrategy = NONE
        SoAdReduceNumericalDataByOffsetThreshold = 0
        SoAdReduceNumericalDataByArraySubtractionThreshold = 0
        SoAdReduceDataByStreaming = false
        SoAdShortSymbols = false
        SoAdInterfacesForDeactivatedData = false
        SoAdReferringKeysInComments = false
      SoAdSocketApi: SoAdSocketApiType=AUTOSAR
    SoAdConfig
      SCG_UDP_fixed_10_10_0_33_30000 (SoAdSocketConnectionGroup):
        SoAdPduHeaderEnable = false
        SoAdResourceManagementEnable = false
        SoAdSocketAutomaticSoConSetup = true
        SoAdSocketIpAddrAssignmentChgNotification = false
        SoAdSocketLocalPort = 30000
        SoAdSocketMsgAcceptanceFilterEnabled = true
        SoAdSocketSoConModeChgNotification = false
        SoAdBestMatchWithSockRouteEnabled = false
        SoAdBestMatchWithPduHeaderEnabled = false
        SoAdSocketAutomaticSoConSetupKeepOnline = false
        SoAdSocketLocalAddressRef = TcpIpLocalAddr_NE_Fixed_10_10_0_33
        SC_UDP_Multicast_Fixed_239_10_0_1_30000_Remote (SoAdSocketConnection): SoAdSocketId=13, SoAdSocketGetReceivedRemoteAddressEnabled=false, SoAdVerifyRxPduEnable=false
          SoAdSocketRemoteAddress: SoAdSocketRemoteIpAddress=239.10.0.1, SoAdSocketRemotePort=30000, SoAdSocketRemoteIpAddressNotSet=false, SoAdSocketRemotePortNotSet=false
        SoAdSocketProtocol
          SoAdSocketUdp:
            SoAdSocketUdpListenOnly = false
            SoAdSocketUdpStrictHeaderLenCheckEnabled = false
            SoAdSocketUdpAddressResolutionRetryEnabled = true
            SoAdSocketUdpImmediateIfTxConfirmation = true
            SoAdSocketUdpAddressResolutionRetryQueueLimit = 2
            SoAdSocketUdpImmediateIfTxConfirmationListSize = 3
      SoAdPduRoute_NM_Tx (SoAdPduRoute): SoAdTxPduId=3, SoAdTxUpperLayerType=IF, SoAdTxIfTriggerTransmit=false, SoAdTxIfOptimized=false, SoAdTxPduRef=UdpNmTxPdu
        SoAdPduRouteDest: SoAdTxSocketConnOrSocketConnBundleRef=SC_UDP_Multicast_Fixed_239_10_0_1_30000_Remote
      SoAdSocketRoute_NM_Rx (SoAdSocketRoute): SoAdRxPduHeaderId=0, SoAdRxSocketConnOrSocketConnBundleRef=SCG_UDP_Multicast_Rx_Fixed_239_10_1_30000
        SoAdSocketRouteDest: SoAdRxUpperLayerType=IF, SoAdRxPduId=3, SoAdRxPduRef=UdpNmRxPdu
      SCG_UDP_Multicast_Rx_Fixed_239_10_1_30000 (SoAdSocketConnectionGroup):
        SoAdPduHeaderEnable = true
        SoAdResourceManagementEnable = false
        SoAdSocketAutomaticSoConSetup = true
        SoAdSocketIpAddrAssignmentChgNotification = false
        SoAdSocketLocalPort = 30000
        SoAdSocketMsgAcceptanceFilterEnabled = true
        SoAdSocketSoConModeChgNotification = false
        SoAdBestMatchWithSockRouteEnabled = false
        SoAdBestMatchWithPduHeaderEnabled = false
        SoAdSocketAutomaticSoConSetupKeepOnline = false
        SoAdSocketLocalAddressRef = TcpIpLocalAddr_NE_Multicast_Rx_fixed_239_10_0_1
        SC_UDP_ANY_DynPort_Remote (SoAdSocketConnection): SoAdSocketId=12, SoAdSocketGetReceivedRemoteAddressEnabled=false, SoAdVerifyRxPduEnable=false
          SoAdSocketRemoteAddress: SoAdSocketRemoteIpAddress=, SoAdSocketRemotePort=0, SoAdSocketRemoteIpAddressNotSet=false, SoAdSocketRemotePortNotSet=false
        SoAdSocketProtocol
          SoAdSocketUdp:
            SoAdSocketUdpListenOnly = false
            SoAdSocketUdpStrictHeaderLenCheckEnabled = false
            SoAdSocketUdpAddressResolutionRetryEnabled = true
            SoAdSocketUdpImmediateIfTxConfirmation = false
            SoAdSocketUdpAddressResolutionRetryQueueLimit = 2
      SCG_SD_UDP_fixed_10_23_0_33_40000 (SoAdSocketConnectionGroup):
        SoAdPduHeaderEnable = true
        SoAdResourceManagementEnable = false
        SoAdSocketAutomaticSoConSetup = false
        SoAdSocketIpAddrAssignmentChgNotification = true
        SoAdSocketLocalPort = 40000
        SoAdSocketMsgAcceptanceFilterEnabled = true
        SoAdSocketSoConModeChgNotification = true
        SoAdBestMatchWithSockRouteEnabled = false
        SoAdBestMatchWithPduHeaderEnabled = false
        SoAdSocketAutomaticSoConSetupKeepOnline = false
        SoAdSocketLocalAddressRef = TcpIpLocalAddr_NE_Fixed_10_23_0_33
        SC_UDP_Multicast_Fixed_239_23_0_1_40000_Remote (SoAdSocketConnection): SoAdSocketId=11, SoAdSocketGetReceivedRemoteAddressEnabled=false, SoAdVerifyRxPduEnable=false, SoAdAdditionalChgNotificationRef=Sd
          SoAdSocketRemoteAddress: SoAdSocketRemoteIpAddress=239.23.0.1, SoAdSocketRemotePort=40000, SoAdSocketRemoteIpAddressNotSet=false, SoAdSocketRemotePortNotSet=false
        SoAdSocketProtocol
          SoAdSocketUdp:
            SoAdSocketUdpListenOnly = false
            SoAdSocketUdpStrictHeaderLenCheckEnabled = false
            SoAdSocketUdpAddressResolutionRetryEnabled = true
            SoAdSocketUdpImmediateIfTxConfirmation = false
            SoAdSocketUdpAddressResolutionRetryQueueLimit = 2
            SoAdSocketUdpTriggerTimeout = 0.005
            SoAdSocketUdpAliveSupervisionTimeout = 1
            SoAdSocketnPduUdpTxBufferMin = 1472
        SC_UDP_Fixed_10_23_0_33_40000_0 (SoAdSocketConnection): SoAdSocketId=9, SoAdSocketGetReceivedRemoteAddressEnabled=false, SoAdVerifyRxPduEnable=false, SoAdAdditionalChgNotificationRef=Sd
          SoAdSocketRemoteAddress: SoAdSocketRemoteIpAddress=, SoAdSocketRemotePort=0, SoAdSocketRemoteIpAddressNotSet=false, SoAdSocketRemotePortNotSet=false
        SC_UDP_Fixed_10_23_0_33_40000_1 (SoAdSocketConnection): SoAdSocketId=10, SoAdSocketGetReceivedRemoteAddressEnabled=false, SoAdVerifyRxPduEnable=false, SoAdAdditionalChgNotificationRef=Sd
          SoAdSocketRemoteAddress: SoAdSocketRemoteIpAddress=, SoAdSocketRemotePort=0, SoAdSocketRemoteIpAddressNotSet=false, SoAdSocketRemotePortNotSet=false
      SoAdSocketRoute_SD_UDP_fixed_10_23_0_33_40000_0 (SoAdSocketRoute): SoAdRxPduHeaderId=3284893697, SoAdRxSocketConnOrSocketConnBundleRef=SCG_SD_UDP_fixed_10_23_0_33_40000
        SoAdSocketRouteDest_VechicleSpeed (SoAdSocketRouteDest):
          SoAdRxUpperLayerType = IF
          SoAdRxPduId = 9
          SoAdRxPduRef = SomeIpVechicleSpeedRxPdu_SoAd
          SoAdRxRoutingGroupRef = SoAdRoutingGroup_VechicleSpeed_AM
          SoAdRxRoutingGroupRef = SoAdRoutingGroup_VechicleSpeed_AC
      SCG_SD_Ctrl_UDP_fixed_10_23_0_33_30490 (SoAdSocketConnectionGroup):
        SoAdPduHeaderEnable = true
        SoAdResourceManagementEnable = false
        SoAdSocketAutomaticSoConSetup = false
        SoAdSocketIpAddrAssignmentChgNotification = true
        SoAdSocketLocalPort = 30490
        SoAdSocketMsgAcceptanceFilterEnabled = false
        SoAdSocketSoConModeChgNotification = true
        SoAdBestMatchWithSockRouteEnabled = false
        SoAdBestMatchWithPduHeaderEnabled = false
        SoAdSocketAutomaticSoConSetupKeepOnline = false
        SoAdSocketLocalAddressRef = TcpIpLocalAddr_NE_Fixed_10_23_0_33
        SC_SD_CTRL_UDP_Any_DynamicPort_Remote (SoAdSocketConnection): SoAdSocketId=5, SoAdSocketGetReceivedRemoteAddressEnabled=true, SoAdVerifyRxPduEnable=false
          SoAdSocketRemoteAddress: SoAdSocketRemoteIpAddress=, SoAdSocketRemotePort=0, SoAdSocketRemoteIpAddressNotSet=false, SoAdSocketRemotePortNotSet=false
        SoAdSocketProtocol
          SoAdSocketUdp:
            SoAdSocketUdpListenOnly = false
            SoAdSocketUdpStrictHeaderLenCheckEnabled = false
            SoAdSocketUdpAddressResolutionRetryEnabled = true
            SoAdSocketUdpImmediateIfTxConfirmation = false
            SoAdSocketUdpAddressResolutionRetryQueueLimit = 2
      SoAdPduRoute_SD_Ctrl_Tx (SoAdPduRoute): SoAdTxPduId=4, SoAdTxUpperLayerType=IF, SoAdTxIfOptimized=false, SoAdTxIfTriggerTransmit=false, SoAdTxPduRef=SdCtrlTxPdu
        SoAdPduRouteDest: SoAdTxPduHeaderId=4294934784, SoAdTxSocketConnOrSocketConnBundleRef=SC_SD_CTRL_UDP_Any_DynamicPort_Remote
      SoAdSocketRoute_SD_Ctrl_Rx (SoAdSocketRoute): SoAdRxPduHeaderId=4294934784, SoAdRxSocketConnOrSocketConnBundleRef=SC_SD_CTRL_UDP_Any_DynamicPort_Remote
        SoAdSocketRouteDest_002 (SoAdSocketRouteDest): SoAdRxUpperLayerType=IF, SoAdRxPduId=4, SoAdRxPduRef=SdCtrlRxPdu
      SoAdRoutingGroup_VechicleSpeed_AM (SoAdRoutingGroup): SoAdRoutingGroupId=9, SoAdRoutingGroupIsEnabledAtInit=false, SoAdRoutingGroupTxTriggerable=false
      SoAdRoutingGroup_VechicleSpeed_AC (SoAdRoutingGroup): SoAdRoutingGroupId=8, SoAdRoutingGroupIsEnabledAtInit=false, SoAdRoutingGroupTxTriggerable=false
      SoAdSocketRoute_SD_Ctrl_Rx_Multicast (SoAdSocketRoute): SoAdRxPduHeaderId=4294934784, SoAdRxSocketConnOrSocketConnBundleRef=SC_SD_CTRL_UDP_Any_DynamicPort_Remote_001
        SoAdSocketRouteDest_004 (SoAdSocketRouteDest): SoAdRxUpperLayerType=IF, SoAdRxPduId=5, SoAdRxPduRef=SdCtrlMulticastRxPdu
      SCG_SD_Ctrl_Multicast_Rx_fixed_239_23_0_2_30490 (SoAdSocketConnectionGroup):
        SoAdPduHeaderEnable = true
        SoAdResourceManagementEnable = false
        SoAdSocketAutomaticSoConSetup = false
        SoAdSocketIpAddrAssignmentChgNotification = false
        SoAdSocketLocalPort = 30490
        SoAdSocketMsgAcceptanceFilterEnabled = false
        SoAdSocketSoConModeChgNotification = true
        SoAdBestMatchWithSockRouteEnabled = false
        SoAdBestMatchWithPduHeaderEnabled = false
        SoAdSocketAutomaticSoConSetupKeepOnline = false
        SoAdSocketLocalAddressRef = TcpIpLocalAddr_NE_Multicast_Rx_fixed_239_23_0_2
        SC_SD_CTRL_UDP_Any_DynamicPort_Remote_001 (SoAdSocketConnection): SoAdSocketId=4, SoAdSocketGetReceivedRemoteAddressEnabled=true, SoAdVerifyRxPduEnable=false
          SoAdSocketRemoteAddress: SoAdSocketRemoteIpAddress=, SoAdSocketRemotePort=0, SoAdSocketRemoteIpAddressNotSet=false, SoAdSocketRemotePortNotSet=false
        SoAdSocketProtocol
          SoAdSocketUdp:
            SoAdSocketUdpListenOnly = false
            SoAdSocketUdpStrictHeaderLenCheckEnabled = false
            SoAdSocketUdpAddressResolutionRetryEnabled = true
            SoAdSocketUdpImmediateIfTxConfirmation = false
            SoAdSocketUdpAddressResolutionRetryQueueLimit = 1
      SCG_SD_UDP_Multicast_Rx_Any_40000 (SoAdSocketConnectionGroup):
        SoAdPduHeaderEnable = false
        SoAdResourceManagementEnable = false
        SoAdSocketAutomaticSoConSetup = false
        SoAdSocketIpAddrAssignmentChgNotification = false
        SoAdSocketLocalPort = 40000
        SoAdSocketMsgAcceptanceFilterEnabled = true
        SoAdSocketSoConModeChgNotification = false
        SoAdBestMatchWithSockRouteEnabled = false
        SoAdBestMatchWithPduHeaderEnabled = false
        SoAdSocketAutomaticSoConSetupKeepOnline = false
        SoAdSocketLocalAddressRef = TcpIpLocalAddr_Multicast_Any_vlan23
        SC_UDP_Multicast_Rx_Any_40000 (SoAdSocketConnection): SoAdSocketId=8, SoAdSocketGetReceivedRemoteAddressEnabled=false, SoAdVerifyRxPduEnable=false
          SoAdSocketRemoteAddress: SoAdSocketRemoteIpAddress=, SoAdSocketRemotePort=0, SoAdSocketRemoteIpAddressNotSet=false, SoAdSocketRemotePortNotSet=false
        SoAdSocketProtocol
          SoAdSocketUdp:
            SoAdSocketUdpListenOnly = true
            SoAdSocketUdpStrictHeaderLenCheckEnabled = false
            SoAdSocketUdpAddressResolutionRetryEnabled = true
            SoAdSocketUdpImmediateIfTxConfirmation = false
            SoAdSocketUdpAddressResolutionRetryQueueLimit = 1
            SoAdSocketUdpAliveSupervisionTimeout = 1
      6 x SoAdRoutingGroup, all with SoAdRoutingGroupIsEnabledAtInit=false, SoAdRoutingGroupTxTriggerable=false:
        SoAdRoutingGroup_FaultInfo_AC: SoAdRoutingGroupId=2
        SoAdRoutingGroup_FaultInfo_AM: SoAdRoutingGroupId=3
        SoAdRoutingGroup_SenState_AC: SoAdRoutingGroupId=4
        SoAdRoutingGroup_SenState_AM: SoAdRoutingGroupId=5
        SoAdRoutingGroup_VechicleInfo_AC: SoAdRoutingGroupId=6
        SoAdRoutingGroup_VechicleInfo_AM: SoAdRoutingGroupId=7
      SoAdPduRoute_SD_UDP_FaultInfo_Tx (SoAdPduRoute): SoAdTxPduId=2, SoAdTxUpperLayerType=IF, SoAdTxIfOptimized=false, SoAdTxIfTriggerTransmit=false, SoAdTxPduRef=SomeIpFalutInfoTxPdu_SoAd
        SoAdPduRouteDest_FaultInfo_Tx (SoAdPduRouteDest):
          SoAdTxPduHeaderId = 3284238337
          SoAdTxUdpTriggerMode = TRIGGER_NEVER
          SoAdTxUdpTriggerTimeout = 0.01
          SoAdTxSocketConnOrSocketConnBundleRef = SCG_SD_UDP_fixed_10_23_0_33_40000
          SoAdTxRoutingGroupRef = SoAdRoutingGroup_FaultInfo_AM
          SoAdTxRoutingGroupRef = SoAdRoutingGroup_FaultInfo_AC
      SoAdPduRoute_SD_UDP_SenState_Tx (SoAdPduRoute): SoAdTxPduId=5, SoAdTxUpperLayerType=IF, SoAdTxIfOptimized=false, SoAdTxIfTriggerTransmit=false, SoAdTxPduRef=SomeIpSenStateTxPdu_SoAd
        SoAdPduRouteDest_SenState_Tx (SoAdPduRouteDest):
          SoAdTxPduHeaderId = 3284238337
          SoAdTxUdpTriggerMode = TRIGGER_NEVER
          SoAdTxUdpTriggerTimeout = 0.01
          SoAdTxSocketConnOrSocketConnBundleRef = SCG_SD_UDP_fixed_10_23_0_33_40000
          SoAdTxRoutingGroupRef = SoAdRoutingGroup_SenState_AM
          SoAdTxRoutingGroupRef = SoAdRoutingGroup_SenState_AC
      3 x SoAdSocketRoute:
        SoAdSocketRoute_SD_UDP_fixed_10_23_0_33_40000_1: SoAdRxPduHeaderId=3285024769, SoAdRxSocketConnOrSocketConnBundleRef=SCG_SD_UDP_fixed_10_23_0_33_40000
          SoAdSocketRouteDest_VechicleInfo (SoAdSocketRouteDest):
            SoAdRxUpperLayerType = IF
            SoAdRxPduId = 10
            SoAdRxPduRef = SomeIpVechicleInfoRxPdu_SoAd
            SoAdRxRoutingGroupRef = SoAdRoutingGroup_VechicleInfo_AM
            SoAdRxRoutingGroupRef = SoAdRoutingGroup_VechicleInfo_AC
        SoAdSocketRoute_SD_UDP_Multicast_Rx_Any_40000_0: SoAdRxSocketConnOrSocketConnBundleRef=SCG_SD_UDP_Multicast_Rx_Any_40000
          SoAdSocketRouteDest_VechicleSpeed_Multi (SoAdSocketRouteDest): SoAdRxUpperLayerType=IF, SoAdRxPduId=7, SoAdRxPduRef=SomeIpVechicleSpeedRxPdu_SoAd, SoAdRxRoutingGroupRef=SoAdRoutingGroup_VechicleSpeed_AM
        SoAdSocketRoute_SD_UDP_Multicast_Rx_Any_40000_1: SoAdRxSocketConnOrSocketConnBundleRef=SCG_SD_UDP_Multicast_Rx_Any_40000
          SoAdSocketRouteDest_VechicleInfo_multi (SoAdSocketRouteDest): SoAdRxUpperLayerType=IF, SoAdRxPduId=8, SoAdRxPduRef=SomeIpVechicleInfoRxPdu_SoAd, SoAdRxRoutingGroupRef=SoAdRoutingGroup_VechicleInfo_AM
      SCG_SD_TCP_TX_fixed_10_23_0_33_47843 (SoAdSocketConnectionGroup):
        SoAdPduHeaderEnable = true
        SoAdResourceManagementEnable = false
        SoAdSocketAutomaticSoConSetup = false
        SoAdSocketIpAddrAssignmentChgNotification = true
        SoAdSocketLocalPort = 47843
        SoAdSocketMsgAcceptanceFilterEnabled = true
        SoAdSocketSoConModeChgNotification = true
        SoAdBestMatchWithSockRouteEnabled = false
        SoAdBestMatchWithPduHeaderEnabled = false
        SoAdSocketAutomaticSoConSetupKeepOnline = false
        SoAdSocketTpRxBufferMin = 512
        SoAdSocketLocalAddressRef = TcpIpLocalAddr_NE_Fixed_10_23_0_33
        SC_TCP_TX_fixed_10_23_0_33_47843 (SoAdSocketConnection):
          SoAdSocketId = 7
          SoAdSocketGetReceivedRemoteAddressEnabled = false
          SoAdVerifyRxPduEnable = false
          SoAdTcpTxQueueSize = 1
          SoAdAdditionalChgNotificationRef = Sd
          SoAdSocketRemoteAddress: SoAdSocketRemoteIpAddress=, SoAdSocketRemotePort=0, SoAdSocketRemoteIpAddressNotSet=false, SoAdSocketRemotePortNotSet=false
        SoAdSocketProtocol
          SoAdSocketTcp: SoAdSocketTcpImmediateTpTxConfirmation=false, SoAdSocketTcpInitiate=false, SoAdSocketTcpKeepAlive=false, SoAdSocketTcpTxBufferMin=512
      SCG_SD_TCP_RX_fixed_10_23_0_33_47842 (SoAdSocketConnectionGroup):
        SoAdPduHeaderEnable = true
        SoAdResourceManagementEnable = false
        SoAdSocketAutomaticSoConSetup = false
        SoAdSocketIpAddrAssignmentChgNotification = true
        SoAdSocketLocalPort = 47842
        SoAdSocketMsgAcceptanceFilterEnabled = true
        SoAdSocketSoConModeChgNotification = true
        SoAdBestMatchWithSockRouteEnabled = false
        SoAdBestMatchWithPduHeaderEnabled = false
        SoAdSocketAutomaticSoConSetupKeepOnline = false
        SoAdSocketTpRxBufferMin = 512
        SoAdSocketLocalAddressRef = TcpIpLocalAddr_NE_Fixed_10_23_0_33
        SC_TCP_TX_fixed_10_23_0_33_47842 (SoAdSocketConnection):
          SoAdSocketId = 6
          SoAdSocketGetReceivedRemoteAddressEnabled = false
          SoAdVerifyRxPduEnable = false
          SoAdTcpTxQueueSize = 1
          SoAdAdditionalChgNotificationRef = Sd
          SoAdSocketRemoteAddress: SoAdSocketRemoteIpAddress=, SoAdSocketRemotePort=0, SoAdSocketRemoteIpAddressNotSet=false, SoAdSocketRemotePortNotSet=false
        SoAdSocketProtocol
          SoAdSocketTcp: SoAdSocketTcpImmediateTpTxConfirmation=false, SoAdSocketTcpInitiate=true, SoAdSocketTcpKeepAlive=false, SoAdSocketTcpTxBufferMin=512
      SoAdPduRoute_SD_TCP_EcuStateTx (SoAdPduRoute): SoAdTxPduId=1, SoAdTxUpperLayerType=IF, SoAdTxIfTriggerTransmit=false, SoAdTxIfOptimized=false, SoAdTxPduRef=SomeIpEcuStateTxPdu_SoAd
        SoAdPduRouteDest_EcuStateTx (SoAdPduRouteDest):
          SoAdTxPduHeaderId = 3284303873
          SoAdTxSocketConnOrSocketConnBundleRef = SCG_SD_TCP_TX_fixed_10_23_0_33_47843
          SoAdTxRoutingGroupRef = SoAdRoutingGroup_EcuState_AC
      SoAdSocketRoute_SD_TCP_RX_fixed_10_23_0_33_47842 (SoAdSocketRoute): SoAdRxPduHeaderId=3284959233, SoAdRxSocketConnOrSocketConnBundleRef=SCG_SD_TCP_RX_fixed_10_23_0_33_47842
        SoAdSocketRouteDest_VechicleStatus (SoAdSocketRouteDest): SoAdRxUpperLayerType=IF, SoAdRxPduId=6, SoAdRxPduRef=SomeIpVechicleStatusRxPdu_SoAd, SoAdRxRoutingGroupRef=SoAdRoutingGroup_VechicleStatus_AC
      SoAdRoutingGroup_EcuState_AC (SoAdRoutingGroup): SoAdRoutingGroupId=1, SoAdRoutingGroupIsEnabledAtInit=false, SoAdRoutingGroupTxTriggerable=false
      SoAdRoutingGroup_VechicleStatus_AC (SoAdRoutingGroup): SoAdRoutingGroupId=0, SoAdRoutingGroupIsEnabledAtInit=false, SoAdRoutingGroupTxTriggerable=false
      4 x SoAdPduRoute:
        SoAdPduRoute_DOIP_TCP_DATA0_Tx: SoAdTxPduId=6, SoAdTxUpperLayerType=TP, SoAdTxTpOptimized=false, SoAdTxPduRef=DoIP_TCP_DATA0_DoIP2SoAd_TxPdu
          SoAdPduRouteDest: SoAdTxSocketConnOrSocketConnBundleRef=SoAdSocketConnection_TCP_DhcpV4_Fixed_169_254_1_33_13400_Remote_Any_0
        SoAdPduRoute_DOIP_TCP_DATA1_Tx: SoAdTxPduId=7, SoAdTxUpperLayerType=TP, SoAdTxTpOptimized=false, SoAdTxPduRef=DoIP_TCP_DATA1_DoIP2SoAd_TxPdu
          SoAdPduRouteDest: SoAdTxSocketConnOrSocketConnBundleRef=SoAdSocketConnection_TCP_DhcpV4_Fixed_169_254_1_33_13400_Remote_Any_1
        SoAdPduRoute_DOIP_UDP_TEST_EQUIPMENT_REQUEST_Tx: SoAdTxPduId=8, SoAdTxUpperLayerType=IF, SoAdTxIfOptimized=false, SoAdTxIfTriggerTransmit=false, SoAdTxPduRef=DoIP_UDP_TEST_EQUIPMENT_REQUEST_DoIP2SoAd_TxPdu
          SoAdPduRouteDest: SoAdTxSocketConnOrSocketConnBundleRef=SoAdSocketConnection_DOIP_UDP_ANY_Remote
        SoAdPduRoute_DOIP_UDP_DISCOVERY_Tx: SoAdTxPduId=0, SoAdTxUpperLayerType=IF, SoAdTxIfOptimized=false, SoAdTxIfTriggerTransmit=false, SoAdTxPduRef=DoIP_UDP_DISCOVERY_DoIP2SoAd_TxPdu
          SoAdPduRouteDest: SoAdTxSocketConnOrSocketConnBundleRef=SoAdSocketConnection_DOIP_Broad_UDP_fixed_255_255_255_255_13400_Remote
      SCG_DOIP_TCP_DhcpV4_Fixed_169_254_1_33_13400 (SoAdSocketConnectionGroup):
        SoAdPduHeaderEnable = false
        SoAdResourceManagementEnable = false
        SoAdSocketAutomaticSoConSetup = false
        SoAdSocketIpAddrAssignmentChgNotification = true
        SoAdSocketLocalPort = 13400
        SoAdSocketMsgAcceptanceFilterEnabled = true
        SoAdSocketSoConModeChgNotification = true
        SoAdBestMatchWithSockRouteEnabled = false
        SoAdBestMatchWithPduHeaderEnabled = false
        SoAdSocketAutomaticSoConSetupKeepOnline = false
        SoAdSocketTpRxBufferMin = 512
        SoAdSocketLocalAddressRef = TcpIpLocalAddr_NE_DhcpV4_Fixed_169_254_1_33
        SoAdSocketConnection_TCP_DhcpV4_Fixed_169_254_1_33_13400_Remote_Any_0 (SoAdSocketConnection): SoAdSocketId=0, SoAdSocketGetReceivedRemoteAddressEnabled=false, SoAdVerifyRxPduEnable=false, SoAdTcpTxQueueSize=2
          SoAdSocketRemoteAddress: SoAdSocketRemoteIpAddress=, SoAdSocketRemotePort=0, SoAdSocketRemoteIpAddressNotSet=false, SoAdSocketRemotePortNotSet=false
        SoAdSocketProtocol
          SoAdSocketTcp:
            SoAdSocketTcpImmediateTpTxConfirmation = false
            SoAdSocketTcpInitiate = false
            SoAdSocketTcpKeepAlive = false
            SoAdSocketTcpTxBufferMin = 512
            SoAdSocketTcpNoDelay = true
        SoAdSocketConnection_TCP_DhcpV4_Fixed_169_254_1_33_13400_Remote_Any_1 (SoAdSocketConnection): SoAdSocketId=1, SoAdSocketGetReceivedRemoteAddressEnabled=false, SoAdVerifyRxPduEnable=false, SoAdTcpTxQueueSize=2
          SoAdSocketRemoteAddress: SoAdSocketRemoteIpAddress=, SoAdSocketRemotePort=0, SoAdSocketRemoteIpAddressNotSet=false, SoAdSocketRemotePortNotSet=false
      SoAdSocketRoute_DOIP_TCP_DATA0_Rx (SoAdSocketRoute): SoAdRxSocketConnOrSocketConnBundleRef=SoAdSocketConnection_TCP_DhcpV4_Fixed_169_254_1_33_13400_Remote_Any_0
        SoAdSocketRouteDest_DOIP_TCP_DATA0_Rx (SoAdSocketRouteDest): SoAdRxUpperLayerType=TP, SoAdRxPduId=0, SoAdRxPduRef=DoIP_TCP_DATA0_SoAd2DoIP_RxPdu
      SoAdSocketRoute_DOIP_TCP_DATA1_Rx (SoAdSocketRoute): SoAdRxSocketConnOrSocketConnBundleRef=SoAdSocketConnection_TCP_DhcpV4_Fixed_169_254_1_33_13400_Remote_Any_1
        SoAdSocketRouteDest_DOIP_TCP_DATA1_Rx (SoAdSocketRouteDest): SoAdRxUpperLayerType=TP, SoAdRxPduId=1, SoAdRxPduRef=DoIP_TCP_DATA1_SoAd2DoIP_RxPdu
      SCG_DOIP_UDP_DhcpV4_Fixed_169_254_1_33_13400 (SoAdSocketConnectionGroup):
        SoAdPduHeaderEnable = false
        SoAdResourceManagementEnable = false
        SoAdSocketAutomaticSoConSetup = false
        SoAdSocketIpAddrAssignmentChgNotification = true
        SoAdSocketLocalPort = 13400
        SoAdSocketMsgAcceptanceFilterEnabled = true
        SoAdSocketSoConModeChgNotification = true
        SoAdBestMatchWithSockRouteEnabled = false
        SoAdBestMatchWithPduHeaderEnabled = false
        SoAdSocketAutomaticSoConSetupKeepOnline = false
        SoAdSocketLocalAddressRef = TcpIpLocalAddr_NE_DhcpV4_Fixed_169_254_1_33
        SoAdSocketConnection_DOIP_Broad_UDP_fixed_255_255_255_255_13400_Remote (SoAdSocketConnection): SoAdSocketId=2, SoAdSocketGetReceivedRemoteAddressEnabled=false, SoAdVerifyRxPduEnable=false
          SoAdSocketRemoteAddress: SoAdSocketRemoteIpAddress=255.255.255.255, SoAdSocketRemotePort=13400, SoAdSocketRemoteIpAddressNotSet=false, SoAdSocketRemotePortNotSet=false
        SoAdSocketProtocol
          SoAdSocketUdp:
            SoAdSocketUdpListenOnly = false
            SoAdSocketUdpStrictHeaderLenCheckEnabled = false
            SoAdSocketUdpAddressResolutionRetryEnabled = true
            SoAdSocketUdpImmediateIfTxConfirmation = false
            SoAdSocketUdpAddressResolutionRetryQueueLimit = 1
        SoAdSocketConnection_DOIP_UDP_ANY_Remote (SoAdSocketConnection): SoAdSocketId=3, SoAdSocketGetReceivedRemoteAddressEnabled=false, SoAdVerifyRxPduEnable=false
          SoAdSocketRemoteAddress: SoAdSocketRemoteIpAddress=, SoAdSocketRemotePort=0, SoAdSocketRemoteIpAddressNotSet=false, SoAdSocketRemotePortNotSet=false
      SoAdSocketRoute_DOIP_UDP_TEST_EQUIPMENT_REQUEST_Rx (SoAdSocketRoute): SoAdRxSocketConnOrSocketConnBundleRef=SoAdSocketConnection_DOIP_UDP_ANY_Remote
        SoAdSocketRouteDest_DOIP_UDP_TEST_EQUIPMENT_REQUEST_Rx (SoAdSocketRouteDest): SoAdRxUpperLayerType=IF, SoAdRxPduId=2, SoAdRxPduRef=DoIP_UDP_TEST_EQUIPMENT_REQUEST_SoAd2DoIP_RxPdu
    4 x SoAdBswModules, all with SoAdIf=true, SoAdIfTriggerTransmit=false:
      UdpNm: SoAdIfTxConfirmation=true, SoAdLocalIpAddrAssigmentChg=false, SoAdSoConModeChg=false, SoAdTp=false, SoAdUseCallerInfix=true, SoAdUseTypeInfix=true, SoAdBswModuleRef=UdpNm
      Sd: SoAdIfTxConfirmation=false, SoAdLocalIpAddrAssigmentChg=true, SoAdSoConModeChg=true, SoAdTp=false, SoAdUseCallerInfix=false, SoAdUseTypeInfix=false, SoAdBswModuleRef=Sd
      PduR: SoAdIfTxConfirmation=true, SoAdLocalIpAddrAssigmentChg=false, SoAdSoConModeChg=false, SoAdTp=false, SoAdUseCallerInfix=true, SoAdUseTypeInfix=true, SoAdBswModuleRef=PduR
      DoIP: SoAdIfTxConfirmation=true, SoAdLocalIpAddrAssigmentChg=true, SoAdSoConModeChg=true, SoAdTp=true, SoAdUseCallerInfix=true, SoAdUseTypeInfix=true, SoAdBswModuleRef=DoIP
