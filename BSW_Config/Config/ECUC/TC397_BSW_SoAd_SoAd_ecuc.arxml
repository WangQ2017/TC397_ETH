AUTOSAR XML (schema 00048)
package /ActiveEcuC
  module config SoAd: implementation-config-variant=VARIANT-PRE-COMPILE, module-description=SoAd_Impl
    SoAdGeneral:
      SoAdDevErrorDetect = true
      SoAdVersionInfoApi = false
      SoAdIPv6AddressEnabled = false
      SoAdMainFunctionPeriod = 0.005
      SoAdRoutingGroupMax = 10
      SoAdSoConMax = 13
      SoAdShutdownFinishedWaitTime = 2
      SoAdTcpTlsEnabled = false
      SoAdTxDynamicLengthEnabled = false
      SoAdMainFunctionSplitEnabled = false
      SoAdSafeBswChecks = false
      SoAdGetAndResetMeasurementDataApi = false
      SoAdGeneration:
        SoAdBoolDataInArrayOfStructStrategy = BOOLEAN
        SoAdOutOfBoundsWriteProtectionStrategy = NONE
        SoAdOutOfBoundsWriteSanitizer = false
        SoAdOutOfBoundsReadSanitizer = false
        SoAdReduceConstantData2Define = false
        SoAdDeduplicateIndirectedData = false
        SoAdDataDeduplicationStrategy = NONE
        SoAdReduceBoolDataByNegationThreshold = 0
        SoAdReduceBoolDataByNumericalComparisonThreshold = 0
        SoAdReduceBoolDataByNumericalRelationThreshold = 0
        SoAdReduceBoolDataByNumericalOperandStrategy = NONE
        SoAdReduceNumericalDataByOffsetThreshold = 0
        SoAdReduceNumericalDataByArraySubtractionThreshold = 0
        SoAdReduceDataByStreaming = false
        SoAdShortSymbols = false
        SoAdInterfacesForDeactivatedData = false
        SoAdReferringKeysInComments = false
      SoAdSocketApi: SoAdSocketApiType=AUTOSAR
    SoAdConfig
      SCG_UDP_fixed_192_168_1_123_4567 (SoAdSocketConnectionGroup):
        SoAdPduHeaderEnable = false
        SoAdResourceManagementEnable = false
        SoAdSocketAutomaticSoConSetup = true
        SoAdSocketIpAddrAssignmentChgNotification = false
        SoAdSocketLocalPort = 4567
        SoAdSocketMsgAcceptanceFilterEnabled = true
        SoAdSocketSoConModeChgNotification = false
        SoAdBestMatchWithSockRouteEnabled = false
        SoAdBestMatchWithPduHeaderEnabled = false
        SoAdSocketAutomaticSoConSetupKeepOnline = false
        SoAdSocketLocalAddressRef = TcpIpLocalAddr_NE_Fixed_192_168_1_123
        SoAdSocketConnection: SoAdSocketId=11, SoAdSocketGetReceivedRemoteAddressEnabled=false, SoAdVerifyRxPduEnable=false
          SC_UDP_fixed_192_168_1_123_4567 (SoAdSocketRemoteAddress): SoAdSocketRemoteIpAddress=255.255.255.255, SoAdSocketRemotePort=4567, SoAdSocketRemoteIpAddressNotSet=false, SoAdSocketRemotePortNotSet=false
        SoAdSocketProtocol
          SoAdSocketUdp:
            SoAdSocketUdpListenOnly = false
            SoAdSocketUdpStrictHeaderLenCheckEnabled = false
            SoAdSocketUdpAddressResolutionRetryEnabled = true
            SoAdSocketUdpImmediateIfTxConfirmation = false
            SoAdSocketUdpAddressResolutionRetryQueueLimit = 1
      SoAdPduRoute_udplog_Tx (SoAdPduRoute): SoAdTxPduId=9, SoAdTxUpperLayerType=IF, SoAdTxIfOptimized=false, SoAdTxIfTriggerTransmit=false, SoAdTxPduRef=udplog_TxPdu_SoAd
        SoAdPduRouteDest: SoAdTxSocketConnOrSocketConnBundleRef=SCG_UDP_fixed_192_168_1_123_4567
      SoAdPduRoute_TimeSyncStatus_Tx (SoAdPduRoute): SoAdTxPduId=8, SoAdTxUpperLayerType=IF, SoAdTxIfTriggerTransmit=false, SoAdTxIfOptimized=false, SoAdTxPduRef=TimeSyncStatus_TxPdu_SoAd
        SoAdPduRouteDest: SoAdTxSocketConnOrSocketConnBundleRef=SCG_UDP_fixed_192_168_1_123_4567
      SCG_DOIP_TCP_DHCP_169_254_1_33_13400 (SoAdSocketConnectionGroup):
        SoAdPduHeaderEnable = false
        SoAdResourceManagementEnable = false
        SoAdSocketAutomaticSoConSetup = false
        SoAdSocketIpAddrAssignmentChgNotification = true
        SoAdSocketLocalPort = 13400
        SoAdSocketMsgAcceptanceFilterEnabled = true
        SoAdSocketSoConModeChgNotification = true
        SoAdBestMatchWithSockRouteEnabled = false
        SoAdBestMatchWithPduHeaderEnabled = false
        SoAdSocketAutomaticSoConSetupKeepOnline = false
        SoAdSocketTpRxBufferMin = 1024
        SoAdSocketLocalAddressRef = TcpIpLocalAddr_NE_DhcpV4_Fixed_169_254_1_33
        SoAdSocketConnection_TCP_DhcpV4_Fixed_169_254_1_33_13400_Remote_Any_0 (SoAdSocketConnection): SoAdSocketId=0, SoAdSocketGetReceivedRemoteAddressEnabled=false, SoAdVerifyRxPduEnable=false, SoAdTcpTxQueueSize=2
          SoAdSocketRemoteAddress: SoAdSocketRemoteIpAddress=, SoAdSocketRemotePort=0, SoAdSocketRemoteIpAddressNotSet=false, SoAdSocketRemotePortNotSet=false
        SoAdSocketProtocol
          SoAdSocketTcp:
            SoAdSocketTcpImmediateTpTxConfirmation = false
            SoAdSocketTcpInitiate = false
            SoAdSocketTcpKeepAlive = false
            SoAdSocketTcpTxBufferMin = 1024
            SoAdSocketTcpNoDelay = true
        SoAdSocketConnection_TCP_DhcpV4_Fixed_169_254_1_33_13400_Remote_Any_1 (SoAdSocketConnection): SoAdSocketId=1, SoAdSocketGetReceivedRemoteAddressEnabled=false, SoAdVerifyRxPduEnable=false, SoAdTcpTxQueueSize=2
          SoAdSocketRemoteAddress: SoAdSocketRemoteIpAddress=, SoAdSocketRemotePort=0, SoAdSocketRemoteIpAddressNotSet=false, SoAdSocketRemotePortNotSet=false
      SoAdPduRoute_DOIP_TCP_DATA0_TX (SoAdPduRoute): SoAdTxPduId=1, SoAdTxUpperLayerType=TP, SoAdTxTpOptimized=false, SoAdTxPduRef=DoIP_TCP_DATA0_DoIP2SoAd_TxPdu
        SoAdPduRouteDest: SoAdTxSocketConnOrSocketConnBundleRef=SoAdSocketConnection_TCP_DhcpV4_Fixed_169_254_1_33_13400_Remote_Any_0
      SoAdPduRoute_DOIP_TCP_DATA1_TX (SoAdPduRoute): SoAdTxPduId=2, SoAdTxUpperLayerType=TP, SoAdTxTpOptimized=false, SoAdTxPduRef=DoIP_TCP_DATA1_DoIP2SoAd_TxPdu
        SoAdPduRouteDest: SoAdTxSocketConnOrSocketConnBundleRef=SoAdSocketConnection_TCP_DhcpV4_Fixed_169_254_1_33_13400_Remote_Any_1
      SoAdSocketRoute_DOIP_TCP_DATA0_Rx (SoAdSocketRoute): SoAdRxSocketConnOrSocketConnBundleRef=SoAdSocketConnection_TCP_DhcpV4_Fixed_169_254_1_33_13400_Remote_Any_0
        SoAdSocketRouteDest: SoAdRxUpperLayerType=TP, SoAdRxPduId=0, SoAdRxPduRef=DoIP_TCP_DATA0_SoAd2DoIP_RxPdu
      SoAdSocketRoute_DOIP_TCP_DATA1_Rx (SoAdSocketRoute): SoAdRxSocketConnOrSocketConnBundleRef=SoAdSocketConnection_TCP_DhcpV4_Fixed_169_254_1_33_13400_Remote_Any_1
        SoAdSocketRouteDest_001 (SoAdSocketRouteDest): SoAdRxUpperLayerType=TP, SoAdRxPduId=1, SoAdRxPduRef=DoIP_TCP_DATA1_SoAd2DoIP_RxPdu
      SCG_DOIP_UDP_DHCP_169_254_1_33_13400 (SoAdSocketConnectionGroup):
        SoAdPduHeaderEnable = false
        SoAdResourceManagementEnable = false
        SoAdSocketAutomaticSoConSetup = false
        SoAdSocketIpAddrAssignmentChgNotification = true
        SoAdSocketLocalPort = 13400
        SoAdSocketMsgAcceptanceFilterEnabled = true
        SoAdSocketSoConModeChgNotification = true
        SoAdBestMatchWithSockRouteEnabled = false
        SoAdBestMatchWithPduHeaderEnabled = false
        SoAdSocketAutomaticSoConSetupKeepOnline = false
        SoAdSocketLocalAddressRef = TcpIpLocalAddr_NE_DhcpV4_Fixed_169_254_1_33
        SoAdSocketConnection_DOIP_UDP_Broad__255_255_255_255_13400_remote (SoAdSocketConnection): SoAdSocketId=3, SoAdSocketGetReceivedRemoteAddressEnabled=false, SoAdVerifyRxPduEnable=false
          SoAdSocketRemoteAddress: SoAdSocketRemoteIpAddress=255.255.255.255, SoAdSocketRemotePort=13400, SoAdSocketRemoteIpAddressNotSet=false, SoAdSocketRemotePortNotSet=false
        SoAdSocketProtocol
          SoAdSocketUdp:
            SoAdSocketUdpListenOnly = false
            SoAdSocketUdpStrictHeaderLenCheckEnabled = false
            SoAdSocketUdpAddressResolutionRetryEnabled = true
            SoAdSocketUdpImmediateIfTxConfirmation = false
            SoAdSocketUdpAddressResolutionRetryQueueLimit = 1
        SoAdSocketConnection_DOIP_UDP_ANY_remote (SoAdSocketConnection): SoAdSocketId=2, SoAdSocketGetReceivedRemoteAddressEnabled=false, SoAdVerifyRxPduEnable=false
          SoAdSocketRemoteAddress: SoAdSocketRemoteIpAddress=, SoAdSocketRemotePort=0, SoAdSocketRemoteIpAddressNotSet=false, SoAdSocketRemotePortNotSet=false
      SoAdPduRoute_DOIP_UDP_DISCOVERY_Tx (SoAdPduRoute): SoAdTxPduId=4, SoAdTxUpperLayerType=IF, SoAdTxIfOptimized=false, SoAdTxIfTriggerTransmit=false, SoAdTxPduRef=DoIP_UDP_DISCOVERY_DoIP2SoAd_TxPdu
        SoAdPduRouteDest: SoAdTxSocketConnOrSocketConnBundleRef=SoAdSocketConnection_DOIP_UDP_Broad__255_255_255_255_13400_remote
      SoAdPduRoute_DOIP_TEST_EQUIPMENT_REQUEST_Tx (SoAdPduRoute):
        SoAdTxPduId = 3
        SoAdTxUpperLayerType = IF
        SoAdTxIfTriggerTransmit = false
        SoAdTxIfOptimized = false
        SoAdTxPduRef = DoIP_UDP_TEST_EQUIPMENT_REQUEST_DoIP2SoAd_TxPdu
        SoAdPduRouteDest: SoAdTxSocketConnOrSocketConnBundleRef=SoAdSocketConnection_DOIP_UDP_ANY_remote
      SoAdSocketRoute_DOIP_UDP_TEST_EQUIPMENT_REQUEST_Rx (SoAdSocketRoute): SoAdRxSocketConnOrSocketConnBundleRef=SoAdSocketConnection_DOIP_UDP_ANY_remote
        SoAdSocketRouteDest_1 (SoAdSocketRouteDest): SoAdRxUpperLayerType=IF, SoAdRxPduId=2, SoAdRxPduRef=DoIP_UDP_TEST_EQUIPMENT_REQUEST_SoAd2DoIP_RxPdu
      6 x SoAdSocketConnectionGroup, all with SoAdPduHeaderEnable=true, SoAdResourceManagementEnable=false, SoAdSocketAutomaticSoConSetup=false, SoAdBestMatchWithSockRouteEnabled=false, SoAdBestMatchWithPduHeaderEnabled=false, SoAdSocketAutomaticSoConSetupKeepOnline=false:
        SCG_SD_Ctrl_UDP_fixed_10_23_0_33_30490: SoAdSocketIpAddrAssignmentChgNotification=true, SoAdSocketLocalPort=30490, SoAdSocketMsgAcceptanceFilterEnabled=false, SoAdSocketSoConModeChgNotification=false, SoAdSocketLocalAddressRef=TcpIpLocalAddr_NE_Fixed_10_23_0_23
          SC_SD_Ctrl_UDP_Any_DynamicPort_Remote (SoAdSocketConnection): SoAdSocketId=5, SoAdSocketGetReceivedRemoteAddressEnabled=true, SoAdVerifyRxPduEnable=false
            SoAdSocketRemoteAddress: SoAdSocketRemoteIpAddress=, SoAdSocketRemotePort=0, SoAdSocketRemoteIpAddressNotSet=false, SoAdSocketRemotePortNotSet=false
          SoAdSocketProtocol
            SoAdSocketUdp:
              SoAdSocketUdpListenOnly = false
              SoAdSocketUdpStrictHeaderLenCheckEnabled = false
              SoAdSocketUdpAddressResolutionRetryEnabled = true
              SoAdSocketUdpImmediateIfTxConfirmation = false
              SoAdSocketUdpAddressResolutionRetryQueueLimit = 1
        SCG_SD_Ctrl_Multicast_Rx_239_23_0_2_30490: SoAdSocketIpAddrAssignmentChgNotification=false, SoAdSocketLocalPort=30490, SoAdSocketMsgAcceptanceFilterEnabled=false, SoAdSocketSoConModeChgNotification=false, SoAdSocketLocalAddressRef=TcpIpLocalAddr_NE_Multicast_Rx_Fixed_239_23_0_2
          SC_SD_Ctrl_UDP_Any_DynamicPort_Remote1 (SoAdSocketConnection): SoAdSocketId=4, SoAdSocketGetReceivedRemoteAddressEnabled=true, SoAdVerifyRxPduEnable=false
            SoAdSocketRemoteAddress: SoAdSocketRemoteIpAddress=, SoAdSocketRemotePort=0, SoAdSocketRemoteIpAddressNotSet=false, SoAdSocketRemotePortNotSet=false
          SoAdSocketProtocol
            SoAdSocketUdp:
              SoAdSocketUdpListenOnly = false
              SoAdSocketUdpStrictHeaderLenCheckEnabled = false
              SoAdSocketUdpAddressResolutionRetryEnabled = true
              SoAdSocketUdpImmediateIfTxConfirmation = false
              SoAdSocketUdpAddressResolutionRetryQueueLimit = 1
        SCG_SD_TCP_TX_fixed_10_23_0_23_47843: SoAdSocketIpAddrAssignmentChgNotification=false, SoAdSocketLocalPort=47843, SoAdSocketMsgAcceptanceFilterEnabled=true, SoAdSocketSoConModeChgNotification=true, SoAdSocketTpRxBufferMin=512, SoAdSocketLocalAddressRef=TcpIpLocalAddr_NE_Fixed_10_23_0_23
          SC_TCP_TX_Any_IP_DynamincPort (SoAdSocketConnection):
            SoAdSocketId = 7
            SoAdSocketGetReceivedRemoteAddressEnabled = false
            SoAdVerifyRxPduEnable = false
            SoAdTcpTxQueueSize = 1
            SoAdAdditionalChgNotificationRef = Sd
            SoAdSocketRemoteAddress: SoAdSocketRemoteIpAddress=, SoAdSocketRemotePort=0, SoAdSocketRemoteIpAddressNotSet=false, SoAdSocketRemotePortNotSet=false
          SoAdSocketProtocol
            SoAdSocketTcp: SoAdSocketTcpImmediateTpTxConfirmation=false, SoAdSocketTcpInitiate=false, SoAdSocketTcpKeepAlive=false, SoAdSocketTcpTxBufferMin=512
        SCG_SD_TCP_RX_fixed_10_23_0_23_47842: SoAdSocketIpAddrAssignmentChgNotification=false, SoAdSocketLocalPort=47842, SoAdSocketMsgAcceptanceFilterEnabled=true, SoAdSocketSoConModeChgNotification=true, SoAdSocketTpRxBufferMin=512, SoAdSocketLocalAddressRef=TcpIpLocalAddr_NE_Fixed_10_23_0_23
          SC_TCP_TX_Any_IP_DynamincPort_001 (SoAdSocketConnection):
            SoAdSocketId = 6
            SoAdSocketGetReceivedRemoteAddressEnabled = false
            SoAdVerifyRxPduEnable = false
            SoAdTcpTxQueueSize = 1
            SoAdAdditionalChgNotificationRef = Sd
            SoAdSocketRemoteAddress: SoAdSocketRemoteIpAddress=, SoAdSocketRemotePort=0, SoAdSocketRemoteIpAddressNotSet=false, SoAdSocketRemotePortNotSet=false
          SoAdSocketProtocol
            SoAdSocketTcp: SoAdSocketTcpImmediateTpTxConfirmation=false, SoAdSocketTcpInitiate=true, SoAdSocketTcpKeepAlive=false, SoAdSocketTcpTxBufferMin=512
        SCG_SD_UDP_fixe_10_23_0_33_40000: SoAdSocketIpAddrAssignmentChgNotification=true, SoAdSocketLocalPort=40000, SoAdSocketMsgAcceptanceFilterEnabled=true, SoAdSocketSoConModeChgNotification=false, SoAdSocketLocalAddressRef=TcpIpLocalAddr_NE_Fixed_10_23_0_23
          SC_UDP_IP_Any_DynamicPort_0 (SoAdSocketConnection): SoAdSocketId=8, SoAdSocketGetReceivedRemoteAddressEnabled=false, SoAdVerifyRxPduEnable=false, SoAdAdditionalChgNotificationRef=Sd
            SoAdSocketRemoteAddress: SoAdSocketRemoteIpAddress=, SoAdSocketRemotePort=0, SoAdSocketRemoteIpAddressNotSet=false, SoAdSocketRemotePortNotSet=false
          SoAdSocketProtocol
            SoAdSocketUdp:
              SoAdSocketUdpListenOnly = false
              SoAdSocketUdpStrictHeaderLenCheckEnabled = false
              SoAdSocketUdpAddressResolutionRetryEnabled = true
              SoAdSocketUdpImmediateIfTxConfirmation = false
              SoAdSocketUdpAddressResolutionRetryQueueLimit = 1
              SoAdSocketUdpAliveSupervisionTimeout = 1
          SC_UDP_IP_Any_DynamicPort_1 (SoAdSocketConnection): SoAdSocketId=9, SoAdSocketGetReceivedRemoteAddressEnabled=false, SoAdVerifyRxPduEnable=false, SoAdAdditionalChgNotificationRef=Sd
            SoAdSocketRemoteAddress: SoAdSocketRemoteIpAddress=, SoAdSocketRemotePort=0, SoAdSocketRemoteIpAddressNotSet=false, SoAdSocketRemotePortNotSet=false
          SC_UDP_Multicast_Fixed_239_23_0_1_40000_remote (SoAdSocketConnection): SoAdSocketId=10, SoAdSocketGetReceivedRemoteAddressEnabled=false, SoAdVerifyRxPduEnable=false, SoAdAdditionalChgNotificationRef=Sd
            SoAdSocketRemoteAddress: SoAdSocketRemoteIpAddress=239.23.0.1, SoAdSocketRemotePort=40000, SoAdSocketRemoteIpAddressNotSet=false, SoAdSocketRemotePortNotSet=false
        SCG_SD_UDP_Multicast_Rx_Any_40000: SoAdSocketIpAddrAssignmentChgNotification=true, SoAdSocketLocalPort=40000, SoAdSocketMsgAcceptanceFilterEnabled=true, SoAdSocketSoConModeChgNotification=false, SoAdSocketLocalAddressRef=TcpIpLocalAddr_Multicast_Any_Vlan23
          SC_UDP_Multicast_Rx_Any (SoAdSocketConnection): SoAdSocketId=12, SoAdSocketGetReceivedRemoteAddressEnabled=false, SoAdVerifyRxPduEnable=false, SoAdAdditionalChgNotificationRef=Sd
            SoAdSocketRemoteAddress: SoAdSocketRemoteIpAddress=, SoAdSocketRemotePort=0, SoAdSocketRemoteIpAddressNotSet=false, SoAdSocketRemotePortNotSet=false
          SoAdSocketProtocol
            SoAdSocketUdp:
              SoAdSocketUdpListenOnly = true
              SoAdSocketUdpStrictHeaderLenCheckEnabled = false
              SoAdSocketUdpAddressResolutionRetryEnabled = true
              SoAdSocketUdpImmediateIfTxConfirmation = false
              SoAdSocketUdpAddressResolutionRetryQueueLimit = 1
              SoAdSocketUdpAliveSupervisionTimeout = 1
      4 x SoAdPduRoute, all with SoAdTxUpperLayerType=IF, SoAdTxIfOptimized=false, SoAdTxIfTriggerTransmit=false:
        SoAdPduRoute_Sd_Ctrl_Tx: SoAdTxPduId=5, SoAdTxPduRef=SdCtrlTxPdu
          SoAdPduRouteDest: SoAdTxPduHeaderId=4294934784, SoAdTxSocketConnOrSocketConnBundleRef=SC_SD_Ctrl_UDP_Any_DynamicPort_Remote
        SoAdPduRoute_Sd_TCP_EcuStateTx: SoAdTxPduId=6, SoAdTxPduRef=SomeIpEcuStateTxPdu_SoAd
          SoAdPduRouteDest:
            SoAdTxPduHeaderId = 3284303873
            SoAdTxSocketConnOrSocketConnBundleRef = SCG_SD_TCP_TX_fixed_10_23_0_23_47843
            SoAdTxRoutingGroupRef = SoAdRoutingGroup_EcuState_AC
        SoAdPduRoute_Sd_UDP_FaultInfoTx: SoAdTxPduId=7, SoAdTxPduRef=SomeIpFalutInfoTxPdu_SoAd
          SoAdPduRouteDest:
            SoAdTxPduHeaderId = 3284172801
            SoAdTxSocketConnOrSocketConnBundleRef = SCG_SD_UDP_fixe_10_23_0_33_40000
            SoAdTxRoutingGroupRef = SoAdRoutingGroup_FaultInfo_AC
            SoAdTxRoutingGroupRef = SoAdRoutingGroup_FaultInfo_AM
        SoAdPduRoute_SD_UDP_SenStateTx: SoAdTxPduId=0, SoAdTxPduRef=SomeIpSenStateTxPdu_SoAd
          SoAdPduRouteDest:
            SoAdTxPduHeaderId = 3284238337
            SoAdTxSocketConnOrSocketConnBundleRef = SCG_SD_UDP_fixe_10_23_0_33_40000
            SoAdTxRoutingGroupRef = SoAdRoutingGroup_SenState_AC
            SoAdTxRoutingGroupRef = SoAdRoutingGroup_SenState_AM
      7 x SoAdSocketRoute:
        SoAdSocketRoute_SD_Ctrl_Rx: SoAdRxPduHeaderId=4294934784, SoAdRxSocketConnOrSocketConnBundleRef=SC_SD_Ctrl_UDP_Any_DynamicPort_Remote
          SoAdSocketRouteDest_2 (SoAdSocketRouteDest): SoAdRxUpperLayerType=IF, SoAdRxPduId=3, SoAdRxPduRef=SdCtrlRxPdu
        SoAdSocketRoute_SD_Ctrl_Rx_ticast: SoAdRxPduHeaderId=4294934784, SoAdRxSocketConnOrSocketConnBundleRef=SC_SD_Ctrl_UDP_Any_DynamicPort_Remote1
          SoAdSocketRouteDest_3 (SoAdSocketRouteDest): SoAdRxUpperLayerType=IF, SoAdRxPduId=4, SoAdRxPduRef=SdCtrlMulticastRxPdu
        SoAdSocketRoute_SD_RX_Fixed_10_23_0_33_47842: SoAdRxPduHeaderId=3285024769, SoAdRxSocketConnOrSocketConnBundleRef=SCG_SD_TCP_RX_fixed_10_23_0_23_47842
          SoAdSocketRouteDest_VechicleInfo_001 (SoAdSocketRouteDest): SoAdRxUpperLayerType=IF, SoAdRxPduId=5, SoAdRxPduRef=SomeIpVechicleInfoRxPdu_SoAd, SoAdRxRoutingGroupRef=SoAdRoutingGroup_VechicleInfo_AC
        SoAdSocketRoute_SD_UDP_Fixed_10_23_0_33_40000_1: SoAdRxPduHeaderId=3284893697, SoAdRxSocketConnOrSocketConnBundleRef=SCG_SD_UDP_fixe_10_23_0_33_40000
          SoAdSocketRouteDest_VechicleSpeed (SoAdSocketRouteDest):
            SoAdRxUpperLayerType = IF
            SoAdRxPduId = 6
            SoAdRxPduRef = SomeIpVechicleSpeedRxPdu_SoAd
            SoAdRxRoutingGroupRef = SoAdRoutingGroup_VechicleSpeed_AC
            SoAdRxRoutingGroupRef = SoAdRoutingGroup_VechicleSpeed_AM
        SoAdSocketRoute_SD_UDP_Fixed_10_23_0_33_40000_2: SoAdRxPduHeaderId=3284959233, SoAdRxSocketConnOrSocketConnBundleRef=SCG_SD_UDP_fixe_10_23_0_33_40000
          SoAdSocketRouteDest_VechicleStatus (SoAdSocketRouteDest):
            SoAdRxUpperLayerType = IF
            SoAdRxPduId = 7
            SoAdRxPduRef = SomeIpVechicleStatusRxPdu_SoAd
            SoAdRxRoutingGroupRef = SoAdRoutingGroup_VechicleStatus_AC
            SoAdRxRoutingGroupRef = SoAdRoutingGroup_VechicleStatus_AM
        SoAdSocketRoute_SD_UDP_Multicast_Rx_Any_1: SoAdRxPduHeaderId=3284893697, SoAdRxSocketConnOrSocketConnBundleRef=SCG_SD_UDP_Multicast_Rx_Any_40000
          SoAdSocketRouteDest_VechicleSpeed_multi (SoAdSocketRouteDest): SoAdRxUpperLayerType=IF, SoAdRxPduId=8, SoAdRxPduRef=SomeIpVechicleSpeedRxPdu_SoAd, SoAdRxRoutingGroupRef=SoAdRoutingGroup_VechicleSpeed_AM
        SoAdSocketRoute_SD_UDP_Multicast_Rx_Any_2: SoAdRxPduHeaderId=3284959233, SoAdRxSocketConnOrSocketConnBundleRef=SCG_SD_UDP_Multicast_Rx_Any_40000
          SoAdSocketRouteDest_VechicleStatus_multi (SoAdSocketRouteDest): SoAdRxUpperLayerType=IF, SoAdRxPduId=9, SoAdRxPduRef=SomeIpVechicleStatusRxPdu_SoAd, SoAdRxRoutingGroupRef=SoAdRoutingGroup_VechicleStatus_AM
      10 x SoAdRoutingGroup, all with SoAdRoutingGroupIsEnabledAtInit=false, SoAdRoutingGroupTxTriggerable=false:
        SoAdRoutingGroup_VechicleSpeed_AC: SoAdRoutingGroupId=6
        SoAdRoutingGroup_VechicleSpeed_AM: SoAdRoutingGroupId=7
        SoAdRoutingGroup_VechicleStatus_AC: SoAdRoutingGroupId=8
        SoAdRoutingGroup_VechicleStatus_AM: SoAdRoutingGroupId=9
        SoAdRoutingGroup_VechicleInfo_AC: SoAdRoutingGroupId=5
        SoAdRoutingGroup_FaultInfo_AC: SoAdRoutingGroupId=1
        SoAdRoutingGroup_FaultInfo_AM: SoAdRoutingGroupId=2
        SoAdRoutingGroup_SenState_AC: SoAdRoutingGroupId=3
        SoAdRoutingGroup_SenState_AM: SoAdRoutingGroupId=4
        SoAdRoutingGroup_EcuState_AC: SoAdRoutingGroupId=0
    3 x SoAdBswModules, all with SoAdIf=true, SoAdIfTriggerTransmit=false:
      PduR: SoAdIfTxConfirmation=true, SoAdLocalIpAddrAssigmentChg=false, SoAdSoConModeChg=false, SoAdTp=false, SoAdUseCallerInfix=true, SoAdUseTypeInfix=true, SoAdBswModuleRef=PduR
      DoIP: SoAdIfTxConfirmation=true, SoAdLocalIpAddrAssigmentChg=true, SoAdSoConModeChg=true, SoAdTp=true, SoAdUseCallerInfix=true, SoAdUseTypeInfix=true, SoAdBswModuleRef=DoIP
      Sd: SoAdIfTxConfirmation=false, SoAdLocalIpAddrAssigmentChg=true, SoAdSoConModeChg=true, SoAdTp=false, SoAdUseCallerInfix=false, SoAdUseTypeInfix=false, SoAdBswModuleRef=Sd
