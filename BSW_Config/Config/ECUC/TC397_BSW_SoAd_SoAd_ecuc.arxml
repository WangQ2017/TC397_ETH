AUTOSAR XML (schema 00048)
package /ActiveEcuC
  module config SoAd: implementation-config-variant=VARIANT-PRE-COMPILE, module-description=SoAd_Impl
    SoAdGeneral:
      SoAdDevErrorDetect = true
      SoAdVersionInfoApi = false
      SoAdIPv6AddressEnabled = false
      SoAdMainFunctionPeriod = 0.005
      SoAdRoutingGroupMax = 1
      SoAdSoConMax = 5
      SoAdShutdownFinishedWaitTime = 2
      SoAdTcpTlsEnabled = false
      SoAdTxDynamicLengthEnabled = false
      SoAdMainFunctionSplitEnabled = false
      SoAdSafeBswChecks = false
      SoAdGetAndResetMeasurementDataApi = false
      SoAdGeneration:
        SoAdBoolDataInArrayOfStructStrategy = BOOLEAN
        SoAdOutOfBoundsWriteProtectionStrategy = NONE
        SoAdOutOfBoundsWriteSanitizer = false
        SoAdOutOfBoundsReadSanitizer = false
        SoAdReduceConstantData2Define = false
        SoAdDeduplicateIndirectedData = false
        SoAdDataDeduplicationStrategy = NONE
        SoAdReduceBoolDataByNegationThreshold = 0
        SoAdReduceBoolDataByNumericalComparisonThreshold = 0
        SoAdReduceBoolDataByNumericalRelationThreshold = 0
        SoAdReduceBoolDataByNumericalOperandStrategy = NONE
        SoAdReduceNumericalDataByOffsetThreshold = 0
        SoAdReduceNumericalDataByArraySubtractionThreshold = 0
        SoAdReduceDataByStreaming = false
        SoAdShortSymbols = false
        SoAdInterfacesForDeactivatedData = false
        SoAdReferringKeysInComments = false
      SoAdSocketApi: SoAdSocketApiType=AUTOSAR
    SoAdConfig
      SCG_UDP_fixed_192_168_1_123_4567 (SoAdSocketConnectionGroup):
        SoAdPduHeaderEnable = false
        SoAdResourceManagementEnable = false
        SoAdSocketAutomaticSoConSetup = true
        SoAdSocketIpAddrAssignmentChgNotification = false
        SoAdSocketLocalPort = 4567
        SoAdSocketMsgAcceptanceFilterEnabled = true
        SoAdSocketSoConModeChgNotification = false
        SoAdBestMatchWithSockRouteEnabled = false
        SoAdBestMatchWithPduHeaderEnabled = false
        SoAdSocketAutomaticSoConSetupKeepOnline = false
        SoAdSocketLocalAddressRef = TcpIpLocalAddr_NE_Fixed_192_168_1_123
        SoAdSocketConnection: SoAdSocketId=4, SoAdSocketGetReceivedRemoteAddressEnabled=false, SoAdVerifyRxPduEnable=false
          SC_UDP_fixed_192_168_1_123_4567 (SoAdSocketRemoteAddress): SoAdSocketRemoteIpAddress=255.255.255.255, SoAdSocketRemotePort=4567, SoAdSocketRemoteIpAddressNotSet=false, SoAdSocketRemotePortNotSet=false
        SoAdSocketProtocol
          SoAdSocketUdp:
            SoAdSocketUdpListenOnly = false
            SoAdSocketUdpStrictHeaderLenCheckEnabled = false
            SoAdSocketUdpAddressResolutionRetryEnabled = true
            SoAdSocketUdpImmediateIfTxConfirmation = false
            SoAdSocketUdpAddressResolutionRetryQueueLimit = 1
      SoAdPduRoute_udplog_Tx (SoAdPduRoute): SoAdTxPduId=5, SoAdTxUpperLayerType=IF, SoAdTxIfOptimized=false, SoAdTxIfTriggerTransmit=false, SoAdTxPduRef=udplog_TxPdu_SoAd
        SoAdPduRouteDest: SoAdTxSocketConnOrSocketConnBundleRef=SCG_UDP_fixed_192_168_1_123_4567
      SoAdPduRoute_TimeSyncStatus_Tx (SoAdPduRoute): SoAdTxPduId=4, SoAdTxUpperLayerType=IF, SoAdTxIfTriggerTransmit=false, SoAdTxIfOptimized=false, SoAdTxPduRef=TimeSyncStatus_TxPdu_SoAd
        SoAdPduRouteDest: SoAdTxSocketConnOrSocketConnBundleRef=SCG_UDP_fixed_192_168_1_123_4567
      SCG_DOIP_TCP_DHCP_169_254_1_33_13400 (SoAdSocketConnectionGroup):
        SoAdPduHeaderEnable = false
        SoAdResourceManagementEnable = false
        SoAdSocketAutomaticSoConSetup = false
        SoAdSocketIpAddrAssignmentChgNotification = true
        SoAdSocketLocalPort = 13400
        SoAdSocketMsgAcceptanceFilterEnabled = true
        SoAdSocketSoConModeChgNotification = true
        SoAdBestMatchWithSockRouteEnabled = false
        SoAdBestMatchWithPduHeaderEnabled = false
        SoAdSocketAutomaticSoConSetupKeepOnline = false
        SoAdSocketTpRxBufferMin = 1024
        SoAdSocketLocalAddressRef = TcpIpLocalAddr_NE_DhcpV4_Fixed_169_254_1_33
        SoAdSocketConnection_TCP_DhcpV4_Fixed_169_254_1_33_13400_Remote_Any_0 (SoAdSocketConnection): SoAdSocketId=0, SoAdSocketGetReceivedRemoteAddressEnabled=false, SoAdVerifyRxPduEnable=false, SoAdTcpTxQueueSize=2
          SoAdSocketRemoteAddress: SoAdSocketRemoteIpAddress=, SoAdSocketRemotePort=0, SoAdSocketRemoteIpAddressNotSet=false, SoAdSocketRemotePortNotSet=false
        SoAdSocketProtocol
          SoAdSocketTcp:
            SoAdSocketTcpImmediateTpTxConfirmation = false
            SoAdSocketTcpInitiate = false
            SoAdSocketTcpKeepAlive = false
            SoAdSocketTcpTxBufferMin = 1024
            SoAdSocketTcpNoDelay = true
        SoAdSocketConnection_TCP_DhcpV4_Fixed_169_254_1_33_13400_Remote_Any_1 (SoAdSocketConnection): SoAdSocketId=1, SoAdSocketGetReceivedRemoteAddressEnabled=false, SoAdVerifyRxPduEnable=false, SoAdTcpTxQueueSize=2
          SoAdSocketRemoteAddress: SoAdSocketRemoteIpAddress=, SoAdSocketRemotePort=0, SoAdSocketRemoteIpAddressNotSet=false, SoAdSocketRemotePortNotSet=false
      SoAdPduRoute_DOIP_TCP_DATA0_TX (SoAdPduRoute): SoAdTxPduId=1, SoAdTxUpperLayerType=TP, SoAdTxTpOptimized=false, SoAdTxPduRef=DoIP_TCP_DATA0_DoIP2SoAd_TxPdu
        SoAdPduRouteDest: SoAdTxSocketConnOrSocketConnBundleRef=SoAdSocketConnection_TCP_DhcpV4_Fixed_169_254_1_33_13400_Remote_Any_0
      SoAdPduRoute_DOIP_TCP_DATA1_TX (SoAdPduRoute): SoAdTxPduId=2, SoAdTxUpperLayerType=TP, SoAdTxTpOptimized=false, SoAdTxPduRef=DoIP_TCP_DATA1_DoIP2SoAd_TxPdu
        SoAdPduRouteDest: SoAdTxSocketConnOrSocketConnBundleRef=SoAdSocketConnection_TCP_DhcpV4_Fixed_169_254_1_33_13400_Remote_Any_1
      SoAdSocketRoute_DOIP_TCP_DATA0_Rx (SoAdSocketRoute): SoAdRxSocketConnOrSocketConnBundleRef=SoAdSocketConnection_TCP_DhcpV4_Fixed_169_254_1_33_13400_Remote_Any_0
        SoAdSocketRouteDest: SoAdRxUpperLayerType=TP, SoAdRxPduId=0, SoAdRxPduRef=DoIP_TCP_DATA0_SoAd2DoIP_RxPdu
      SoAdSocketRoute_DOIP_TCP_DATA1_Rx (SoAdSocketRoute): SoAdRxSocketConnOrSocketConnBundleRef=SoAdSocketConnection_TCP_DhcpV4_Fixed_169_254_1_33_13400_Remote_Any_1
        SoAdSocketRouteDest_001 (SoAdSocketRouteDest): SoAdRxUpperLayerType=TP, SoAdRxPduId=1, SoAdRxPduRef=DoIP_TCP_DATA1_SoAd2DoIP_RxPdu
      SCG_DOIP_UDP_DHCP_169_254_1_33_13400 (SoAdSocketConnectionGroup):
        SoAdPduHeaderEnable = false
        SoAdResourceManagementEnable = false
        SoAdSocketAutomaticSoConSetup = false
        SoAdSocketIpAddrAssignmentChgNotification = true
        SoAdSocketLocalPort = 13400
        SoAdSocketMsgAcceptanceFilterEnabled = true
        SoAdSocketSoConModeChgNotification = true
        SoAdBestMatchWithSockRouteEnabled = false
        SoAdBestMatchWithPduHeaderEnabled = false
        SoAdSocketAutomaticSoConSetupKeepOnline = false
        SoAdSocketLocalAddressRef = TcpIpLocalAddr_NE_DhcpV4_Fixed_169_254_1_33
        SoAdSocketConnection_DOIP_UDP_Broad__255_255_255_255_13400_remote (SoAdSocketConnection): SoAdSocketId=3, SoAdSocketGetReceivedRemoteAddressEnabled=false, SoAdVerifyRxPduEnable=false
          SoAdSocketRemoteAddress: SoAdSocketRemoteIpAddress=255.255.255.255, SoAdSocketRemotePort=13400, SoAdSocketRemoteIpAddressNotSet=false, SoAdSocketRemotePortNotSet=false
        SoAdSocketProtocol
          SoAdSocketUdp:
            SoAdSocketUdpListenOnly = false
            SoAdSocketUdpStrictHeaderLenCheckEnabled = false
            SoAdSocketUdpAddressResolutionRetryEnabled = true
            SoAdSocketUdpImmediateIfTxConfirmation = false
            SoAdSocketUdpAddressResolutionRetryQueueLimit = 1
        SoAdSocketConnection_DOIP_UDP_ANY_remote (SoAdSocketConnection): SoAdSocketId=2, SoAdSocketGetReceivedRemoteAddressEnabled=false, SoAdVerifyRxPduEnable=false
          SoAdSocketRemoteAddress: SoAdSocketRemoteIpAddress=, SoAdSocketRemotePort=0, SoAdSocketRemoteIpAddressNotSet=false, SoAdSocketRemotePortNotSet=false
      SoAdPduRoute_DOIP_UDP_DISCOVERY_Tx (SoAdPduRoute): SoAdTxPduId=3, SoAdTxUpperLayerType=IF, SoAdTxIfOptimized=false, SoAdTxIfTriggerTransmit=false, SoAdTxPduRef=DoIP_UDP_DISCOVERY_DoIP2SoAd_TxPdu
        SoAdPduRouteDest: SoAdTxSocketConnOrSocketConnBundleRef=SoAdSocketConnection_DOIP_UDP_Broad__255_255_255_255_13400_remote
      SoAdPduRoute_DOIP_TEST_EQUIPMENT_REQUEST_Tx (SoAdPduRoute):
        SoAdTxPduId = 0
        SoAdTxUpperLayerType = IF
        SoAdTxIfTriggerTransmit = false
        SoAdTxIfOptimized = false
        SoAdTxPduRef = DoIP_UDP_TEST_EQUIPMENT_REQUEST_DoIP2SoAd_TxPdu
        SoAdPduRouteDest: SoAdTxSocketConnOrSocketConnBundleRef=SoAdSocketConnection_DOIP_UDP_ANY_remote
      SoAdSocketRoute_DOIP_UDP_TEST_EQUIPMENT_REQUEST_Rx (SoAdSocketRoute): SoAdRxSocketConnOrSocketConnBundleRef=SoAdSocketConnection_DOIP_UDP_ANY_remote
        SoAdSocketRouteDest_1 (SoAdSocketRouteDest): SoAdRxUpperLayerType=IF, SoAdRxPduId=2, SoAdRxPduRef=DoIP_UDP_TEST_EQUIPMENT_REQUEST_SoAd2DoIP_RxPdu
    PduR (SoAdBswModules):
      SoAdIf = true
      SoAdIfTriggerTransmit = false
      SoAdIfTxConfirmation = true
      SoAdLocalIpAddrAssigmentChg = false
      SoAdSoConModeChg = false
      SoAdTp = false
      SoAdUseCallerInfix = true
      SoAdUseTypeInfix = true
      SoAdBswModuleRef = PduR
    DoIP (SoAdBswModules):
      SoAdIf = true
      SoAdIfTriggerTransmit = false
      SoAdIfTxConfirmation = true
      SoAdLocalIpAddrAssigmentChg = true
      SoAdSoConModeChg = true
      SoAdTp = true
      SoAdUseCallerInfix = true
      SoAdUseTypeInfix = true
      SoAdBswModuleRef = DoIP
