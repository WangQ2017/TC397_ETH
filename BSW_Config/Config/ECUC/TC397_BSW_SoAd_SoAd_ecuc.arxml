AUTOSAR XML (schema 00048)
package /ActiveEcuC
  module config SoAd: implementation-config-variant=VARIANT-PRE-COMPILE, module-description=SoAd_Impl
    SoAdGeneral:
      SoAdDevErrorDetect = true
      SoAdVersionInfoApi = false
      SoAdIPv6AddressEnabled = false
      SoAdMainFunctionPeriod = 0.005
      SoAdRoutingGroupMax = 1
      SoAdSoConMax = 1
      SoAdShutdownFinishedWaitTime = 2
      SoAdTcpTlsEnabled = false
      SoAdTxDynamicLengthEnabled = false
      SoAdMainFunctionSplitEnabled = false
      SoAdSafeBswChecks = false
      SoAdGetAndResetMeasurementDataApi = false
      SoAdGeneration:
        SoAdBoolDataInArrayOfStructStrategy = BOOLEAN
        SoAdOutOfBoundsWriteProtectionStrategy = NONE
        SoAdOutOfBoundsWriteSanitizer = false
        SoAdOutOfBoundsReadSanitizer = false
        SoAdReduceConstantData2Define = false
        SoAdDeduplicateIndirectedData = false
        SoAdDataDeduplicationStrategy = NONE
        SoAdReduceBoolDataByNegationThreshold = 0
        SoAdReduceBoolDataByNumericalComparisonThreshold = 0
        SoAdReduceBoolDataByNumericalRelationThreshold = 0
        SoAdReduceBoolDataByNumericalOperandStrategy = NONE
        SoAdReduceNumericalDataByOffsetThreshold = 0
        SoAdReduceNumericalDataByArraySubtractionThreshold = 0
        SoAdReduceDataByStreaming = false
        SoAdShortSymbols = false
        SoAdInterfacesForDeactivatedData = false
        SoAdReferringKeysInComments = false
      SoAdSocketApi: SoAdSocketApiType=AUTOSAR
    SoAdConfig
      SoAdSocketConnectionGroup:
        SoAdPduHeaderEnable = false
        SoAdResourceManagementEnable = false
        SoAdSocketAutomaticSoConSetup = true
        SoAdSocketIpAddrAssignmentChgNotification = false
        SoAdSocketLocalPort = 0
        SoAdSocketMsgAcceptanceFilterEnabled = true
        SoAdSocketSoConModeChgNotification = false
        SoAdBestMatchWithSockRouteEnabled = false
        SoAdBestMatchWithPduHeaderEnabled = false
        SoAdSocketAutomaticSoConSetupKeepOnline = false
        SoAdSocketLocalAddressRef = (unset)
        SoAdSocketConnection: SoAdSocketId=0, SoAdSocketGetReceivedRemoteAddressEnabled=false, SoAdVerifyRxPduEnable=false
          SoAdSocketRemoteAddress: SoAdSocketRemoteIpAddress=, SoAdSocketRemotePort=0, SoAdSocketRemoteIpAddressNotSet=false, SoAdSocketRemotePortNotSet=false
        SoAdSocketProtocol
