AUTOSAR XML (schema 00048)
package /ActiveEcuC
  module config SoAd: implementation-config-variant=VARIANT-PRE-COMPILE, module-description=SoAd_Impl
    SoAdGeneral:
      SoAdDevErrorDetect = true
      SoAdVersionInfoApi = false
      SoAdIPv6AddressEnabled = false
      SoAdMainFunctionPeriod = 0.005
      SoAdRoutingGroupMax = 1
      SoAdSoConMax = 1
      SoAdShutdownFinishedWaitTime = 2
      SoAdTcpTlsEnabled = false
      SoAdTxDynamicLengthEnabled = false
      SoAdMainFunctionSplitEnabled = false
      SoAdSafeBswChecks = false
      SoAdGetAndResetMeasurementDataApi = false
      SoAdGeneration:
        SoAdBoolDataInArrayOfStructStrategy = BOOLEAN
        SoAdOutOfBoundsWriteProtectionStrategy = NONE
        SoAdOutOfBoundsWriteSanitizer = false
        SoAdOutOfBoundsReadSanitizer = false
        SoAdReduceConstantData2Define = false
        SoAdDeduplicateIndirectedData = false
        SoAdDataDeduplicationStrategy = NONE
        SoAdReduceBoolDataByNegationThreshold = 0
        SoAdReduceBoolDataByNumericalComparisonThreshold = 0
        SoAdReduceBoolDataByNumericalRelationThreshold = 0
        SoAdReduceBoolDataByNumericalOperandStrategy = NONE
        SoAdReduceNumericalDataByOffsetThreshold = 0
        SoAdReduceNumericalDataByArraySubtractionThreshold = 0
        SoAdReduceDataByStreaming = false
        SoAdShortSymbols = false
        SoAdInterfacesForDeactivatedData = false
        SoAdReferringKeysInComments = false
      SoAdSocketApi: SoAdSocketApiType=AUTOSAR
    SoAdConfig
      SCG_UDP_fixed_192_168_1_123_4567 (SoAdSocketConnectionGroup):
        SoAdPduHeaderEnable = false
        SoAdResourceManagementEnable = false
        SoAdSocketAutomaticSoConSetup = true
        SoAdSocketIpAddrAssignmentChgNotification = false
        SoAdSocketLocalPort = 4567
        SoAdSocketMsgAcceptanceFilterEnabled = true
        SoAdSocketSoConModeChgNotification = false
        SoAdBestMatchWithSockRouteEnabled = false
        SoAdBestMatchWithPduHeaderEnabled = false
        SoAdSocketAutomaticSoConSetupKeepOnline = false
        SoAdSocketLocalAddressRef = TcpIpLocalAddr_NE_Fixed_192_168_1_123
        SoAdSocketConnection: SoAdSocketId=0, SoAdSocketGetReceivedRemoteAddressEnabled=false, SoAdVerifyRxPduEnable=false
          SC_UDP_fixed_192_168_1_123_4567 (SoAdSocketRemoteAddress): SoAdSocketRemoteIpAddress=255.255.255.255, SoAdSocketRemotePort=4567, SoAdSocketRemoteIpAddressNotSet=false, SoAdSocketRemotePortNotSet=false
        SoAdSocketProtocol
          SoAdSocketUdp:
            SoAdSocketUdpListenOnly = false
            SoAdSocketUdpStrictHeaderLenCheckEnabled = false
            SoAdSocketUdpAddressResolutionRetryEnabled = true
            SoAdSocketUdpImmediateIfTxConfirmation = false
            SoAdSocketUdpAddressResolutionRetryQueueLimit = 1
      SoAdPduRoute_udplog_Tx (SoAdPduRoute): SoAdTxPduId=1, SoAdTxUpperLayerType=IF, SoAdTxIfOptimized=false, SoAdTxIfTriggerTransmit=false, SoAdTxPduRef=udplog_TxPdu_SoAd
        SoAdPduRouteDest: SoAdTxSocketConnOrSocketConnBundleRef=SCG_UDP_fixed_192_168_1_123_4567
      SoAdPduRoute_TimeSyncStatus_Tx (SoAdPduRoute): SoAdTxPduId=0, SoAdTxUpperLayerType=IF, SoAdTxIfTriggerTransmit=false, SoAdTxIfOptimized=false, SoAdTxPduRef=TimeSyncStatus_TxPdu_SoAd
        SoAdPduRouteDest: SoAdTxSocketConnOrSocketConnBundleRef=SCG_UDP_fixed_192_168_1_123_4567
    PduR (SoAdBswModules):
      SoAdIf = true
      SoAdIfTriggerTransmit = false
      SoAdIfTxConfirmation = true
      SoAdLocalIpAddrAssigmentChg = false
      SoAdSoConModeChg = false
      SoAdTp = false
      SoAdUseCallerInfix = true
      SoAdUseTypeInfix = true
      SoAdBswModuleRef = PduR
