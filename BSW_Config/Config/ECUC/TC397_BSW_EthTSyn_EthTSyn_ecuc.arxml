AUTOSAR XML (schema 00048)
package /ActiveEcuC
  module config EthTSyn: implementation-config-variant=VARIANT-PRE-COMPILE, module-description=EthTSyn_Impl
    EthTSynGeneral:
      EthTSynDestPhyAddr = 01:80:C2:00:00:0E
      EthTSynDevErrorDetect = true
      EthTSynHardwareTimestampSupport = false
      EthTSynMainFunctionPeriod = 0.005
      EthTSynMasterSlaveConflictDetection = false
      EthTSynMessageCompliance = false
      EthTSynVersionInfoApi = false
      EthTSynEnableSwitchMgmt = false
      EthTSynSafeBswChecks = false
      EthTSynEthIfFrameType = (unset)
    EthTSynGlobalTimeDomain:
      EthTSynGlobalTimeDomainId = 0
      EthTSynIsOffsetTimeDomain = false
      EthTSynEnableTimeValidation = false
      EthTSynSynchronizedTimeBaseRef = StbMSynchronizedTimeBase
      EthTSynPortConfig: EthTSynGlobalTimeDebounceTime=0.01, EthTSynPortNumber=0, EthTSynFramePrio=7, EthTSynGlobalTimeEthIfRef=EthIfController
        EthTSynPortRole
