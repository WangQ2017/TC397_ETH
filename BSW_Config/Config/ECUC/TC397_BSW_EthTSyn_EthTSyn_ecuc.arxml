AUTOSAR XML (schema 00048)
package /ActiveEcuC
  module config EthTSyn: implementation-config-variant=VARIANT-PRE-COMPILE, module-description=EthTSyn_Impl
    EthTSynGeneral:
      EthTSynDestPhyAddr = 01:80:C2:00:00:0E
      EthTSynDevErrorDetect = true
      EthTSynHardwareTimestampSupport = true
      EthTSynMainFunctionPeriod = 0.005
      EthTSynMasterSlaveConflictDetection = false
      EthTSynMessageCompliance = false
      EthTSynVersionInfoApi = false
      EthTSynEnableSwitchMgmt = false
      EthTSynSafeBswChecks = false
      EthTSynEthIfFrameType = EthTSyn_EthTSyn
    EthTSynGlobalTimeDomain:
      EthTSynGlobalTimeDomainId = 0
      EthTSynIsOffsetTimeDomain = false
      EthTSynEnableTimeValidation = false
      EthTSynSynchronizedTimeBaseRef = StbMSynchronizedTimeBase
      EthTSynPortConfig: EthTSynGlobalTimeDebounceTime=0.01, EthTSynPortNumber=1, EthTSynFramePrio=7, EthTSynGlobalTimeEthIfRef=EthIfController_Vlan10
        EthTSynPdelayConfig:
          EthTSynGlobalTimePdelayRespEnable = true
          EthTSynGlobalTimePropagationDelay = 0.000006
          EthTSynGlobalTimeTxPdelayReqPeriod = 1
          EthTSynPdelayRespAndRespFollowUpTimeout = 0
          EthTSynUseStaticPdelay = false
          EthTSynAlwaysAsCapable = true
        EthTSynPortRole
          EthTSynGlobalTimeSlave: EthTSynGlobalTimeFollowUpTimeout=0.125, EthTSynRxCrcValidated=CRC_IGNORED, EthTSynEnableAnnounce=false, EthTSynEnableSourcePortIdentityCheck=false
