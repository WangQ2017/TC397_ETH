AUTOSAR XML (schema 00048)
package /ActiveEcuC
  module config EthTSyn: implementation-config-variant=VARIANT-PRE-COMPILE, module-description=EthTSyn_Impl
    EthTSynGeneral:
      EthTSynDestPhyAddr = 01:80:C2:00:00:0E
      EthTSynDevErrorDetect = true
      EthTSynHardwareTimestampSupport = true
      EthTSynMainFunctionPeriod = 0.005
      EthTSynMasterSlaveConflictDetection = true
      EthTSynMessageCompliance = false
      EthTSynVersionInfoApi = false
      EthTSynEnableSwitchMgmt = false
      EthTSynSafeBswChecks = false
      EthTSynEthIfFrameType = EthIfFrameOwnerConfig_EthTsyn
    EthTSynGlobalTimeDomain_MAIN0 (EthTSynGlobalTimeDomain):
      EthTSynGlobalTimeDomainId = 0
      EthTSynIsOffsetTimeDomain = false
      EthTSynEnableTimeValidation = false
      EthTSynSynchronizedTimeBaseRef = StbMSynchronizedTimeBase_MAIN0
      EthTSynPortConfig: EthTSynGlobalTimeDebounceTime=0.01, EthTSynPortNumber=1, EthTSynGlobalTimeEthIfRef=EthIfController_untagged
        EthTSynPortRole
          EthTSynGlobalTimeSlave: EthTSynGlobalTimeFollowUpTimeout=0.1, EthTSynRxCrcValidated=CRC_IGNORED, EthTSynEnableAnnounce=false, EthTSynEnableSourcePortIdentityCheck=false
        EthTSynPdelayConfig:
          EthTSynGlobalTimePdelayRespEnable = true
          EthTSynGlobalTimePropagationDelay = 0.000006
          EthTSynGlobalTimeTxPdelayReqPeriod = 1
          EthTSynPdelayRespAndRespFollowUpTimeout = 0.1
          EthTSynUseStaticPdelay = false
          EthTSynAlwaysAsCapable = true
          EthTSynPdelayLatencyThreshold = 0.001
          EthTSynPdelayReqAllowedLostResponses = 1
    EthTSynGlobalTimeDomain_MAIN6 (EthTSynGlobalTimeDomain):
      EthTSynGlobalTimeDomainId = 6
      EthTSynIsOffsetTimeDomain = false
      EthTSynEnableTimeValidation = false
      EthTSynSynchronizedTimeBaseRef = StbMSynchronizedTimeBase_MAIN6
      EthTSynPortConfig: EthTSynGlobalTimeDebounceTime=0.01, EthTSynPortNumber=1, EthTSynGlobalTimeEthIfRef=EthIfController_untagged
        EthTSynPortRole
          EthTSynGlobalTimeMaster:
            EthTSynCyclicMsgResumeTime = 0.9
            EthTSynGlobalTimeTxCrcSecured = CRC_NOT_SUPPORTED
            EthTSynGlobalTimeTxPeriod = 0.125
            EthTSynImmediateTimeSync = true
            EthTSynTLVFollowUpOFSSubTLV = false
            EthTSynTLVFollowUpStatusSubTLV = false
            EthTSynTLVFollowUpTimeSubTLV = false
            EthTSynTLVFollowUpUserDataSubTLV = false
            EthTSynTxAnnounce = false
