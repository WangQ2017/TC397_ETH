AUTOSAR XML (schema 00048)
package /ActiveEcuC
  module config TcpIp: implementation-config-variant=VARIANT-PRE-COMPILE, module-description=TcpIp_Impl
    TcpIpGeneral:
      TcpIpBufferMemory = 0
      TcpIpDevErrorDetect = true
      TcpIpDhcpServerEnabled = false
      TcpIpMainFunctionPeriod = 0.005
      TcpIpResetIpAssignmentApi = false
      TcpIpScalabilityClass = SC1
      TcpIpTcpEnabled = false
      TcpIpTcpSocketMax = 0
      TcpIpUdpEnabled = true
      TcpIpUdpSocketMax = 2
      TcpIpVersionInfoApi = false
      TcpIpRandNoFct = Appl_Crypto_GetRandNo
      TcpIpRandNoFctIncludeFile = Appl_Rand.h
      TcpIpDiagExtensionsEnabled = false
      TcpIpLowerLayerName = EthIf
      TcpIpMainFunctionSplitEnabled = false
      TcpIpSafeBswChecks = false
      TcpIpGetDhcpStatusApi = false
      TcpIpIpSecEnabled = false
      TcpIpGetAndResetMeasurementDataApi = false
      TcpIpGeneration:
        TcpIpBoolDataInArrayOfStructStrategy = BOOLEAN
        TcpIpOutOfBoundsWriteProtectionStrategy = NONE
        TcpIpOutOfBoundsWriteSanitizer = false
        TcpIpOutOfBoundsReadSanitizer = false
        TcpIpReduceConstantData2Define = false
        TcpIpDeduplicateIndirectedData = true
        TcpIpDataDeduplicationStrategy = NONE
        TcpIpReduceBoolDataByNegationThreshold = 2
        TcpIpReduceBoolDataByNumericalComparisonThreshold = 2
        TcpIpReduceBoolDataByNumericalRelationThreshold = 2
        TcpIpReduceBoolDataByNumericalOperandStrategy = DEDUPLICATE_DATA_WITH_ANY_VALUE
        TcpIpReduceNumericalDataByOffsetThreshold = 0
        TcpIpReduceNumericalDataByArraySubtractionThreshold = 2
        TcpIpReduceDataByStreaming = false
        TcpIpShortSymbols = false
        TcpIpInterfacesForDeactivatedData = false
        TcpIpReferringKeysInComments = false
      TcpIpIpV4General:
        TcpIpArpEnabled = true
        TcpIpAutoIpEnabled = false
        TcpIpDhcpClientEnabled = false
        TcpIpIcmpEnabled = true
        TcpIpIpV4Enabled = true
        TcpIpPathMtuDiscoveryEnabled = false
        TcpIpIpV4EthIfUpdatePhysAddrFilterApiEnabled = true
        TcpIpArpDiscardedEntryHandling = false
        TcpIpLocalAddrIpv4EntriesMax = 3
      TcpIpIpV6General:
        TcpIpDhcpV6ClientEnabled = false
        TcpIpIpV6Enabled = false
        TcpIpIpV6PathMtuDiscoveryEnabled = false
        TcpIpLocalAddrIpv6EntriesMax = 0
        TcpIpNdpAddressResolutionUnrechabilityDetectionEnabled = true
        TcpIpNdpPrefixAndRouterDiscoveryEnabled = true
        TcpIpIpV6EthIfUpdatePhysAddrFilterApiEnabled = true
        TcpIpIpV6SetTrafficClassAndFlowLabelApiEnabled = false
        TcpIpIpV6ExtendedDestAddrValidationEnabled = false
        TcpIpIpV6CacheLookupOptimizationEnabled = true
    TcpIpConfig
      TcpIpCtrl_Vlan10 (TcpIpCtrl): TcpIpIpFramePrioDefault=0, TcpIpEthIfCtrlRef=EthIfController_Untagged
        TcpIpIpVXCtrl
          TcpIpIpV4Ctrl: TcpIpIpTypeOfServiceDefault=0, TcpIpIpCtrlIdx=0, TcpIpIpDefaultTtl=64, TcpIpArpConfigRef=TcpIpArpConfig
      TcpIpLocalAddr_NE_Fixed_10_10_0_33 (TcpIpLocalAddr):
        TcpIpAddrId = 0
        TcpIpAddressType = TCPIP_UNICAST
        TcpIpDomainType = TCPIP_AF_INET
        TcpIpIpAddrReceiveAllNotConfiguredMulticasts = false
        TcpIpCtrlRef = TcpIpCtrl_Vlan10
        TcpIpAddrAssignment: TcpIpAssignmentMethod=TCPIP_STATIC, TcpIpAssignmentPriority=1, TcpIpAssignmentTrigger=TCPIP_AUTOMATIC, TcpIpAssignmentLifetime=TCPIP_FORGET
        TcpIpStaticIpAddressConfig: TcpIpStaticIpAddress=10.10.0.33, TcpIpNetmask=24
      TcpIpSocketOwnerConfig
        SoAd (TcpIpSocketOwner):
          TcpIpSocketOwnerUpperLayerType = SOAD
          TcpIpSocketOwnerId = 0
          TcpIpSocketOwnerTcpIpEventName = SoAd_TcpIpEvent
          TcpIpSocketOwnerTcpListenSocketMax = 0
          TcpIpSocketOwnerCopyTxDataDynamicLengthEnabled = false
          TcpIpSocketOwnerCopyTxDataName = SoAd_CopyTxData
          TcpIpSocketOwnerHeaderFileName = SoAd_Cbk.h
          TcpIpSocketOwnerLocalIpAddrAssignmentChgName = SoAd_LocalIpAddrAssignmentChg
          TcpIpSocketOwnerRxIndicationName = SoAd_RxIndication
          TcpIpSocketOwnerTcpAcceptedName = SoAd_TcpAccepted
          TcpIpSocketOwnerTcpConnectedName = SoAd_TcpConnected
          TcpIpSocketOwnerTxConfirmationName = SoAd_TxConfirmation
      TcpIpIpConfig
        TcpIpIpV4Config
          TcpIpArpConfig:
            TcpIpArpNumGratuitousARPonStartup = 0
            TcpIpArpPacketQueueEnabled = true
            TcpIpArpTableEntryTimeout = 30
            TcpIpArpTableSizeMax = 10
            TcpIpArpRetryTime = 5
            TcpIpArpRetryInterval = 2
            TcpIpArpRequestTimeout = 0.1
          TcpIpIcmpConfig: TcpIpIcmpTtl=64, TcpIpIcmpEchoReplyMaxLen=32, TcpIpIcmpDestinationUnreachableEnabled=true
      TcpIpUdpConfig: TcpIpUdpTtl=64, TcpIpUdpTxRetryQueueSize=3
      TcpIpLocalAddr_TcpIpCtrl_Vlan10_Broadcast (TcpIpLocalAddr):
        TcpIpAddrId = 2
        TcpIpAddressType = TCPIP_IPV4_BROADCAST
        TcpIpDomainType = TCPIP_AF_INET
        TcpIpIpAddrReceiveAllNotConfiguredMulticasts = false
        TcpIpCtrlRef = TcpIpCtrl_Vlan10
        TcpIpAddrAssignment: TcpIpAssignmentMethod=TCPIP_STATIC, TcpIpAssignmentPriority=1, TcpIpAssignmentTrigger=TCPIP_AUTOMATIC
      TcpIpLocalAddr_NE_Multicast_Rx_fixed_239_10_0_1 (TcpIpLocalAddr):
        TcpIpAddrId = 1
        TcpIpAddressType = TCPIP_MULTICAST
        TcpIpDomainType = TCPIP_AF_INET
        TcpIpIpAddrReceiveAllNotConfiguredMulticasts = false
        TcpIpCtrlRef = TcpIpCtrl_Vlan10
        TcpIpAddrAssignment: TcpIpAssignmentMethod=TCPIP_STATIC, TcpIpAssignmentPriority=1, TcpIpAssignmentTrigger=TCPIP_AUTOMATIC
        TcpIpStaticIpAddressConfig: TcpIpStaticIpAddress=239.10.0.1
