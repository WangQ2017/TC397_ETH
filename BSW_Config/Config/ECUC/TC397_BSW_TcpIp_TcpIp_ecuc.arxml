AUTOSAR XML (schema 00048)
package /ActiveEcuC
  module config TcpIp: implementation-config-variant=VARIANT-PRE-COMPILE, module-description=TcpIp_Impl
    TcpIpGeneral:
      TcpIpBufferMemory = 0
      TcpIpDevErrorDetect = (unset)
      TcpIpDhcpServerEnabled = false
      TcpIpMainFunctionPeriod = 0.005
      TcpIpResetIpAssignmentApi = false
      TcpIpScalabilityClass = SC1
      TcpIpTcpEnabled = false
      TcpIpTcpSocketMax = 0
      TcpIpUdpEnabled = true
      TcpIpUdpSocketMax = 0
      TcpIpVersionInfoApi = (unset)
      TcpIpRandNoFct = Appl_Crypto_GetRandNo
      TcpIpRandNoFctIncludeFile = Appl_Rand.h
      TcpIpDiagExtensionsEnabled = false
      TcpIpLowerLayerName = EthIf
      TcpIpMainFunctionSplitEnabled = false
      TcpIpSafeBswChecks = false
      TcpIpGetDhcpStatusApi = false
      TcpIpIpSecEnabled = false
      TcpIpGetAndResetMeasurementDataApi = false
      TcpIpGeneration:
        TcpIpBoolDataInArrayOfStructStrategy = BOOLEAN
        TcpIpOutOfBoundsWriteProtectionStrategy = NONE
        TcpIpOutOfBoundsWriteSanitizer = false
        TcpIpOutOfBoundsReadSanitizer = false
        TcpIpReduceConstantData2Define = false
        TcpIpDeduplicateIndirectedData = true
        TcpIpDataDeduplicationStrategy = NONE
        TcpIpReduceBoolDataByNegationThreshold = 2
        TcpIpReduceBoolDataByNumericalComparisonThreshold = 2
        TcpIpReduceBoolDataByNumericalRelationThreshold = 2
        TcpIpReduceBoolDataByNumericalOperandStrategy = DEDUPLICATE_DATA_WITH_ANY_VALUE
        TcpIpReduceNumericalDataByOffsetThreshold = 0
        TcpIpReduceNumericalDataByArraySubtractionThreshold = 2
        TcpIpReduceDataByStreaming = false
        TcpIpShortSymbols = false
        TcpIpInterfacesForDeactivatedData = false
        TcpIpReferringKeysInComments = false
      TcpIpIpV4General:
        TcpIpArpEnabled = true
        TcpIpAutoIpEnabled = false
        TcpIpDhcpClientEnabled = false
        TcpIpIcmpEnabled = true
        TcpIpIpV4Enabled = false
        TcpIpLocalAddrIpv4EntriesMax = (unset)
        TcpIpPathMtuDiscoveryEnabled = (unset)
        TcpIpIpV4EthIfUpdatePhysAddrFilterApiEnabled = true
        TcpIpArpDiscardedEntryHandling = false
      TcpIpIpV6General:
        TcpIpDhcpV6ClientEnabled = false
        TcpIpIpV6Enabled = false
        TcpIpIpV6PathMtuDiscoveryEnabled = false
        TcpIpLocalAddrIpv6EntriesMax = (unset)
        TcpIpNdpAddressResolutionUnrechabilityDetectionEnabled = (unset)
        TcpIpNdpPrefixAndRouterDiscoveryEnabled = (unset)
        TcpIpIpV6EthIfUpdatePhysAddrFilterApiEnabled = true
        TcpIpIpV6SetTrafficClassAndFlowLabelApiEnabled = false
        TcpIpIpV6ExtendedDestAddrValidationEnabled = false
        TcpIpIpV6CacheLookupOptimizationEnabled = true
    TcpIpConfig
      TcpIpCtrl: TcpIpEthIfCtrlRef=(unset)
        TcpIpIpVXCtrl
      TcpIpLocalAddr: TcpIpAddrId=0, TcpIpAddressType=(unset), TcpIpDomainType=(unset), TcpIpIpAddrReceiveAllNotConfiguredMulticasts=false, TcpIpCtrlRef=(unset)
        TcpIpAddrAssignment: TcpIpAssignmentMethod=(unset), TcpIpAssignmentPriority=1, TcpIpAssignmentTrigger=TCPIP_AUTOMATIC
      TcpIpSocketOwnerConfig
        TcpIpSocketOwner:
          TcpIpSocketOwnerUpperLayerType = (unset)
          TcpIpSocketOwnerId = 0
          TcpIpSocketOwnerTcpIpEventName = 
          TcpIpSocketOwnerTcpListenSocketMax = 0
          TcpIpSocketOwnerCopyTxDataDynamicLengthEnabled = false
