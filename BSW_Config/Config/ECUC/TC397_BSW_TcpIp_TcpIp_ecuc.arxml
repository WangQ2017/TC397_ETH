AUTOSAR XML (schema 00048)
package /ActiveEcuC
  module config TcpIp: implementation-config-variant=VARIANT-PRE-COMPILE, module-description=TcpIp_Impl
    TcpIpGeneral:
      TcpIpBufferMemory = 0
      TcpIpDevErrorDetect = true
      TcpIpDhcpServerEnabled = false
      TcpIpMainFunctionPeriod = 0.005
      TcpIpResetIpAssignmentApi = false
      TcpIpScalabilityClass = SC1
      TcpIpTcpEnabled = false
      TcpIpTcpSocketMax = 0
      TcpIpUdpEnabled = true
      TcpIpUdpSocketMax = 1
      TcpIpVersionInfoApi = false
      TcpIpRandNoFct = Appl_Crypto_GetRandNo
      TcpIpRandNoFctIncludeFile = Appl_Rand.h
      TcpIpDiagExtensionsEnabled = false
      TcpIpLowerLayerName = EthIf
      TcpIpMainFunctionSplitEnabled = false
      TcpIpSafeBswChecks = false
      TcpIpGetDhcpStatusApi = false
      TcpIpIpSecEnabled = false
      TcpIpGetAndResetMeasurementDataApi = false
      TcpIpGeneration:
        TcpIpBoolDataInArrayOfStructStrategy = BOOLEAN
        TcpIpOutOfBoundsWriteProtectionStrategy = NONE
        TcpIpOutOfBoundsWriteSanitizer = false
        TcpIpOutOfBoundsReadSanitizer = false
        TcpIpReduceConstantData2Define = false
        TcpIpDeduplicateIndirectedData = true
        TcpIpDataDeduplicationStrategy = NONE
        TcpIpReduceBoolDataByNegationThreshold = 2
        TcpIpReduceBoolDataByNumericalComparisonThreshold = 2
        TcpIpReduceBoolDataByNumericalRelationThreshold = 2
        TcpIpReduceBoolDataByNumericalOperandStrategy = DEDUPLICATE_DATA_WITH_ANY_VALUE
        TcpIpReduceNumericalDataByOffsetThreshold = 0
        TcpIpReduceNumericalDataByArraySubtractionThreshold = 2
        TcpIpReduceDataByStreaming = false
        TcpIpShortSymbols = false
        TcpIpInterfacesForDeactivatedData = false
        TcpIpReferringKeysInComments = false
      TcpIpIpV4General:
        TcpIpArpEnabled = true
        TcpIpAutoIpEnabled = false
        TcpIpDhcpClientEnabled = false
        TcpIpIcmpEnabled = false
        TcpIpIpV4Enabled = true
        TcpIpLocalAddrIpv4EntriesMax = 2
        TcpIpPathMtuDiscoveryEnabled = false
        TcpIpIpV4EthIfUpdatePhysAddrFilterApiEnabled = true
        TcpIpArpDiscardedEntryHandling = false
      TcpIpIpV6General:
        TcpIpDhcpV6ClientEnabled = false
        TcpIpIpV6Enabled = false
        TcpIpIpV6PathMtuDiscoveryEnabled = false
        TcpIpLocalAddrIpv6EntriesMax = 0
        TcpIpNdpAddressResolutionUnrechabilityDetectionEnabled = true
        TcpIpNdpPrefixAndRouterDiscoveryEnabled = true
        TcpIpIpV6EthIfUpdatePhysAddrFilterApiEnabled = true
        TcpIpIpV6SetTrafficClassAndFlowLabelApiEnabled = false
        TcpIpIpV6ExtendedDestAddrValidationEnabled = false
        TcpIpIpV6CacheLookupOptimizationEnabled = true
    TcpIpConfig
      TcpIpCtrl_untagged (TcpIpCtrl): TcpIpIpFramePrioDefault=0, TcpIpEthIfCtrlRef=EthIfController_untagged
        TcpIpIpVXCtrl
          TcpIpIpV4Ctrl: TcpIpIpTypeOfServiceDefault=0, TcpIpIpCtrlIdx=0, TcpIpIpDefaultTtl=64, TcpIpArpConfigRef=TcpIpArpConfig
      TcpIpLocalAddr_NE_Fixed_192_168_1_123 (TcpIpLocalAddr):
        TcpIpAddrId = 0
        TcpIpAddressType = TCPIP_UNICAST
        TcpIpDomainType = TCPIP_AF_INET
        TcpIpIpAddrReceiveAllNotConfiguredMulticasts = false
        TcpIpCtrlRef = TcpIpCtrl_untagged
        TcpIpAddrAssignment: TcpIpAssignmentMethod=TCPIP_STATIC, TcpIpAssignmentPriority=1, TcpIpAssignmentTrigger=TCPIP_AUTOMATIC
        TcpIpStaticIpAddressConfig: TcpIpStaticIpAddress=192.168.1.123, TcpIpNetmask=24
      TcpIpSocketOwnerConfig
        SoAd (TcpIpSocketOwner):
          TcpIpSocketOwnerUpperLayerType = SOAD
          TcpIpSocketOwnerId = 0
          TcpIpSocketOwnerTcpIpEventName = SoAd_TcpIpEvent
          TcpIpSocketOwnerTcpListenSocketMax = 0
          TcpIpSocketOwnerCopyTxDataDynamicLengthEnabled = false
          TcpIpSocketOwnerTcpConnectedName = SoAd_TcpConnected
          TcpIpSocketOwnerHeaderFileName = SoAd_Cbk.h
          TcpIpSocketOwnerLocalIpAddrAssignmentChgName = SoAd_LocalIpAddrAssignmentChg
          TcpIpSocketOwnerRxIndicationName = SoAd_RxIndication
          TcpIpSocketOwnerCopyTxDataName = SoAd_CopyTxData
          TcpIpSocketOwnerTcpAcceptedName = SoAd_TcpAccepted
          TcpIpSocketOwnerTxConfirmationName = SoAd_TxConfirmation
      TcpIpIpConfig
        TcpIpIpV4Config
          TcpIpArpConfig:
            TcpIpArpNumGratuitousARPonStartup = 0
            TcpIpArpPacketQueueEnabled = true
            TcpIpArpTableEntryTimeout = 30
            TcpIpArpTableSizeMax = 10
            TcpIpArpRetryTime = 5
            TcpIpArpRetryInterval = 2
            TcpIpArpRequestTimeout = 1
      TcpIpV4LocalAddr_TcpIpCtrl_untagged_Broadcast (TcpIpLocalAddr):
        TcpIpAddrId = 1
        TcpIpAddressType = TCPIP_IPV4_BROADCAST
        TcpIpDomainType = TCPIP_AF_INET
        TcpIpIpAddrReceiveAllNotConfiguredMulticasts = false
        TcpIpCtrlRef = TcpIpCtrl_untagged
        TcpIpAddrAssignment: TcpIpAssignmentMethod=TCPIP_STATIC, TcpIpAssignmentPriority=1, TcpIpAssignmentTrigger=TCPIP_AUTOMATIC
      TcpIpUdpConfig: TcpIpUdpTtl=64, TcpIpUdpTxRetryQueueSize=1
