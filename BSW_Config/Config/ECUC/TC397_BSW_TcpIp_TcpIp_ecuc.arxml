AUTOSAR XML (schema 00048)
package /ActiveEcuC
  module config TcpIp: implementation-config-variant=VARIANT-PRE-COMPILE, module-description=TcpIp_Impl
    TcpIpGeneral:
      TcpIpBufferMemory = 4096
      TcpIpDevErrorDetect = true
      TcpIpDhcpServerEnabled = false
      TcpIpMainFunctionPeriod = 0.005
      TcpIpResetIpAssignmentApi = false
      TcpIpScalabilityClass = SC1
      TcpIpTcpEnabled = true
      TcpIpTcpSocketMax = 6
      TcpIpUdpEnabled = true
      TcpIpUdpSocketMax = 7
      TcpIpVersionInfoApi = false
      TcpIpRandNoFct = Appl_Crypto_GetRandNo
      TcpIpRandNoFctIncludeFile = Appl_Rand.h
      TcpIpDiagExtensionsEnabled = false
      TcpIpLowerLayerName = EthIf
      TcpIpMainFunctionSplitEnabled = false
      TcpIpSafeBswChecks = false
      TcpIpGetDhcpStatusApi = false
      TcpIpIpSecEnabled = false
      TcpIpGetAndResetMeasurementDataApi = false
      TcpIpGeneration:
        TcpIpBoolDataInArrayOfStructStrategy = BOOLEAN
        TcpIpOutOfBoundsWriteProtectionStrategy = NONE
        TcpIpOutOfBoundsWriteSanitizer = false
        TcpIpOutOfBoundsReadSanitizer = false
        TcpIpReduceConstantData2Define = false
        TcpIpDeduplicateIndirectedData = true
        TcpIpDataDeduplicationStrategy = NONE
        TcpIpReduceBoolDataByNegationThreshold = 2
        TcpIpReduceBoolDataByNumericalComparisonThreshold = 2
        TcpIpReduceBoolDataByNumericalRelationThreshold = 2
        TcpIpReduceBoolDataByNumericalOperandStrategy = DEDUPLICATE_DATA_WITH_ANY_VALUE
        TcpIpReduceNumericalDataByOffsetThreshold = 0
        TcpIpReduceNumericalDataByArraySubtractionThreshold = 2
        TcpIpReduceDataByStreaming = false
        TcpIpShortSymbols = false
        TcpIpInterfacesForDeactivatedData = false
        TcpIpReferringKeysInComments = false
      TcpIpIpV4General:
        TcpIpArpEnabled = true
        TcpIpAutoIpEnabled = false
        TcpIpDhcpClientEnabled = true
        TcpIpIcmpEnabled = true
        TcpIpIpV4Enabled = true
        TcpIpPathMtuDiscoveryEnabled = false
        TcpIpIpV4EthIfUpdatePhysAddrFilterApiEnabled = true
        TcpIpArpDiscardedEntryHandling = false
        TcpIpLocalAddrIpv4EntriesMax = 9
      TcpIpIpV6General:
        TcpIpDhcpV6ClientEnabled = false
        TcpIpIpV6Enabled = false
        TcpIpIpV6PathMtuDiscoveryEnabled = false
        TcpIpLocalAddrIpv6EntriesMax = 0
        TcpIpNdpAddressResolutionUnrechabilityDetectionEnabled = true
        TcpIpNdpPrefixAndRouterDiscoveryEnabled = true
        TcpIpIpV6EthIfUpdatePhysAddrFilterApiEnabled = true
        TcpIpIpV6SetTrafficClassAndFlowLabelApiEnabled = false
        TcpIpIpV6ExtendedDestAddrValidationEnabled = false
        TcpIpIpV6CacheLookupOptimizationEnabled = true
    TcpIpConfig
      TcpIpCtrl_Vlan10 (TcpIpCtrl): TcpIpIpFramePrioDefault=0, TcpIpEthIfCtrlRef=EthIfController_Vlan10
        TcpIpIpVXCtrl
          TcpIpIpV4Ctrl_Vlan10 (TcpIpIpV4Ctrl): TcpIpIpTypeOfServiceDefault=0, TcpIpIpCtrlIdx=0, TcpIpIpDefaultTtl=64, TcpIpArpConfigRef=TcpIpArpConfig
      TcpIpLocalAddr_NE_Fixed_10_10_0_33 (TcpIpLocalAddr):
        TcpIpAddrId = 0
        TcpIpAddressType = TCPIP_UNICAST
        TcpIpDomainType = TCPIP_AF_INET
        TcpIpIpAddrReceiveAllNotConfiguredMulticasts = false
        TcpIpCtrlRef = TcpIpCtrl_Vlan10
        TcpIpAddrAssignment: TcpIpAssignmentMethod=TCPIP_STATIC, TcpIpAssignmentPriority=1, TcpIpAssignmentTrigger=TCPIP_AUTOMATIC, TcpIpAssignmentLifetime=TCPIP_FORGET
        TcpIpStaticIpAddressConfig: TcpIpStaticIpAddress=10.10.0.33, TcpIpNetmask=24
      TcpIpSocketOwnerConfig
        SoAd (TcpIpSocketOwner):
          TcpIpSocketOwnerUpperLayerType = SOAD
          TcpIpSocketOwnerId = 0
          TcpIpSocketOwnerTcpIpEventName = SoAd_TcpIpEvent
          TcpIpSocketOwnerTcpListenSocketMax = 2
          TcpIpSocketOwnerCopyTxDataDynamicLengthEnabled = false
          TcpIpSocketOwnerCopyTxDataName = SoAd_CopyTxData
          TcpIpSocketOwnerHeaderFileName = SoAd_Cbk.h
          TcpIpSocketOwnerLocalIpAddrAssignmentChgName = SoAd_LocalIpAddrAssignmentChg
          TcpIpSocketOwnerRxIndicationName = SoAd_RxIndication
          TcpIpSocketOwnerTcpAcceptedName = SoAd_TcpAccepted
          TcpIpSocketOwnerTcpConnectedName = SoAd_TcpConnected
          TcpIpSocketOwnerTxConfirmationName = SoAd_TxConfirmation
      TcpIpIpConfig
        TcpIpIpV4Config
          TcpIpArpConfig:
            TcpIpArpNumGratuitousARPonStartup = 5
            TcpIpArpPacketQueueEnabled = true
            TcpIpArpTableEntryTimeout = 30
            TcpIpArpTableSizeMax = 10
            TcpIpArpRetryTime = 5
            TcpIpArpRetryInterval = 2
            TcpIpArpRequestTimeout = 0.1
          TcpIpIcmpConfig: TcpIpIcmpTtl=64, TcpIpIcmpEchoReplyMaxLen=32, TcpIpIcmpDestinationUnreachableEnabled=true
          TcpIpDhcpConfig:
            TcpIpDhcpV4InitWaitMin = 0.1
            TcpIpDhcpV4InitWaitMax = 0.8
            TcpIpDhcpV4DiscoverMaxNum = 5
            TcpIpDhcpV4DiscoverIntervalMin = 2
            TcpIpDhcpV4DiscoverIntervalMax = 30
            TcpIpDhcpV4RequestMaxNum = 6
            TcpIpDhcpV4RequestInterval = 2
            TcpIpDhcpV4RenewIntervalMin = 5
            TcpIpDhcpV4RebindIntervalMin = 5
            TcpIpDhcpV4HostNameLenMax = 30
            TcpIpDhcpV4RestartOnFail = false
          TcpIpIpFragmentationConfig:
            TcpIpIpFragmentationRxEnabled = true
            TcpIpIpMaxReassDgramSize = 4460
            TcpIpIpReassInOrderEnabled = false
            TcpIpIpMaxTxDgramSize = 4460
            TcpIpIpNumFragments = 3
            TcpIpIpReassTimeout = 1
            TcpIpIpNumReassDgrams = 3
          TcpIpStaticArpTable
            TcpIpStaticArpEntry: TcpIpStaticArpEntryIpAddr=10.23.0.100, TcpIpStaticArpEntryPhysAddr=00-17-BC-00-17-BC
      TcpIpUdpConfig: TcpIpUdpTtl=64, TcpIpUdpTxRetryQueueSize=3
        TcpIpUdpTxReqList: TcpIpUdpTxReqListSize=3
      3 x TcpIpLocalAddr, all with TcpIpDomainType=TCPIP_AF_INET, TcpIpIpAddrReceiveAllNotConfiguredMulticasts=false:
        TcpIpLocalAddr_TcpIpCtrl_Vlan10_Broadcast: TcpIpAddrId=2, TcpIpAddressType=TCPIP_IPV4_BROADCAST, TcpIpCtrlRef=TcpIpCtrl_Vlan10
          TcpIpAddrAssignment: TcpIpAssignmentMethod=TCPIP_STATIC, TcpIpAssignmentPriority=1, TcpIpAssignmentTrigger=TCPIP_AUTOMATIC
        TcpIpLocalAddr_NE_Multicast_Rx_fixed_239_10_0_1: TcpIpAddrId=1, TcpIpAddressType=TCPIP_MULTICAST, TcpIpCtrlRef=TcpIpCtrl_Vlan10
          TcpIpAddrAssignment: TcpIpAssignmentMethod=TCPIP_STATIC, TcpIpAssignmentPriority=1, TcpIpAssignmentTrigger=TCPIP_AUTOMATIC
          TcpIpStaticIpAddressConfig: TcpIpStaticIpAddress=239.10.0.1
        TcpIpLocalAddr_NE_Fixed_10_23_0_33: TcpIpAddrId=3, TcpIpAddressType=TCPIP_UNICAST, TcpIpCtrlRef=TcpIpCtrl_Vlan23
          TcpIpAddrAssignment: TcpIpAssignmentMethod=TCPIP_STATIC, TcpIpAssignmentPriority=1, TcpIpAssignmentTrigger=TCPIP_AUTOMATIC, TcpIpAssignmentLifetime=TCPIP_FORGET
          TcpIpStaticIpAddressConfig: TcpIpStaticIpAddress=10.23.0.33, TcpIpNetmask=24
      TcpIpCtrl_Vlan23 (TcpIpCtrl): TcpIpIpFramePrioDefault=0, TcpIpEthIfCtrlRef=EthIfController_Vlan23
        TcpIpIpVXCtrl
          TcpIpIpV4Ctrl_Vlan23 (TcpIpIpV4Ctrl): TcpIpIpTypeOfServiceDefault=0, TcpIpIpCtrlIdx=1, TcpIpIpDefaultTtl=64, TcpIpArpConfigRef=TcpIpArpConfig, TcpIpStaticArpTableRef=TcpIpStaticArpTable
      3 x TcpIpLocalAddr, all with TcpIpDomainType=TCPIP_AF_INET, TcpIpIpAddrReceiveAllNotConfiguredMulticasts=false, TcpIpCtrlRef=TcpIpCtrl_Vlan23:
        TcpIpLocalAddr_TcpIpCtrl_Vlan23_Broadcast: TcpIpAddrId=6, TcpIpAddressType=TCPIP_IPV4_BROADCAST
          TcpIpAddrAssignment: TcpIpAssignmentMethod=TCPIP_STATIC, TcpIpAssignmentPriority=1, TcpIpAssignmentTrigger=TCPIP_AUTOMATIC
        TcpIpLocalAddr_NE_Multicast_Rx_fixed_239_23_0_2: TcpIpAddrId=4, TcpIpAddressType=TCPIP_MULTICAST
          TcpIpAddrAssignment: TcpIpAssignmentMethod=TCPIP_STATIC, TcpIpAssignmentPriority=1, TcpIpAssignmentTrigger=TCPIP_AUTOMATIC
          TcpIpStaticIpAddressConfig: TcpIpStaticIpAddress=239.23.0.2
        TcpIpLocalAddr_Multicast_Any_vlan23: TcpIpAddrId=5, TcpIpAddressType=TCPIP_MULTICAST
          TcpIpAddrAssignment: TcpIpAssignmentMethod=TCPIP_STATIC, TcpIpAssignmentPriority=1, TcpIpAssignmentTrigger=TCPIP_MANUAL
      TcpIpTcpConfig:
        TcpIpTcpCongestionAvoidanceEnabled = true
        TcpIpTcpFastRecoveryEnabled = true
        TcpIpTcpFastRetransmitEnabled = true
        TcpIpTcpFinWait2Timeout = 120
        TcpIpTcpKeepAliveEnabled = true
        TcpIpTcpKeepAliveInterval = 0
        TcpIpTcpKeepAliveProbesMax = 0
        TcpIpTcpKeepAliveTime = 7200
        TcpIpTcpMsl = 120
        TcpIpTcpNagleEnabled = true
        TcpIpTcpReceiveWindowMax = 512
        TcpIpTcpSlowStartEnabled = true
        TcpIpTcpSynMaxRtx = 255
        TcpIpTcpSynReceivedTimeout = 0
        TcpIpTcpTtl = 64
        TcpIpTcpUserTimeoutDef = 20
        TcpIpTcpUserTimeoutOptionSupport = false
        TcpIpTcpTimeStampOptionSupport = true
        TcpIpTcpTxResetQueueSize = 8
        TcpIpTcpTxRetryQueueSize = 10
        TcpIpTcpOutOfOrderRxSupport = true
        TcpIpTcpRetransmissionTimeout = 1
        TcpIpTcpRetransmissionTimeoutMax = 60
        TcpIpTcpNagleTimeout = 0.1
        TcpIpTcpMaxNumOooSegsPerSocket = 5
        TcpIpTcpSackOptionSupport = true
        TcpIpTcpAvgNumOooSegsPerSocket = 5
        4 x TcpIpTcpSocketBuffer, all with TcpIpTcpSocketRxBufferSize=512, TcpIpTcpSocketTxBufferSize=512:
          TcpIpTcpSocketBuffer_{001..004}
      TcpIpCtrl_Vlan1 (TcpIpCtrl): TcpIpIpFramePrioDefault=0, TcpIpEthIfCtrlRef=EthIfController_Vlan1
        TcpIpIpVXCtrl
          TcpIpIpV4Ctrl_Vlan1 (TcpIpIpV4Ctrl):
            TcpIpIpTypeOfServiceDefault = 0
            TcpIpIpCtrlIdx = 2
            TcpIpIpDefaultTtl = 64
            TcpIpArpConfigRef = TcpIpArpConfig
            TcpIpDhcpConfigRef = TcpIpDhcpConfig
            TcpIpFragmentationConfigRef = TcpIpIpFragmentationConfig
      TcpIpLocalAddr_NE_DhcpV4_Fixed_169_254_1_33 (TcpIpLocalAddr):
        TcpIpAddrId = 7
        TcpIpAddressType = TCPIP_UNICAST
        TcpIpDomainType = TCPIP_AF_INET
        TcpIpIpAddrReceiveAllNotConfiguredMulticasts = false
        TcpIpCtrlRef = TcpIpCtrl_Vlan1
        TcpIpAddrAssignment_NE_DhcpV4_Fixed_169_254_1_33 (TcpIpAddrAssignment): TcpIpAssignmentMethod=TCPIP_DHCP, TcpIpAssignmentPriority=1, TcpIpAssignmentTrigger=TCPIP_AUTOMATIC, TcpIpAssignmentLifetime=TCPIP_FORGET
        TcpIpAddrAssignment_NE_DhcpV4_Fixed_169_254_1_33_default (TcpIpAddrAssignment): TcpIpAssignmentMethod=TCPIP_STATIC, TcpIpAssignmentPriority=2, TcpIpAssignmentTrigger=TCPIP_AUTOMATIC
        TcpIpStaticIpAddressConfig: TcpIpStaticIpAddress=169.254.1.33, TcpIpNetmask=24
      TcpIpV4LocalAddr_TcpIpCtrl_Vlan1_Broadcast (TcpIpLocalAddr):
        TcpIpAddrId = 8
        TcpIpAddressType = TCPIP_IPV4_BROADCAST
        TcpIpDomainType = TCPIP_AF_INET
        TcpIpIpAddrReceiveAllNotConfiguredMulticasts = false
        TcpIpCtrlRef = TcpIpCtrl_Vlan1
        TcpIpAddrAssignment: TcpIpAssignmentMethod=TCPIP_STATIC, TcpIpAssignmentPriority=1, TcpIpAssignmentTrigger=TCPIP_AUTOMATIC
