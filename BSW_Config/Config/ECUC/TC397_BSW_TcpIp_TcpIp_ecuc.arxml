AUTOSAR XML (schema 00048)
package /ActiveEcuC
  module config TcpIp: implementation-config-variant=VARIANT-PRE-COMPILE, module-description=TcpIp_Impl
    TcpIpGeneral:
      TcpIpBufferMemory = 6144
      TcpIpDevErrorDetect = true
      TcpIpDhcpServerEnabled = false
      TcpIpMainFunctionPeriod = 0.005
      TcpIpResetIpAssignmentApi = false
      TcpIpScalabilityClass = SC1
      TcpIpTcpEnabled = true
      TcpIpTcpSocketMax = 6
      TcpIpUdpEnabled = true
      TcpIpUdpSocketMax = 6
      TcpIpVersionInfoApi = false
      TcpIpRandNoFct = Appl_Crypto_GetRandNo
      TcpIpRandNoFctIncludeFile = Appl_Rand.h
      TcpIpDiagExtensionsEnabled = false
      TcpIpLowerLayerName = EthIf
      TcpIpMainFunctionSplitEnabled = false
      TcpIpSafeBswChecks = false
      TcpIpGetDhcpStatusApi = false
      TcpIpIpSecEnabled = false
      TcpIpGetAndResetMeasurementDataApi = false
      TcpIpGeneration:
        TcpIpBoolDataInArrayOfStructStrategy = BOOLEAN
        TcpIpOutOfBoundsWriteProtectionStrategy = NONE
        TcpIpOutOfBoundsWriteSanitizer = false
        TcpIpOutOfBoundsReadSanitizer = false
        TcpIpReduceConstantData2Define = false
        TcpIpDeduplicateIndirectedData = true
        TcpIpDataDeduplicationStrategy = NONE
        TcpIpReduceBoolDataByNegationThreshold = 2
        TcpIpReduceBoolDataByNumericalComparisonThreshold = 2
        TcpIpReduceBoolDataByNumericalRelationThreshold = 2
        TcpIpReduceBoolDataByNumericalOperandStrategy = DEDUPLICATE_DATA_WITH_ANY_VALUE
        TcpIpReduceNumericalDataByOffsetThreshold = 0
        TcpIpReduceNumericalDataByArraySubtractionThreshold = 2
        TcpIpReduceDataByStreaming = false
        TcpIpShortSymbols = false
        TcpIpInterfacesForDeactivatedData = false
        TcpIpReferringKeysInComments = false
      TcpIpIpV4General:
        TcpIpArpEnabled = true
        TcpIpAutoIpEnabled = false
        TcpIpDhcpClientEnabled = true
        TcpIpIcmpEnabled = true
        TcpIpIpV4Enabled = true
        TcpIpLocalAddrIpv4EntriesMax = 8
        TcpIpPathMtuDiscoveryEnabled = false
        TcpIpIpV4EthIfUpdatePhysAddrFilterApiEnabled = true
        TcpIpArpDiscardedEntryHandling = false
      TcpIpIpV6General:
        TcpIpDhcpV6ClientEnabled = false
        TcpIpIpV6Enabled = false
        TcpIpIpV6PathMtuDiscoveryEnabled = false
        TcpIpLocalAddrIpv6EntriesMax = 0
        TcpIpNdpAddressResolutionUnrechabilityDetectionEnabled = true
        TcpIpNdpPrefixAndRouterDiscoveryEnabled = true
        TcpIpIpV6EthIfUpdatePhysAddrFilterApiEnabled = true
        TcpIpIpV6SetTrafficClassAndFlowLabelApiEnabled = false
        TcpIpIpV6ExtendedDestAddrValidationEnabled = false
        TcpIpIpV6CacheLookupOptimizationEnabled = true
    TcpIpConfig
      TcpIpCtrl_untagged (TcpIpCtrl): TcpIpIpFramePrioDefault=0, TcpIpEthIfCtrlRef=EthIfController_untagged
        TcpIpIpVXCtrl
          TcpIpIpV4Ctrl: TcpIpIpTypeOfServiceDefault=0, TcpIpIpCtrlIdx=0, TcpIpIpDefaultTtl=64, TcpIpArpConfigRef=TcpIpArpConfig
      TcpIpLocalAddr_NE_Fixed_192_168_1_123 (TcpIpLocalAddr):
        TcpIpAddrId = 0
        TcpIpAddressType = TCPIP_UNICAST
        TcpIpDomainType = TCPIP_AF_INET
        TcpIpIpAddrReceiveAllNotConfiguredMulticasts = false
        TcpIpCtrlRef = TcpIpCtrl_untagged
        TcpIpAddrAssignment: TcpIpAssignmentMethod=TCPIP_STATIC, TcpIpAssignmentPriority=1, TcpIpAssignmentTrigger=TCPIP_AUTOMATIC
        TcpIpStaticIpAddressConfig: TcpIpStaticIpAddress=192.168.1.123, TcpIpNetmask=24
      TcpIpSocketOwnerConfig
        SoAd (TcpIpSocketOwner):
          TcpIpSocketOwnerUpperLayerType = SOAD
          TcpIpSocketOwnerId = 0
          TcpIpSocketOwnerTcpIpEventName = SoAd_TcpIpEvent
          TcpIpSocketOwnerTcpListenSocketMax = 2
          TcpIpSocketOwnerCopyTxDataDynamicLengthEnabled = false
          TcpIpSocketOwnerTcpConnectedName = SoAd_TcpConnected
          TcpIpSocketOwnerHeaderFileName = SoAd_Cbk.h
          TcpIpSocketOwnerLocalIpAddrAssignmentChgName = SoAd_LocalIpAddrAssignmentChg
          TcpIpSocketOwnerRxIndicationName = SoAd_RxIndication
          TcpIpSocketOwnerCopyTxDataName = SoAd_CopyTxData
          TcpIpSocketOwnerTcpAcceptedName = SoAd_TcpAccepted
          TcpIpSocketOwnerTxConfirmationName = SoAd_TxConfirmation
      TcpIpIpConfig
        TcpIpIpV4Config
          TcpIpArpConfig:
            TcpIpArpNumGratuitousARPonStartup = 0
            TcpIpArpPacketQueueEnabled = true
            TcpIpArpTableEntryTimeout = 30
            TcpIpArpTableSizeMax = 10
            TcpIpArpRetryTime = 5
            TcpIpArpRetryInterval = 2
            TcpIpArpRequestTimeout = 1
          TcpIpDhcpConfig:
            TcpIpDhcpV4InitWaitMin = 0.1
            TcpIpDhcpV4InitWaitMax = 0.8
            TcpIpDhcpV4DiscoverMaxNum = 5
            TcpIpDhcpV4DiscoverIntervalMin = 2
            TcpIpDhcpV4DiscoverIntervalMax = 30
            TcpIpDhcpV4RequestMaxNum = 6
            TcpIpDhcpV4RequestInterval = 2
            TcpIpDhcpV4RenewIntervalMin = 5
            TcpIpDhcpV4RebindIntervalMin = 5
            TcpIpDhcpV4HostNameLenMax = 30
            TcpIpDhcpV4RestartOnFail = false
          TcpIpIcmpConfig: TcpIpIcmpTtl=64, TcpIpIcmpEchoReplyMaxLen=32, TcpIpIcmpDestinationUnreachableEnabled=false
      TcpIpV4LocalAddr_TcpIpCtrl_untagged_Broadcast (TcpIpLocalAddr):
        TcpIpAddrId = 1
        TcpIpAddressType = TCPIP_IPV4_BROADCAST
        TcpIpDomainType = TCPIP_AF_INET
        TcpIpIpAddrReceiveAllNotConfiguredMulticasts = false
        TcpIpCtrlRef = TcpIpCtrl_untagged
        TcpIpAddrAssignment: TcpIpAssignmentMethod=TCPIP_STATIC, TcpIpAssignmentPriority=1, TcpIpAssignmentTrigger=TCPIP_AUTOMATIC
      TcpIpUdpConfig: TcpIpUdpTtl=64, TcpIpUdpTxRetryQueueSize=1
      TcpIpCtrl_Vlan1 (TcpIpCtrl): TcpIpIpFramePrioDefault=0, TcpIpEthIfCtrlRef=EthIfController_Vlan1
        TcpIpIpVXCtrl
          TcpIpIpV4Ctrl_Valn1 (TcpIpIpV4Ctrl): TcpIpIpTypeOfServiceDefault=0, TcpIpIpCtrlIdx=1, TcpIpIpDefaultTtl=64, TcpIpArpConfigRef=TcpIpArpConfig, TcpIpDhcpConfigRef=TcpIpDhcpConfig
      TcpIpLocalAddr_NE_DhcpV4_Fixed_169_254_1_33 (TcpIpLocalAddr):
        TcpIpAddrId = 2
        TcpIpAddressType = TCPIP_UNICAST
        TcpIpDomainType = TCPIP_AF_INET
        TcpIpIpAddrReceiveAllNotConfiguredMulticasts = false
        TcpIpCtrlRef = TcpIpCtrl_Vlan1
        TcpIpAddrAssignment_NE_DhcpV4_Fixed_169_254_1_33 (TcpIpAddrAssignment): TcpIpAssignmentMethod=TCPIP_DHCP, TcpIpAssignmentPriority=1, TcpIpAssignmentTrigger=TCPIP_AUTOMATIC, TcpIpAssignmentLifetime=TCPIP_FORGET
        TcpIpAddrAssignment_NE_DhcpV4_Fixed_169_254_1_33_Default (TcpIpAddrAssignment): TcpIpAssignmentMethod=TCPIP_STATIC, TcpIpAssignmentPriority=2, TcpIpAssignmentTrigger=TCPIP_MANUAL
        TcpIpStaticIpAddressConfig: TcpIpStaticIpAddress=169.254.1.33, TcpIpNetmask=24
      TcpIpV4LocalAddr_TcpIpCtrl_Vlan1_Broadcast (TcpIpLocalAddr):
        TcpIpAddrId = 3
        TcpIpAddressType = TCPIP_IPV4_BROADCAST
        TcpIpDomainType = TCPIP_AF_INET
        TcpIpIpAddrReceiveAllNotConfiguredMulticasts = false
        TcpIpCtrlRef = TcpIpCtrl_Vlan1
        TcpIpAddrAssignment: TcpIpAssignmentMethod=TCPIP_STATIC, TcpIpAssignmentPriority=1, TcpIpAssignmentTrigger=TCPIP_AUTOMATIC
      TcpIpTcpConfig:
        TcpIpTcpCongestionAvoidanceEnabled = false
        TcpIpTcpFastRecoveryEnabled = false
        TcpIpTcpFastRetransmitEnabled = false
        TcpIpTcpFinWait2Timeout = 120
        TcpIpTcpKeepAliveEnabled = false
        TcpIpTcpKeepAliveInterval = 0
        TcpIpTcpKeepAliveProbesMax = 0
        TcpIpTcpKeepAliveTime = 7200
        TcpIpTcpMsl = 120
        TcpIpTcpNagleEnabled = true
        TcpIpTcpReceiveWindowMax = 512
        TcpIpTcpSlowStartEnabled = false
        TcpIpTcpSynMaxRtx = 255
        TcpIpTcpSynReceivedTimeout = 0
        TcpIpTcpTtl = 64
        TcpIpTcpUserTimeoutDef = 20
        TcpIpTcpUserTimeoutOptionSupport = false
        TcpIpTcpTimeStampOptionSupport = false
        TcpIpTcpTxResetQueueSize = 8
        TcpIpTcpTxRetryQueueSize = 10
        TcpIpTcpOutOfOrderRxSupport = true
        TcpIpTcpAvgNumOooSegsPerSocket = 5
        TcpIpTcpSackOptionSupport = false
        TcpIpTcpMaxNumOooSegsPerSocket = 5
        TcpIpTcpRetransmissionTimeout = 0.1
        TcpIpTcpRetransmissionTimeoutMax = 6
        TcpIpTcpNagleTimeout = 0.1
        4 x TcpIpTcpSocketBuffer:
          TcpIpTcpSocketBuffer_001: TcpIpTcpSocketRxBufferSize=1024, TcpIpTcpSocketTxBufferSize=1024
          TcpIpTcpSocketBuffer_002: TcpIpTcpSocketRxBufferSize=1024, TcpIpTcpSocketTxBufferSize=1024
          TcpIpTcpSocketBuffer: TcpIpTcpSocketRxBufferSize=512, TcpIpTcpSocketTxBufferSize=512
          TcpIpTcpSocketBuffer_003: TcpIpTcpSocketRxBufferSize=512, TcpIpTcpSocketTxBufferSize=512
      TcpIpCtrl_Vlan23 (TcpIpCtrl): TcpIpIpFramePrioDefault=0, TcpIpEthIfCtrlRef=EthIfController_Valn23
        TcpIpIpVXCtrl
          TcpIpIpV4Ctrl_001 (TcpIpIpV4Ctrl): TcpIpIpTypeOfServiceDefault=0, TcpIpIpCtrlIdx=2, TcpIpIpDefaultTtl=64, TcpIpArpConfigRef=TcpIpArpConfig
      4 x TcpIpLocalAddr, all with TcpIpDomainType=TCPIP_AF_INET, TcpIpIpAddrReceiveAllNotConfiguredMulticasts=false, TcpIpCtrlRef=TcpIpCtrl_Vlan23:
        TcpIpLocalAddr_NE_Fixed_10_23_0_23: TcpIpAddrId=4, TcpIpAddressType=TCPIP_UNICAST
          TcpIpAddrAssignment: TcpIpAssignmentMethod=TCPIP_STATIC, TcpIpAssignmentPriority=1, TcpIpAssignmentTrigger=TCPIP_AUTOMATIC
          TcpIpStaticIpAddressConfig: TcpIpStaticIpAddress=10.23.0.33, TcpIpNetmask=24
        TcpIpV4LocalAddr_TcpIpCtrl_Vlan23_Broadcast: TcpIpAddrId=7, TcpIpAddressType=TCPIP_IPV4_BROADCAST
          TcpIpAddrAssignment: TcpIpAssignmentMethod=TCPIP_STATIC, TcpIpAssignmentPriority=1, TcpIpAssignmentTrigger=TCPIP_AUTOMATIC
        TcpIpLocalAddr_NE_Multicast_Rx_Fixed_239_23_0_2: TcpIpAddrId=5, TcpIpAddressType=TCPIP_MULTICAST
          TcpIpAddrAssignment: TcpIpAssignmentMethod=TCPIP_STATIC, TcpIpAssignmentPriority=1, TcpIpAssignmentTrigger=TCPIP_AUTOMATIC
          TcpIpStaticIpAddressConfig: TcpIpStaticIpAddress=239.23.0.2
        TcpIpLocalAddr_Multicast_Any_Vlan23: TcpIpAddrId=6, TcpIpAddressType=TCPIP_MULTICAST
          TcpIpAddrAssignment: TcpIpAssignmentMethod=TCPIP_STATIC, TcpIpAssignmentPriority=1, TcpIpAssignmentTrigger=TCPIP_MANUAL
