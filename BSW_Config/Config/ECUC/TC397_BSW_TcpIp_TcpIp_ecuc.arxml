AUTOSAR XML (schema 00048)
package /ActiveEcuC
  module config TcpIp: implementation-config-variant=VARIANT-PRE-COMPILE, module-description=TcpIp_Impl
    TcpIpGeneral:
      TcpIpBufferMemory = 0
      TcpIpDevErrorDetect = (unset)
      TcpIpDhcpServerEnabled = false
      TcpIpMainFunctionPeriod = 0.005
      TcpIpResetIpAssignmentApi = false
      TcpIpScalabilityClass = SC1
      TcpIpTcpEnabled = false
      TcpIpTcpSocketMax = 0
      TcpIpUdpEnabled = true
      TcpIpUdpSocketMax = 1
      TcpIpVersionInfoApi = (unset)
      TcpIpRandNoFct = Appl_Crypto_GetRandNo
      TcpIpRandNoFctIncludeFile = Appl_Rand.h
      TcpIpDiagExtensionsEnabled = false
      TcpIpLowerLayerName = EthIf
      TcpIpMainFunctionSplitEnabled = false
      TcpIpSafeBswChecks = false
      TcpIpGetDhcpStatusApi = false
      TcpIpIpSecEnabled = false
      TcpIpGetAndResetMeasurementDataApi = false
      TcpIpGeneration:
        TcpIpBoolDataInArrayOfStructStrategy = BOOLEAN
        TcpIpOutOfBoundsWriteProtectionStrategy = NONE
        TcpIpOutOfBoundsWriteSanitizer = false
        TcpIpOutOfBoundsReadSanitizer = false
        TcpIpReduceConstantData2Define = false
        TcpIpDeduplicateIndirectedData = true
        TcpIpDataDeduplicationStrategy = NONE
        TcpIpReduceBoolDataByNegationThreshold = 2
        TcpIpReduceBoolDataByNumericalComparisonThreshold = 2
        TcpIpReduceBoolDataByNumericalRelationThreshold = 2
        TcpIpReduceBoolDataByNumericalOperandStrategy = DEDUPLICATE_DATA_WITH_ANY_VALUE
        TcpIpReduceNumericalDataByOffsetThreshold = 0
        TcpIpReduceNumericalDataByArraySubtractionThreshold = 2
        TcpIpReduceDataByStreaming = false
        TcpIpShortSymbols = false
        TcpIpInterfacesForDeactivatedData = false
        TcpIpReferringKeysInComments = false
      TcpIpIpV4General:
        TcpIpArpEnabled = true
        TcpIpAutoIpEnabled = false
        TcpIpDhcpClientEnabled = false
        TcpIpIcmpEnabled = false
        TcpIpIpV4Enabled = true
        TcpIpPathMtuDiscoveryEnabled = (unset)
        TcpIpIpV4EthIfUpdatePhysAddrFilterApiEnabled = true
        TcpIpArpDiscardedEntryHandling = false
        TcpIpLocalAddrIpv4EntriesMax = 2
      TcpIpIpV6General:
        TcpIpDhcpV6ClientEnabled = false
        TcpIpIpV6Enabled = false
        TcpIpIpV6PathMtuDiscoveryEnabled = false
        TcpIpLocalAddrIpv6EntriesMax = (unset)
        TcpIpNdpAddressResolutionUnrechabilityDetectionEnabled = (unset)
        TcpIpNdpPrefixAndRouterDiscoveryEnabled = (unset)
        TcpIpIpV6EthIfUpdatePhysAddrFilterApiEnabled = true
        TcpIpIpV6SetTrafficClassAndFlowLabelApiEnabled = false
        TcpIpIpV6ExtendedDestAddrValidationEnabled = false
        TcpIpIpV6CacheLookupOptimizationEnabled = true
    TcpIpConfig
      TcpIpCtrl: TcpIpIpFramePrioDefault=0, TcpIpEthIfCtrlRef=EthIfController
        TcpIpIpVXCtrl
          TcpIpIpV4Ctrl: TcpIpIpTypeOfServiceDefault=0, TcpIpIpCtrlIdx=0, TcpIpIpDefaultTtl=64, TcpIpArpConfigRef=TcpIpArpConfig, TcpIpDhcpConfigRef=TcpIpDhcpConfig
      NE_Fixed_192_168_1_100 (TcpIpLocalAddr):
        TcpIpAddrId = 0
        TcpIpAddressType = TCPIP_UNICAST
        TcpIpDomainType = TCPIP_AF_INET
        TcpIpIpAddrReceiveAllNotConfiguredMulticasts = false
        TcpIpCtrlRef = TcpIpCtrl
        TcpIpAddrAssignment: TcpIpAssignmentMethod=TCPIP_STATIC, TcpIpAssignmentPriority=1, TcpIpAssignmentTrigger=TCPIP_MANUAL, TcpIpAssignmentLifetime=TCPIP_FORGET
        TcpIpStaticIpAddressConfig: TcpIpStaticIpAddress=192.168.1.100, TcpIpNetmask=24
      TcpIpSocketOwnerConfig
        SoAd (TcpIpSocketOwner):
          TcpIpSocketOwnerUpperLayerType = SOAD
          TcpIpSocketOwnerId = 0
          TcpIpSocketOwnerTcpIpEventName = SoAd_TcpIpEvent
          TcpIpSocketOwnerTcpListenSocketMax = 0
          TcpIpSocketOwnerCopyTxDataDynamicLengthEnabled = false
          TcpIpSocketOwnerCopyTxDataName = SoAd_CopyTxData
          TcpIpSocketOwnerHeaderFileName = SoAd_Cbk.h
          TcpIpSocketOwnerLocalIpAddrAssignmentChgName = SoAd_LocalIpAddrAssignmentChg
          TcpIpSocketOwnerRxIndicationName = SoAd_RxIndication
          TcpIpSocketOwnerTcpAcceptedName = SoAd_TcpAccepted
          TcpIpSocketOwnerTcpConnectedName = SoAd_TcpConnected
          TcpIpSocketOwnerTxConfirmationName = SoAd_TxConfirmation
      TcpIpIpConfig
        TcpIpIpV4Config
          TcpIpArpConfig:
            TcpIpArpNumGratuitousARPonStartup = 0
            TcpIpArpPacketQueueEnabled = true
            TcpIpArpTableEntryTimeout = 30
            TcpIpArpTableSizeMax = 10
            TcpIpArpRetryTime = 5
            TcpIpArpRetryInterval = 2
            TcpIpArpRequestTimeout = 0.1
          TcpIpDhcpConfig:
            TcpIpDhcpV4InitWaitMin = 0.1
            TcpIpDhcpV4InitWaitMax = 0.8
            TcpIpDhcpV4DiscoverMaxNum = 5
            TcpIpDhcpV4DiscoverIntervalMin = 2
            TcpIpDhcpV4DiscoverIntervalMax = 30
            TcpIpDhcpV4RequestMaxNum = 6
            TcpIpDhcpV4RequestInterval = 2
            TcpIpDhcpV4RenewIntervalMin = 5
            TcpIpDhcpV4RebindIntervalMin = 5
            TcpIpDhcpV4HostNameLenMax = 30
            TcpIpDhcpV4RestartOnFail = false
      TcpIpUdpConfig: TcpIpUdpTtl=64, TcpIpUdpTxRetryQueueSize=1
      TcpIpV4LocalAddr_TcpIpCtrl_Broadcast (TcpIpLocalAddr):
        TcpIpAddrId = 1
        TcpIpAddressType = TCPIP_IPV4_BROADCAST
        TcpIpDomainType = TCPIP_AF_INET
        TcpIpIpAddrReceiveAllNotConfiguredMulticasts = false
        TcpIpCtrlRef = TcpIpCtrl
        TcpIpAddrAssignment: TcpIpAssignmentMethod=TCPIP_STATIC, TcpIpAssignmentPriority=1, TcpIpAssignmentTrigger=TCPIP_AUTOMATIC
