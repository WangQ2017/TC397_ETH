AUTOSAR XML (schema 00048)
package /ActiveEcuC
  module config DoIP: implementation-config-variant=VARIANT-PRE-COMPILE, module-description=DoIP_Impl
    DoIPConfigSet: DoIPLogicalAddress=4626, DoIPGid=1103823438081, DoIPEid=711448700325
      DoIPChannel_DOIP_Phy_Req (DoIPChannel): DoIPChannelSARef=DoIPTester_0x0E80, DoIPChannelTARef=DoIPTargetAddress_1212
        DoIPPduRRxPdu_Phy_Req (DoIPPduRRxPdu): DoIPPduRRxPduId=0, DoIPPduRRxPduRef=DoIPPhyReqRxPdu_DoIP2PduR
        DoIPPduRTxPdu_Phy_Res (DoIPPduRTxPdu): DoIPPduRTxPduId=0, DoIPPduType=DOIP_TPPDU, DoIPPduRTxPduRef=DoIPPhyResTxPdu_PduR2DoIP
      DoIPConnections
        DoIPTargetAddress_EE80 (DoIPTargetAddress): DoIPTargetAddressValue=61056, DoIPTargetAddressVerification=false, DoIPTargetMaxBufSize=4095
        DoIPTcpConnection_TCP_DATA0 (DoIPTcpConnection)
          DoIPSoAdTcpRxPdun_TCP_DATA0_Rx (DoIPSoAdTcpRxPdu): DoIPSoAdTcpRxPduId=0, DoIPSoAdTcpRxPduRef=DoIP_TCP_DATA0_SoAd2DoIP_RxPdu
          DoIPSoAdTcpTxPdun_TCP_DATA0_Tx (DoIPSoAdTcpTxPdu): DoIPSoAdTcpTxPduId=0, DoIPSoAdTcpTxPduRef=DoIP_TCP_DATA0_DoIP2SoAd_TxPdu
        DoIPTcpConnection_TCP_DATA1 (DoIPTcpConnection)
          DoIPSoAdTcpRxPdu_TCP_DATA1_Rx (DoIPSoAdTcpRxPdu): DoIPSoAdTcpRxPduId=1, DoIPSoAdTcpRxPduRef=DoIP_TCP_DATA1_SoAd2DoIP_RxPdu
          DoIPSoAdTcpTxPdu_TCP_DATA1_Tx (DoIPSoAdTcpTxPdu): DoIPSoAdTcpTxPduId=1, DoIPSoAdTcpTxPduRef=DoIP_TCP_DATA1_DoIP2SoAd_TxPdu
        DoIPUdpConnection_UDP_TEST_EQUIPMENT_REQUEST (DoIPUdpConnection)
          DoIPSoAdUdpRxPdu_UDP_TEST_EQUIPMENT_REQUEST_Rx (DoIPSoAdUdpRxPdu): DoIPSoAdUdpRxPduId=2, DoIPSoAdUdpRxPduRef=DoIP_UDP_TEST_EQUIPMENT_REQUEST_SoAd2DoIP_RxPdu
          DoIPSoAdUdpTxPdu_UDP_TEST_EQUIPMENT_REQUEST_Tx (DoIPSoAdUdpTxPdu): DoIPSoAdUdpTxPduId=2, DoIPSoAdUdpTxPduRef=DoIP_UDP_TEST_EQUIPMENT_REQUEST_DoIP2SoAd_TxPdu
        DoIPUdpVehicleAnnouncementConnection_UDP_DISCOVERY (DoIPUdpVehicleAnnouncementConnection)
          DoIPSoAdUdpVehicleAnnouncementTxPdu_UDP_DISCOVERY_Tx (DoIPSoAdUdpVehicleAnnouncementTxPdu): DoIPSoAdUdpVehicleAnnouncementTxPduId=3, DoIPSoAdUdpVehicleAnnouncementTxPduRef=DoIP_UDP_DISCOVERY_DoIP2SoAd_TxPdu
        DoIPTargetAddress_1212 (DoIPTargetAddress): DoIPTargetAddressValue=4626, DoIPTargetAddressVerification=false, DoIPTargetMaxBufSize=4095
        DoIPIpAddressAssignment_TcpIpLocalAddr_NE_DhcpV4_Fixed_169_254_1_33_TcpIpAddrAssignment_NE_DhcpV4_Fixed_169_254_1_33 (DoIPIpAddressAssignment): DoIPControlIpAssignment=false, DoIPIpAddressAssignmentRef=TcpIpAddrAssignment_NE_DhcpV4_Fixed_169_254_1_33
        DoIPIpAddressAssignment_TcpIpLocalAddr_NE_DhcpV4_Fixed_169_254_1_33_TcpIpAddrAssignment_NE_DhcpV4_Fixed_169_254_1_33_default (DoIPIpAddressAssignment): DoIPControlIpAssignment=false, DoIPIpAddressAssignmentRef=TcpIpAddrAssignment_NE_DhcpV4_Fixed_169_254_1_33_default
      DoIPTester_0x0E80 (DoIPTester): DoIPNumByteDiagAckNack=256, DoIPTesterSA=3712, DoIPRoutingActivationRef=DoIPRoutingActivation
      DoIPChannel_DOIP_Func_Req (DoIPChannel): DoIPChannelSARef=DoIPTester_0x0E80, DoIPChannelTARef=DoIPTargetAddress_EE80
        DoIPPduRRxPdu_Func_Req (DoIPPduRRxPdu): DoIPPduRRxPduId=1, DoIPPduRRxPduRef=DoIPFuncReqRxPdu_DoIP2PduR
      DoIPRoutingActivation: DoIPRoutingActivationNumber=0, DoIPTargetAddressRef=DoIPTargetAddress_1212, DoIPTargetAddressRef=DoIPTargetAddress_EE80
    DoIPGeneral:
      DoIPAliveCheckResponseTimeout = 0.5
      DoIPDevelopmentErrorDetect = true
      DoIPDhcpOptionVinUse = false
      DoIPEntityStatusMaxByteFieldUse = false
      DoIPGIDInvalidityPattern = 0
      DoIPGeneralInactivityTime = 300
      DoIPHostNameSizeMax = DoIP-
      DoIPInitialInactivityTime = 2
      DoIPInitialVehicleAnnouncementTime = 0.5
      DoIPMainFunctionPeriod = 0.005
      DoIPMaxRequestBytes = 4102
      DoIPMaxTesterConnections = 2
      DoIPMaxUDPRequestPerMessage = 1
      DoIPNodeType = DOIP_NODE
      DoIPUseEIDasGID = false
      DoIPUseMacAddressForIdentification = false
      DoIPUseVehicleIdentificationSyncStatus = false
      DoIPVehicleAnnouncementInterval = 0.5
      DoIPVehicleAnnouncementRepetition = 3
      DoIPGetAndResetMeasurementDataApi = false
      DoIPVersionInfoApi = false
      DoIPVinGidMaster = false
      DoIPVinInvalidityPattern = 0
      DoIPSupportEntityState = false
      DoIPSupportVidWithEId = false
      DoIPSupportPduSizeRouting = false
      DoIPTcpTxMgtQueueSize = 2
      DoIPUdpTxMgtListSize = 4
      DoIPSupportShutdown = false
      DoIPActivationLineDefaultActive = true
      DoIPSupportOemSpecificPayloadTypes = false
      DoIPSafeBswChecks = false
      DoIPTcpRxMultiMessage = false
      DoIPTcpTxMgtQueueProcessLimit = 2
      DoIPDhcpOptionVendorEntNum3210Use = false
      DoIPHeaderFileInclusion = Appl_DoIp.h
      DoIPGetVinCallback: DoIPGetVinDirect=ApplDoIP_GetVin
      DoIPPowerModeCallback: DoIPPowerModeDirect=ApplDoIP_GetPowerMode
      DoIPGeneration:
        DoIPOutOfBoundsWriteProtectionStrategy = NONE
        DoIPOutOfBoundsWriteSanitizer = false
        DoIPOutOfBoundsReadSanitizer = false
        DoIPReduceConstantData2Define = false
        DoIPBoolDataInArrayOfStructStrategy = BITMASKING
        DoIPDeduplicateIndirectedData = true
        DoIPDataDeduplicationStrategy = DEDUPLICATE_CONST_DATA_WITH_CAST
        DoIPReduceBoolDataByNegationThreshold = 2
        DoIPReduceBoolDataByNumericalComparisonThreshold = 2
        DoIPReduceBoolDataByNumericalRelationThreshold = 2
        DoIPReduceBoolDataByNumericalOperandStrategy = DEDUPLICATE_DATA_WITH_ANY_VALUE
        DoIPReduceNumericalDataByOffsetThreshold = 2
        DoIPReduceNumericalDataByArraySubtractionThreshold = 2
        DoIPReduceDataByStreaming = false
        DoIPShortSymbols = false
        DoIPInterfacesForDeactivatedData = false
        DoIPReferringKeysInComments = false
