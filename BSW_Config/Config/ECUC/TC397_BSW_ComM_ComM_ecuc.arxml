AUTOSAR XML (schema 00048)
package /ActiveEcuC
  module config ComM: implementation-config-variant=VARIANT-PRE-COMPILE, module-description=ComM_Impl
    ComMGeneral:
      ComMDevErrorDetect = true
      ComMVersionInfoApi = true
      ComMEcuGroupClassification = 3
      ComMModeLimitationEnabled = false
      ComMPncSupport = true
      ComMSynchronousWakeUp = true
      ComMTMinFullComModeDuration = 5
      ComMWakeupInhibitionEnabled = false
      ComMSafeBswChecks = false
      ComMPncPrepareSleepTimer = 1
      ComMGeneration: ComMOutOfBoundsWriteSanitizer=false, ComMOutOfBoundsReadSanitizer=false
    ComMConfigSet: ComMPncEnabled=true
      ComMChannel_Vlan10 (ComMChannel):
        ComMBusType = COMM_BUS_TYPE_ETH
        ComMChannelId = 0
        ComMFullCommRequestNotificationEnabled = false
        ComMMainFunctionPeriod = 0.005
        ComMNoCom = false
        ComMNoWakeup = false
        ComMPncGatewayType = COMM_GATEWAY_TYPE_NONE
        ComMNetworkManagement: ComMNmVariant=FULL, ComMPncNmRequest=true
        ComMUserPerChannel: ComMUserChannel=ComMUser_Channel_Vlan10
      ComMUser_Channel_Vlan10 (ComMUser): ComMUserIdentifier=0, ComMUserModeNotification=false
      ComMPnc_00 (ComMPnc): ComMPncId=0, ComMChannelPerPnc=ComMChannel_Vlan10, ComMUserPerPnc=ComMUser_Pnc00
        ComMPncComSignal_EIRA_ETH_Rx (ComMPncComSignal):
          ComMPncComSignalDirection = RX
          ComMPncComSignalKind = EIRA
          ComMPncComSignalRef = ComSignalPnc_EIRA_ETH_Rx
          ComMPncComSignalChannelRef = ComMChannel_Vlan10
        ComMPncComSignal_EIRA_ETH_Tx (ComMPncComSignal):
          ComMPncComSignalDirection = TX
          ComMPncComSignalKind = EIRA
          ComMPncComSignalRef = ComSignalPnc_EIRA_ETH_Tx
          ComMPncComSignalChannelRef = ComMChannel_Vlan10
      ComMUser_Pnc00 (ComMUser): ComMUserIdentifier=1, ComMUserModeNotification=false
      ComMChannel_Vlan23 (ComMChannel):
        ComMBusType = COMM_BUS_TYPE_ETH
        ComMChannelId = 1
        ComMFullCommRequestNotificationEnabled = false
        ComMMainFunctionPeriod = 0.005
        ComMNoCom = false
        ComMNoWakeup = false
        ComMNetworkManagement: ComMNmVariant=LIGHT, ComMPncNmRequest=false, ComMNmLightTimeout=5
        ComMUserPerChannel: ComMUserChannel=ComMUser_Channel_Vlan23
      ComMUser_Channel_Vlan23 (ComMUser): ComMUserIdentifier=2, ComMUserModeNotification=false
      ComMChannel_Vlan1 (ComMChannel):
        ComMBusType = COMM_BUS_TYPE_ETH
        ComMChannelId = 2
        ComMFullCommRequestNotificationEnabled = false
        ComMMainFunctionPeriod = 0.005
        ComMNoCom = false
        ComMNoWakeup = false
        ComMNetworkManagement: ComMNmVariant=LIGHT, ComMPncNmRequest=false, ComMNmLightTimeout=5
        ComMUserPerChannel: ComMUserChannel=ComMUser_Channel_Vlan1
      ComMUser_Channel_Vlan1 (ComMUser): ComMUserIdentifier=3, ComMUserModeNotification=false
