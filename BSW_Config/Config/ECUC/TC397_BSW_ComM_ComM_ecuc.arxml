AUTOSAR XML (schema 00048)
package /ActiveEcuC
  module config ComM: implementation-config-variant=VARIANT-PRE-COMPILE, module-description=ComM_Impl
    ComMGeneral:
      ComMDevErrorDetect = true
      ComMVersionInfoApi = false
      ComMEcuGroupClassification = 3
      ComMModeLimitationEnabled = false
      ComMPncSupport = false
      ComMSynchronousWakeUp = true
      ComMTMinFullComModeDuration = 5
      ComMWakeupInhibitionEnabled = false
      ComMSafeBswChecks = false
      ComMGeneration: ComMOutOfBoundsWriteSanitizer=false, ComMOutOfBoundsReadSanitizer=false
    ComMConfigSet
      ComMChannel:
        ComMBusType = COMM_BUS_TYPE_CAN
        ComMChannelId = 0
        ComMFullCommRequestNotificationEnabled = false
        ComMMainFunctionPeriod = 0.02
        ComMNoCom = false
        ComMNoWakeup = false
        ComMNetworkManagement: ComMNmVariant=FULL, ComMPncNmRequest=false
      ComMUser: ComMUserIdentifier=0, ComMUserModeNotification=false
