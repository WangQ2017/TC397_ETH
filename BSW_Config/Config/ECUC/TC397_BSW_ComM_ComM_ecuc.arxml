AUTOSAR XML (schema 00048)
package /ActiveEcuC
  module config ComM: implementation-config-variant=VARIANT-PRE-COMPILE, module-description=ComM_Impl
    ComMGeneral:
      ComMDevErrorDetect = true
      ComMVersionInfoApi = false
      ComMEcuGroupClassification = 3
      ComMModeLimitationEnabled = false
      ComMPncSupport = false
      ComMSynchronousWakeUp = true
      ComMTMinFullComModeDuration = 5
      ComMWakeupInhibitionEnabled = false
      ComMSafeBswChecks = false
      ComMGeneration: ComMOutOfBoundsWriteSanitizer=false, ComMOutOfBoundsReadSanitizer=false
    ComMConfigSet
      ComMChannel_untagged (ComMChannel):
        ComMBusType = COMM_BUS_TYPE_ETH
        ComMChannelId = 0
        ComMFullCommRequestNotificationEnabled = false
        ComMMainFunctionPeriod = 0.02
        ComMNoCom = false
        ComMNoWakeup = false
        ComMNetworkManagement: ComMNmVariant=NONE, ComMPncNmRequest=false
        ComMUserPerChannel: ComMUserChannel=ComMUser_untagged
      ComMUser_untagged (ComMUser): ComMUserIdentifier=0, ComMUserModeNotification=false
      ComMChannel_Vlan1 (ComMChannel):
        ComMBusType = COMM_BUS_TYPE_ETH
        ComMChannelId = 1
        ComMFullCommRequestNotificationEnabled = false
        ComMMainFunctionPeriod = 0.02
        ComMNoCom = false
        ComMNoWakeup = false
        ComMNetworkManagement: ComMNmVariant=NONE, ComMPncNmRequest=false
        ComMUserPerChannel: ComMUserChannel=ComMUser_Vlan1
      ComMUser_Vlan1 (ComMUser): ComMUserIdentifier=1, ComMUserModeNotification=false
      ComMChannel_Vlan23 (ComMChannel):
        ComMBusType = COMM_BUS_TYPE_ETH
        ComMChannelId = 2
        ComMFullCommRequestNotificationEnabled = false
        ComMMainFunctionPeriod = 0.02
        ComMNoCom = false
        ComMNoWakeup = false
        ComMNetworkManagement: ComMNmVariant=NONE, ComMPncNmRequest=false
        ComMUserPerChannel: ComMUserChannel=ComMUser_Vlan23
      ComMUser_Vlan23 (ComMUser): ComMUserIdentifier=2, ComMUserModeNotification=false
