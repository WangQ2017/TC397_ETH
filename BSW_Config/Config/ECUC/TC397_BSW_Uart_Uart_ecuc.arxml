AUTOSAR XML (schema 00048)
package /ActiveEcuC
  module config Uart: implementation-config-variant=VARIANT-POST-BUILD-LOADABLE, module-description=Uart_Impl
    UartGeneral:
      UartDevErrorDetect = false
      UartRunTimeErrorDetect = false
      UartSafetyEnable = false
      UartVersionInfoApi = false
      UartInitCheckApi = false
      UartDeInitApi = true
      UartAbortReadApi = false
      UartAbortWriteApi = false
      UartCsrClksel = ASCLINS
      UartSleepEnable = false
      UartIndex = 0
      UartInitDeInitApiMode = MCAL_SUPERVISOR
      UartTimeoutCount = 4294967295
      UartMainFunctionReadPeriod = 0.005
      UartMainFunctionWritePeriod = 0.005
      UartClockRef = McuClockReferencePointConfig
    UartConfigSet
      UartChannel_0 (UartChannel):
        UartBaudRate = 115200
        UartHwUnit = ASCLIN0
        UartChannelId = 0
        UartAutoCalcBaudParams = true
        UartChanBaudNumerator = 2304
        UartChanBaudDenominator = 2500
        UartChanBaudPrescalar = 9
        UartChanBaudOverSampling = 15
        UartRxPinSelection = SELECT_A_PORT14_PIN1
        UartCTSEnable = false
        UartCTSPinSelection = SELECT_CTS_A_PORT14_PIN9
        UartCTSPolarity = LOW
        UartDataLength = 8
        UartStopBits = 1
        UartParityBit = NOPARITY
        UartTxChannelMode = INTERRUPT
        UartRxChannelMode = POLLING
        UartNotification: UartTransmitNotifPtr=NULL_PTR, UartReceiveNotifPtr=NULL_PTR, UartAbortTransmitNotifPtr=NULL_PTR, UartAbortReceiveNotifPtr=NULL_PTR
    CommonPublishedInformation:
      ArMajorVersion = 4
      ArMinorVersion = 2
      ArPatchVersion = 2
      SwMajorVersion = 10
      SwMinorVersion = 40
      SwPatchVersion = 2
      ModuleId = 255
      VendorId = 17
      Release = _TRICORE_TC397
