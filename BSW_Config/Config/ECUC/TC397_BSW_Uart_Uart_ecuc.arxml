AUTOSAR XML (schema 00048)
package /ActiveEcuC
  module config Uart: implementation-config-variant=VARIANT-POST-BUILD-LOADABLE, module-description=Uart_Impl
    UartGeneral:
      UartDevErrorDetect = true
      UartRunTimeErrorDetect = true
      UartSafetyEnable = true
      UartVersionInfoApi = false
      UartInitCheckApi = false
      UartDeInitApi = true
      UartStreamingRecvModeApi = false
      UartAbortReadApi = false
      UartAbortWriteApi = false
      UartCsrClksel = ASCLINS
      UartSleepEnable = false
      UartIndex = 0
      UartInitDeInitApiMode = MCAL_SUPERVISOR
      UartTimeoutCount = 4294967295
      UartMainFunctionReadPeriod = 0.01
      UartMainFunctionWritePeriod = 0.01
      UartClockRef = McuClockReferencePointConfig
    UartConfigSet
      UartChannel_0 (UartChannel):
        UartBaudRate = 115200
        UartHwUnit = ASCLIN0
        UartChannelId = 0
        UartAutoCalcBaudParams = true
        UartChanBaudNumerator = 2304
        UartChanBaudDenominator = 2500
        UartChanBaudPrescalar = 9
        UartChanBaudOverSampling = 15
        UartRxPinSelection = SELECT_A_PORT14_PIN1
        UartCTSEnable = false
        UartCTSPinSelection = SELECT_CTS_A_PORT14_PIN9
        UartCTSPolarity = LOW
        UartDataLength = 8
        UartStopBits = 1
        UartParityBit = NOPARITY
        UartTxChannelMode = INTERRUPT
        UartRxChannelMode = POLLING
        UartNotification:
          UartTransmitNotifPtr = NULL_PTR
          UartReceiveNotifPtr = NULL_PTR
          UartAbortTransmitNotifPtr = NULL_PTR
          UartAbortReceiveNotifPtr = NULL_PTR
          UartStreamingRecvNotifPtr = Streaming_Notification00
      UartChannel_1 (UartChannel):
        UartBaudRate = 115200
        UartHwUnit = ASCLIN3
        UartChannelId = 1
        UartAutoCalcBaudParams = true
        UartChanBaudNumerator = 24
        UartChanBaudDenominator = 1000
        UartChanBaudPrescalar = 4
        UartChanBaudOverSampling = 9
        UartRxPinSelection = SELECT_A_PORT15_PIN7
        UartCTSEnable = true
        UartCTSPinSelection = SELECT_CTS_A_PORT00_PIN12
        UartCTSPolarity = HIGH
        UartDataLength = 8
        UartStopBits = 1
        UartParityBit = NOPARITY
        UartTxChannelMode = INTERRUPT
        UartRxChannelMode = INTERRUPT
        UartNotification:
          UartTransmitNotifPtr = NULL_PTR
          UartReceiveNotifPtr = NULL_PTR
          UartAbortTransmitNotifPtr = NULL_PTR
          UartAbortReceiveNotifPtr = NULL_PTR
          UartStreamingRecvNotifPtr = NULL_PTR
    CommonPublishedInformation:
      ArMajorVersion = 4
      ArMinorVersion = 4
      ArPatchVersion = 0
      SwMajorVersion = 20
      SwMinorVersion = 25
      SwPatchVersion = 0
      ModuleId = 255
      VendorId = 17
      Release = _TRICORE_TC397
