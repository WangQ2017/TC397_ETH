AUTOSAR XML (schema 00048)
package /ActiveEcuC
  module config EthSM: implementation-config-variant=VARIANT-PRE-COMPILE, module-description=EthSM_Impl
    EthSMGeneral: EthSMDevErrorDetect=true, EthSMMainFunctionPeriod=0.005, EthSMVersionInfoApi=false, EthSMEnableEthIfApiTimeout=false, EthSMSafeBswChecks=false
      EthSMGeneration: EthSMOutOfBoundsWriteSanitizer=false, EthSMOutOfBoundsReadSanitizer=false, EthSMShortSymbols=false
    EthSMNetwork_Vlan10 (EthSMNetwork):
      EthSMConfirmationTimeout = 0.1
      EthSMMaxNumRetry = 0
      EthSMStackType = TcpIp
      EthSMComMNetworkHandleRef = ComMChannel_Vlan10
      EthSMEthIfControllerRef = EthIfController_Vlan10
    EthSMNetwork_Vlan23 (EthSMNetwork):
      EthSMConfirmationTimeout = 0.1
      EthSMMaxNumRetry = 0
      EthSMStackType = TcpIp
      EthSMComMNetworkHandleRef = ComMChannel_Vlan23
      EthSMEthIfControllerRef = EthIfController_Vlan23
