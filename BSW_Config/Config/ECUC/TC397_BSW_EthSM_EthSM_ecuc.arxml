AUTOSAR XML (schema 00048)
package /ActiveEcuC
  module config EthSM: implementation-config-variant=VARIANT-PRE-COMPILE, module-description=EthSM_Impl
    EthSMGeneral: EthSMDevErrorDetect=true, EthSMMainFunctionPeriod=0.02, EthSMVersionInfoApi=false, EthSMEnableEthIfApiTimeout=false, EthSMSafeBswChecks=false
      EthSMGeneration: EthSMOutOfBoundsWriteSanitizer=false, EthSMOutOfBoundsReadSanitizer=false, EthSMShortSymbols=false
    3 x EthSMNetwork, all with EthSMConfirmationTimeout=0.1, EthSMMaxNumRetry=0, EthSMStackType=TcpIp:
      EthSMNetwork_untagged: EthSMComMNetworkHandleRef=ComMChannel_untagged, EthSMEthIfControllerRef=EthIfController_untagged
      EthSMNetwork_Vlan1: EthSMComMNetworkHandleRef=ComMChannel_Vlan1, EthSMEthIfControllerRef=EthIfController_Vlan1
      EthSMNetwork_Vlan23: EthSMComMNetworkHandleRef=ComMChannel_Vlan23, EthSMEthIfControllerRef=EthIfController_Valn23
