AUTOSAR XML (schema 00048)
package /InitialEcuC
  ecuc value collection InitialEcuC
