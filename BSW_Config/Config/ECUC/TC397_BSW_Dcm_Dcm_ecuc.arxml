AUTOSAR XML (schema 00048)
package /ActiveEcuC
  module config Dcm: implementation-config-variant=VARIANT-PRE-COMPILE, module-description=Dcm_Impl
    DcmConfigSet
      DcmDsd
        DcmDsdServiceTable
          14 x DcmDsdService:
            DiagSessionControl: DcmDsdSidTabServiceId=16, DcmDsdSidTabSubfuncAvail=true
              3 x DcmDsdSubService:
                Default: DcmDsdSubServiceId=1
                Extended: DcmDsdSubServiceId=3
                Programming: DcmDsdSubServiceId=2
            TesterPresent: DcmDsdSidTabServiceId=62, DcmDsdSidTabSubfuncAvail=true
              TesterPresent (DcmDsdSubService): DcmDsdSubServiceId=0
            ReadDataById: DcmDsdSidTabServiceId=34, DcmDsdSidTabSubfuncAvail=false
            EcuReset: DcmDsdSidTabServiceId=17, DcmDsdSidTabSubfuncAvail=true
              Hard (DcmDsdSubService): DcmDsdSubServiceId=1
              Soft (DcmDsdSubService): DcmDsdSubServiceId=3
            WriteDataById: DcmDsdSidTabServiceId=46, DcmDsdSidTabSubfuncAvail=false
            ClearDiagInfo: DcmDsdSidTabServiceId=20, DcmDsdSidTabSubfuncAvail=false, DcmDsdSidTabSessionLevelRef=DcmDspSessionRow_Extended, DcmDsdSidTabSessionLevelRef=DcmDspSessionRow_Default
            CommunicationControl: DcmDsdSidTabServiceId=40, DcmDsdSidTabSubfuncAvail=true, DcmDsdSidTabSessionLevelRef=DcmDspSessionRow_Extended
              EnableRxAndDisableTx (DcmDsdSubService): DcmDsdSubServiceId=1, DcmDsdSubServiceSessionLevelRef=DcmDspSessionRow_Extended
              EnableRxAndTx (DcmDsdSubService): DcmDsdSubServiceId=0, DcmDsdSubServiceSessionLevelRef=DcmDspSessionRow_Extended
            ReadDtcInfo: DcmDsdSidTabServiceId=25, DcmDsdSidTabSubfuncAvail=true
              6 x DcmDsdSubService:
                RNODTCBSM: DcmDsdSubServiceId=1
                RDTCBSM: DcmDsdSubServiceId=2
                RDTCSSBDTC: DcmDsdSubServiceId=4
                RDTCEDRBDN: DcmDsdSubServiceId=6
                RSUPDTC: DcmDsdSubServiceId=10
                RDTCFDC: DcmDsdSubServiceId=20
            RoutineControl: DcmDsdSidTabServiceId=49, DcmDsdSidTabSubfuncAvail=true
            RequestDownload: DcmDsdSidTabServiceId=52, DcmDsdSidTabSubfuncAvail=false, DcmDsdSidTabFnc=Dcm_DiagnosticService_0x34, DcmDsdSidTabSessionLevelRef=DcmDspSessionRow_Programming
            RequestTransferExit: DcmDsdSidTabServiceId=55, DcmDsdSidTabSubfuncAvail=false, DcmDsdSidTabFnc=Dcm_DiagnosticService_0x37
            RequestUpload: DcmDsdSidTabServiceId=53, DcmDsdSidTabSubfuncAvail=false, DcmDsdSidTabFnc=Dcm_DiagnosticService_0x35, DcmDsdSidTabSessionLevelRef=DcmDspSessionRow_Programming, DcmDsdSidTabSessionLevelRef=DcmDspSessionRow_Extended
            SecurityAccess: DcmDsdSidTabServiceId=39, DcmDsdSidTabSubfuncAvail=true, DcmDsdSidTabSessionLevelRef=DcmDspSessionRow_Extended, DcmDsdSidTabSessionLevelRef=DcmDspSessionRow_Programming
              level3_request_Seed (DcmDsdSubService): DcmDsdSubServiceId=5, DcmDsdSubServiceSessionLevelRef=DcmDspSessionRow_Extended, DcmDsdSubServiceSessionLevelRef=DcmDspSessionRow_Programming
              level3_send_key (DcmDsdSubService): DcmDsdSubServiceId=6, DcmDsdSubServiceSessionLevelRef=DcmDspSessionRow_Extended, DcmDsdSubServiceSessionLevelRef=DcmDspSessionRow_Programming
            TransferData: DcmDsdSidTabServiceId=54, DcmDsdSidTabSubfuncAvail=false, DcmDsdSidTabFnc=Dcm_DiagnosticService_0x36
      DcmDsl
        DcmDslBuffer: DcmDslBufferSize=13168
        DcmDslDiagResp: DcmDslDiagRespMaxNumRespPend=0, DcmDslDiagRespOnSecondDeclinedRequest=false, DcmDslDiagRespMaxNumOfDeclinedRequests=3
        DcmDslProtocol
          DcmDslProtocolRow_MAIN (DcmDslProtocolRow):
            DcmDslProtocolEndiannessConvEnabled = false
            DcmDslProtocolID = DCM_UDS_ON_IP
            DcmDslProtocolPreemptTimeout = 0
            DcmDslProtocolPriority = 0
            DcmSendRespPendOnTransToBoot = true
            DcmTimStrP2ServerAdjust = 0.005
            DcmTimStrP2StarServerAdjust = 0.01
            DcmDslProtocolMaximumResponseSize = 4095
            DcmDslProtocolRxBufferID = DcmDslBuffer
            DcmDslProtocolSIDTable = DcmDsdServiceTable
            DcmDslProtocolTxBufferID = DcmDslBuffer
            DcmDemClientRef = DemClient
            DcmDslConnection_DIAG_Ext_MAIN (DcmDslConnection)
              DcmDslMainConnection_DIAG_Ext_MAIN (DcmDslMainConnection): DcmDslProtocolRxTesterSourceAddr=3712, DcmDslProtocolRxConnectionId=1
                DcmDslProtocolRx_DoIP_Phy_Req (DcmDslProtocolRx):
                  DcmDslProtocolRxAddrType = DCM_PHYSICAL_TYPE
                  DcmDslProtocolRxChannelId = 0
                  DcmDslProtocolRxPduId = 0
                  DcmDslProtocolRxPduRef = DoIPPhyReqRxPdu_PduR2Dcm
                  DcmDslProtocolRxComMChannelRef = ComMChannel_Vlan1
                DcmDslProtocolRx_DoIP_Func_Req (DcmDslProtocolRx):
                  DcmDslProtocolRxAddrType = DCM_FUNCTIONAL_TYPE
                  DcmDslProtocolRxChannelId = 0
                  DcmDslProtocolRxPduId = 1
                  DcmDslProtocolRxPduRef = DoIPFuncReqRxPdu_PduR2Dcm
                  DcmDslProtocolRxComMChannelRef = ComMChannel_Vlan1
                DcmDslProtocolTx_DoIP_Phy_Res (DcmDslProtocolTx): DcmDslTxConfirmationPduId=0, DcmDslProtocolTxPduRef=DoIPPhyResTxPdu_Dcm2PduR
      DcmDsp: DcmDspReadDIDReportsNODIByte=false
        DcmDspSecurity
          Level_3 (DcmDspSecurityRow):
            DcmDspSecurityAttemptCounterEnabled = true
            DcmDspSecurityDelayTime = 10
            DcmDspSecurityDelayTimeOnBoot = 0
            DcmDspSecurityKeySize = 64
            DcmDspSecurityLevel = 3
            DcmDspSecurityNumAttDelay = 1
            DcmDspSecuritySeedSize = 32
            DcmDspSecurityUsePort = USE_ASYNCH_CLIENT_SERVER
        DcmDspSession
          3 x DcmDspSessionRow, all with DcmDspSessionForBoot=DCM_NO_BOOT, DcmDspSessionP2ServerMax=0.02, DcmDspSessionP2StarServerMax=2:
            DcmDspSessionRow_Default: DcmDspSessionLevel=1
            DcmDspSessionRow_Extended: DcmDspSessionLevel=3
            DcmDspSessionRow_Programming: DcmDspSessionLevel=2
        DcmDspComControl
          DcmDspComControlAllChannel: DcmDspAllComMChannelRef=ComMChannel_Vlan1
        DcmDspRoutine_Get_Link_Quality_Start (DcmDspRoutine):
          DcmDspRequestResultsRoutineSupported = true
          DcmDspRoutineFixedLength = false
          DcmDspRoutineIdentifier = 592
          DcmDspRoutineUsePort = true
          DcmDspRoutineUsed = true
          DcmDspStopRoutineSupported = false
          DcmDspRoutineInfoRef = DcmDspRoutineInfo_Get_Link_Quality_Start
        DcmDspRoutineInfo_Get_Link_Quality_Start (DcmDspRoutineInfo)
          DcmDspRoutineAuthorization
          DcmDspStartRoutineIn
            Port_Number (DcmDspStartRoutineInSignal): DcmDspRoutineSignalLength=8, DcmDspRoutineSignalPos=0, DcmDspRoutineSignalType=UINT8
          DcmDspStartRoutineOut
            Link_Quality (DcmDspStartRoutineOutSignal): DcmDspRoutineSignalLength=8, DcmDspRoutineSignalPos=0, DcmDspRoutineSignalType=UINT8
        DcmDspDid_0x16F_Version_Info_WR (DcmDspDid): DcmDspDidIdentifier=367, DcmDspDidUsed=true, DcmDspDidUsePort=USE_DATA_ELEMENT_SPECIFIC_INTERFACES, DcmDspDidInfoRef=DcmDspDidInfo_Version_Info
          DcmDspDidSignal: DcmDspDidDataPos=0, DcmDspDidDataRef=Version_Info
        DcmDspDidInfo_Version_Info (DcmDspDidInfo)
          DcmDspDidAccess
            DcmDspDidRead
            DcmDspDidWrite: DcmDspDidWriteSessionRef=DcmDspSessionRow_Extended
        Version_Info (DcmDspData):
          DcmDspDataSize = 64
          DcmDspDataUsePort = USE_DATA_ASYNCH_CLIENT_SERVER
          DcmDspDataType = UINT8
          DcmDspDataConditionCheckReadFncUsed = true
          DcmDspDataTypedClientServerPortEnabled = true
          DcmDspDataInfoRef = Info_Version_Info
        Info_Version_Info (DcmDspDataInfo): DcmDspDataFixedLength=true
      DcmGeneral:
        DcmDevErrorDetect = true
        DcmRequestManufacturerNotificationEnabled = false
        DcmRequestSupplierNotificationEnabled = false
        DcmRespondAllRequest = true
        DcmTaskTime = 0.005
        DcmVersionInfoApi = false
        DcmDspDataDefaultEndianness = LITTLE_ENDIAN
        DcmSafeBswChecks = false
        DcmSupportedIDCalculationSuppressionEnabled = false
        DcmDtrDataProvisionViaDemEnabled = true
        DcmForeignDiagnosticRequestDetectionEnabled = false
        DcmSuppressResponseOnCanTpFuncMixedAddrRequests = false
        DcmSenderReceiverPRPortsEnabled = false
        DcmUserConfigFile = 
      DcmPageBufferCfg: DcmPagedBufferEnabled=true
