AUTOSAR XML (schema 00048)
package /ActiveEcuC
  module config Dcm: implementation-config-variant=VARIANT-PRE-COMPILE, module-description=Dcm_Impl
    DcmConfigSet
      DcmDsd
        DcmDsdServiceTable
          DiagSessionControl (DcmDsdService): DcmDsdSidTabServiceId=16, DcmDsdSidTabSubfuncAvail=true
            3 x DcmDsdSubService:
              Default: DcmDsdSubServiceId=1
              Extended: DcmDsdSubServiceId=3
              Programming: DcmDsdSubServiceId=2
          TesterPresent (DcmDsdService): DcmDsdSidTabServiceId=62, DcmDsdSidTabSubfuncAvail=true
            TesterPresent (DcmDsdSubService): DcmDsdSubServiceId=0
      DcmDsl
        DcmDslBuffer: DcmDslBufferSize=13168
        DcmDslDiagResp: DcmDslDiagRespMaxNumRespPend=0, DcmDslDiagRespOnSecondDeclinedRequest=false, DcmDslDiagRespMaxNumOfDeclinedRequests=3
        DcmDslProtocol
          DcmDslProtocolRow_MAIN (DcmDslProtocolRow):
            DcmDslProtocolEndiannessConvEnabled = false
            DcmDslProtocolID = DCM_UDS_ON_IP
            DcmDslProtocolPreemptTimeout = 0
            DcmDslProtocolPriority = 0
            DcmSendRespPendOnTransToBoot = true
            DcmTimStrP2ServerAdjust = 0
            DcmTimStrP2StarServerAdjust = 0
            DcmDslProtocolRxBufferID = DcmDslBuffer
            DcmDslProtocolSIDTable = DcmDsdServiceTable
            DcmDslProtocolTxBufferID = DcmDslBuffer
            DcmDslConnection_DIAG_Ext_MAIN (DcmDslConnection)
              DcmDslMainConnection_DIAG_Ext_MAIN (DcmDslMainConnection): DcmDslProtocolRxTesterSourceAddr=3712, DcmDslProtocolRxConnectionId=1
                DcmDslProtocolRx_DoIP_Phy_Req (DcmDslProtocolRx):
                  DcmDslProtocolRxAddrType = DCM_PHYSICAL_TYPE
                  DcmDslProtocolRxChannelId = 0
                  DcmDslProtocolRxPduId = 0
                  DcmDslProtocolRxPduRef = DoIPPhyReqRxPdu_PduR2Dcm
                  DcmDslProtocolRxComMChannelRef = ComMChannel_Vlan1
                DcmDslProtocolRx_DoIP_Func_Req (DcmDslProtocolRx):
                  DcmDslProtocolRxAddrType = DCM_FUNCTIONAL_TYPE
                  DcmDslProtocolRxChannelId = 0
                  DcmDslProtocolRxPduId = 1
                  DcmDslProtocolRxPduRef = DoIPFuncReqRxPdu_PduR2Dcm
                  DcmDslProtocolRxComMChannelRef = ComMChannel_Vlan1
                DcmDslProtocolTx_DoIP_Phy_Res (DcmDslProtocolTx): DcmDslTxConfirmationPduId=0, DcmDslProtocolTxPduRef=DoIPPhyResTxPdu_Dcm2PduR
      DcmDsp: DcmDspReadDIDReportsNODIByte=false
        DcmDspSecurity
        DcmDspSession
          3 x DcmDspSessionRow, all with DcmDspSessionForBoot=DCM_NO_BOOT, DcmDspSessionP2ServerMax=0.02, DcmDspSessionP2StarServerMax=2:
            DcmDspSessionRow_Default: DcmDspSessionLevel=1
            DcmDspSessionRow_Extended: DcmDspSessionLevel=3
            DcmDspSessionRow_Programming: DcmDspSessionLevel=2
        DcmDspComControl
          DcmDspComControlAllChannel: DcmDspAllComMChannelRef=ComMChannel_Vlan1
      DcmGeneral:
        DcmDevErrorDetect = true
        DcmRequestManufacturerNotificationEnabled = false
        DcmRequestSupplierNotificationEnabled = false
        DcmRespondAllRequest = true
        DcmTaskTime = 0.005
        DcmVersionInfoApi = false
        DcmDspDataDefaultEndianness = LITTLE_ENDIAN
        DcmSafeBswChecks = false
        DcmSupportedIDCalculationSuppressionEnabled = false
        DcmDtrDataProvisionViaDemEnabled = true
        DcmForeignDiagnosticRequestDetectionEnabled = false
        DcmSuppressResponseOnCanTpFuncMixedAddrRequests = false
        DcmSenderReceiverPRPortsEnabled = false
        DcmUserConfigFile = 
      DcmPageBufferCfg: DcmPagedBufferEnabled=true
