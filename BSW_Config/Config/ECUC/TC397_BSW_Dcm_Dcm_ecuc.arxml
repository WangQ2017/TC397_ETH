AUTOSAR XML (schema 00048)
package /ActiveEcuC
  module config Dcm: implementation-config-variant=VARIANT-PRE-COMPILE, module-description=Dcm_Impl
    DcmConfigSet
      DcmDsd
        DcmDsdServiceTable
          5 x DcmDsdService:
            DiagSessionControl: DcmDsdSidTabServiceId=16, DcmDsdSidTabSubfuncAvail=true
              3 x DcmDsdSubService:
                Default: DcmDsdSubServiceId=1
                Programming: DcmDsdSubServiceId=2
                Extend: DcmDsdSubServiceId=3
            ReadDataById: DcmDsdSidTabServiceId=34, DcmDsdSidTabSubfuncAvail=false
            WriteDataById: DcmDsdSidTabServiceId=46, DcmDsdSidTabSubfuncAvail=false
            RoutineControl: DcmDsdSidTabServiceId=49, DcmDsdSidTabSubfuncAvail=true
            TesterPresent: DcmDsdSidTabServiceId=62, DcmDsdSidTabSubfuncAvail=true
              DcmDsdSubService: DcmDsdSubServiceId=0
      DcmDsl
        DcmDslBuffer: DcmDslBufferSize=13168
        DcmDslDiagResp: DcmDslDiagRespMaxNumRespPend=0, DcmDslDiagRespOnSecondDeclinedRequest=false, DcmDslDiagRespMaxNumOfDeclinedRequests=3
        DcmDslProtocol
          DcmDslProtocolRow:
            DcmDslProtocolEndiannessConvEnabled = false
            DcmDslProtocolID = DCM_UDS_ON_IP
            DcmDslProtocolPreemptTimeout = 0
            DcmDslProtocolPriority = 0
            DcmSendRespPendOnTransToBoot = true
            DcmTimStrP2ServerAdjust = 0.005
            DcmTimStrP2StarServerAdjust = 0.01
            DcmDslProtocolRxBufferID = DcmDslBuffer
            DcmDslProtocolSIDTable = DcmDsdServiceTable
            DcmDslProtocolTxBufferID = DcmDslBuffer
            DcmDslConnection_DIAG_MAIN (DcmDslConnection)
              DcmDslMainConnection: DcmDslProtocolRxTesterSourceAddr=3712, DcmDslProtocolRxConnectionId=1
                DcmDslProtocolRx_DOIP_PHY_REQ (DcmDslProtocolRx):
                  DcmDslProtocolRxAddrType = DCM_PHYSICAL_TYPE
                  DcmDslProtocolRxChannelId = 0
                  DcmDslProtocolRxPduId = 1
                  DcmDslProtocolRxPduRef = DoIPPhyReqRxPdu_PduR2Dcm
                  DcmDslProtocolRxComMChannelRef = ComMChannel_Vlan1
                DcmDslProtocolRx_DOIP_FUNC_REQ (DcmDslProtocolRx):
                  DcmDslProtocolRxAddrType = DCM_FUNCTIONAL_TYPE
                  DcmDslProtocolRxChannelId = 0
                  DcmDslProtocolRxPduId = 0
                  DcmDslProtocolRxPduRef = DoIPFuncReqRxPdu_PduR2Dcm
                  DcmDslProtocolRxComMChannelRef = ComMChannel_Vlan1
                DcmDslProtocolTx: DcmDslTxConfirmationPduId=0, DcmDslProtocolTxPduRef=DoIPPhyResTxPdu_Dcm2PduR
      DcmDsp: DcmDspReadDIDReportsNODIByte=false
        DcmDspSecurity
        DcmDspSession
          3 x DcmDspSessionRow, all with DcmDspSessionForBoot=DCM_NO_BOOT, DcmDspSessionP2ServerMax=0.05, DcmDspSessionP2StarServerMax=5:
            DcmDspSessionRow_default: DcmDspSessionLevel=1
            DcmDspSessionRow_Programming: DcmDspSessionLevel=2
            DcmDspSessionRow_Extend: DcmDspSessionLevel=3
        DcmDspDid_0x16F_NetPara (DcmDspDid): DcmDspDidIdentifier=367, DcmDspDidUsed=true, DcmDspDidUsePort=USE_DATA_ELEMENT_SPECIFIC_INTERFACES, DcmDspDidInfoRef=DcmDspDidInfo_NetPara
          DcmDspDidSignal: DcmDspDidDataPos=0, DcmDspDidDataRef=DcmDspData_NetPara
        DcmDspDidInfo_NetPara (DcmDspDidInfo)
          DcmDspDidAccess
            DcmDspDidRead
            DcmDspDidWrite: DcmDspDidWriteSessionRef=DcmDspSessionRow_Extend
        DcmDspData_NetPara (DcmDspData): DcmDspDataSize=64, DcmDspDataUsePort=USE_DATA_ASYNCH_CLIENT_SERVER, DcmDspDataType=UINT8, DcmDspDataInfoRef=DcmDspDataInfo_NetPara
        DcmDspDataInfo_NetPara (DcmDspDataInfo): DcmDspDataFixedLength=true
        DcmDspRoutine_0x250_SetPhyTxMode (DcmDspRoutine):
          DcmDspRequestResultsRoutineSupported = true
          DcmDspRoutineFixedLength = false
          DcmDspRoutineIdentifier = 592
          DcmDspRoutineUsePort = true
          DcmDspRoutineUsed = true
          DcmDspStopRoutineSupported = false
          DcmDspRoutineInfoRef = DcmDspRoutineInfo_0x250_SetPhyTxMode
        DcmDspRoutineInfo_0x250_SetPhyTxMode (DcmDspRoutineInfo)
          DcmDspRoutineAuthorization
          DcmDspStartRoutineIn
            TxMode (DcmDspStartRoutineInSignal): DcmDspRoutineSignalLength=8, DcmDspRoutineSignalPos=0, DcmDspRoutineSignalType=UINT8
      DcmGeneral:
        DcmDevErrorDetect = true
        DcmRequestManufacturerNotificationEnabled = false
        DcmRequestSupplierNotificationEnabled = false
        DcmRespondAllRequest = true
        DcmTaskTime = 0.005
        DcmVersionInfoApi = false
        DcmDspDataDefaultEndianness = LITTLE_ENDIAN
        DcmSafeBswChecks = false
        DcmSupportedIDCalculationSuppressionEnabled = false
        DcmDtrDataProvisionViaDemEnabled = true
        DcmForeignDiagnosticRequestDetectionEnabled = false
        DcmSuppressResponseOnCanTpFuncMixedAddrRequests = false
        DcmSenderReceiverPRPortsEnabled = false
      DcmPageBufferCfg: DcmPagedBufferEnabled=true
