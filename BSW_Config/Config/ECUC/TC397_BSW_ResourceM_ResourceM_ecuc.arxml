AUTOSAR XML (schema 00048)
package /ResourceM
  module config ResourceM: implementation-config-variant=VARIANT-PRE-COMPILE
    ResourceMMcalConfig_0 (ResourceMMcalConfig): ResourceMMasterCore=CORE0, ResourceMNumberOfActiveCores=6
      6 x ResourceMMcalCore:
        ResourceMMcalCore_{0..5}: ResourceMCoreID=CORE{0..5}
    ResourceMGeneral: ResourceMSubDerivative=TC397x
