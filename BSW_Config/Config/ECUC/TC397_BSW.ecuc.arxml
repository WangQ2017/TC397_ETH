AUTOSAR XML (schema 00048)
package /ActiveEcuC
  ecuc value collection ActiveEcuC: ecu-extract=SYSTEM
    ecuc-values:
      ResourceM
      Dio
      McalLib
      Port
      Mcu
      Irq
      vSet
      vLinkGen
      vBRS
      BswM
      EcuM
      vBaseEnv
      Det
      Rte
      Os
      EcuC
      EthTrcv
      EthIf
      Eth
      UdpNm
      EthSM
      SoAd
      TcpIp
      PduR
      EthTSyn
      StbM
      ComM
      Uart
      Nm
      Com
