AUTOSAR XML (schema 00048)
package /ActiveEcuC
  ecuc value collection ActiveEcuC: ecu-extract=SYSTEM
    ecuc-values:
      vSet
      vLinkGen
      vBRS
      BswM
      EcuM
      vBaseEnv
      Det
      Rte
      Os
      EcuC
      Uart
      EthTrcv
      Eth
      ResourceM
      McalLib
      Dio
      Crc
      Uart
      Irq
      Port
      Mcu
      EthIf
      EthTSyn
      StbM
      TcpIp
      EthSM
      ComM
      SoAd
      PduR
      LdCom
      Com
      DoIP
      Dcm
      Sd
