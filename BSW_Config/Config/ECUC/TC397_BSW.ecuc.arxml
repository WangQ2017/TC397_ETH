AUTOSAR XML (schema 00048)
package /ActiveEcuC
  ecuc value collection ActiveEcuC: ecu-extract=SYSTEM
    ecuc-values:
      vSet
      vLinkGen
      vBRS
      BswM
      EcuM
      vBaseEnv
      Det
      Rte
      Os
      EcuC
      UdpNm
      EthSM
      SoAd
      TcpIp
      PduR
      EthTSyn
      StbM
      ComM
      Uart
      Nm
      Com
      EthIf
      EthTrcv
      Eth
      ResourceM
      McalLib
      Dio
      Crc
      Uart
      Irq
      Port
      Mcu
      Sd
      LdCom
      DoIP
      Dcm
      Fee
      Fls
      NvM
      MemIf
      Dem
