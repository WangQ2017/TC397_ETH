AUTOSAR XML (schema 00048)
package /Dio
  module config Dio: implementation-config-variant=VARIANT-LINK-TIME, module-description=Dio_Impl
    CommonPublishedInformation:
      ArMajorVersion = 4
      ArMinorVersion = 4
      ArPatchVersion = 0
      ModuleId = 120
      Release = _TRICORE_TC397
      SwMajorVersion = 20
      SwMinorVersion = 25
      SwPatchVersion = 0
      VendorId = 17
    DioConfig
      DioPort_0 (DioPort): DioPortId=0
        DioChannel_PHY_RESET (DioChannel): DioChannelId=0
        DioChannel_PHY_WAKE (DioChannel): DioChannelId=1
      DioPort_33 (DioPort): DioPortId=33
        4 x DioChannel:
          DioChannel_LED0: DioChannelId=1
          DioChannel_LED1: DioChannelId=2
          DioChannel_LED2: DioChannelId=3
          DioChannel_LED3: DioChannelId=4
    DioGeneral: DioDevErrorDetect=false, DioFlipChannelApi=true, DioMaskedWritePortApi=false, DioSafetyEnable=false, DioVersionInfoApi=false
