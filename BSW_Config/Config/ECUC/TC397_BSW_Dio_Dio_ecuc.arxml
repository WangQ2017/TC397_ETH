AUTOSAR XML (schema 00048)
package /Dio
  module config Dio: implementation-config-variant=VARIANT-LINK-TIME, module-description=Dio_Impl
    CommonPublishedInformation:
      ArMajorVersion = 4
      ArMinorVersion = 4
      ArPatchVersion = 0
      ModuleId = 120
      Release = _TRICORE_TC397
      SwMajorVersion = 20
      SwMinorVersion = 25
      SwPatchVersion = 0
      VendorId = 17
    DioConfig
      4 x DioPort:
        DioPort_20: DioPortId=20
          DioChannel_LED4 (DioChannel): DioChannelId=11
          DioChannel_LED5 (DioChannel): DioChannelId=12
        DioPort_33: DioPortId=33
          4 x DioChannel:
            DioChannel_LED0: DioChannelId=1
            DioChannel_LED1: DioChannelId=2
            DioChannel_LED2: DioChannelId=3
            DioChannel_LED3: DioChannelId=4
        DioPort_11: DioPortId=11
          DioChannel_MDC (DioChannel): DioChannelId=0
          DioChannel_MDIO (DioChannel): DioChannelId=1
        DioPort_12: DioPortId=12
          14 x DioChannel:
            DioChannel_TX3: DioChannelId=0
            DioChannel_TX2: DioChannelId=1
            DioChannel_TX1: DioChannelId=2
            DioChannel_TX0: DioChannelId=3
            DioChannel_TXER: DioChannelId=4
            DioChannel_TXCLK: DioChannelId=5
            DioChannel_TXEN: DioChannelId=6
            DioChannel_RX3: DioChannelId=7
            DioChannel_RX2: DioChannelId=8
            DioChannel_RX1: DioChannelId=9
            DioChannel_RX0: DioChannelId=10
            DioChannel_CRSDV: DioChannelId=11
            DioChannel_RXER: DioChannelId=13
            DioChannel_REFCLK: DioChannelId=12
    DioGeneral: DioDevErrorDetect=false, DioFlipChannelApi=false, DioMaskedWritePortApi=false, DioSafetyEnable=true, DioVersionInfoApi=false
