AUTOSAR XML (schema 00048)
package /ActiveEcuC
  module config Dem: implementation-config-variant=VARIANT-PRE-COMPILE, module-description=Dem_Impl
    DemGeneral:
      DemAgingCycleCounterProcessing = DEM_PROCESS_AGINGCTR_INTERN
      DemGeneralInterfaceSupport = false
      DemDataElementDefaultEndianness = LITTLE_ENDIAN
      DemAgingRequieresTestedCycle = false
      DemMaxNumberEventEntryMirror = 0
      DemPTOSupport = false
      DemTriggerMonitorInitBeforeClearOk = true
      DemExtendedDataCapture = DEM_TRIGGER_EVENT_MEMORY_STORAGE
      DemFreezeFrameCapture = DEM_TRIGGER_EVENT_MEMORY_STORAGE
      DemOperationCycleProcessing = DEM_PROCESS_OPCYC_STATE
      DemMaxNumberTimeSeriesSnapshots = 0
      DemAvailabilitySupport = DEM_NO_AVAILABILITY
      DemAvailabilityStorage = false
      DemBswErrorBufferSize = 0
      DemClearDTCBehavior = DEM_CLRRESP_VOLATILE
      DemClearDTCLimitation = DEM_ALL_SUPPORTED_DTCS
      DemDebounceCounterBasedSupport = true
      DemDebounceTimeBasedSupport = false
      DemDevErrorDetect = true
      DemDtcStatusAvailabilityMask = 255
      DemEnableConditionSupport = true
      DemEventCombinationSupport = DEM_EVCOMB_DISABLED
      DemEventDisplacementStrategy = DEM_DISPLACEMENT_LEGACY_403
      DemEventMemoryEntryStorageTrigger = DEM_STORAGE_ON_TEST_FAILED
      DemMaxNumberEventEntryOBDFreezeFrame = 0
      DemMaxNumberEventEntryPermanent = 0
      DemMaxNumberEventEntryPrimary = 1
      DemMaxNumberEventEntrySecondary = 0
      DemMaxNumberPrestoredFF = 0
      DemOBDSupport = DEM_OBD_NO_OBD_SUPPORT
      DemOccurrenceCounterProcessing = DEM_PROCESS_OCCCTR_TF
      DemOperationCycleStatusStorage = false
      DemResetConfirmedBitOnOverflow = true
      DemStatusBitHandlingTestFailedSinceLastClear = DEM_STATUS_BIT_NORMAL
      DemStatusBitStorageTestFailed = true
      DemStorageConditionSupport = true
      DemSuppressionSupport = DEM_NO_SUPPRESSION
      DemTaskTime = 0.01
      DemTriggerDcmReports = false
      DemTriggerDltReports = false
      DemTriggerFiMReports = false
      DemTriggerFiMReportsExtended = false
      DemTriggerMonitorInitForEnableConditions = false
      DemTypeOfDTCSupported = DEM_DTC_TRANSLATION_ISO14229_1
      DemTypeOfFreezeFrameRecordNumeration = DEM_FF_RECNUM_CONFIGURED
      DemVersionInfoApi = false
      DemBswApiVersion = DEM_BSW_API_4_XX_XX
      DemBswApiVersionNvM = DEM_BSW_API_4_XX_XX
      DemBswApiVersionFiM = DEM_BSW_API_4_XX_XX
      DemAgingAfterHealing = DEM_AGING_WHILE_HEALING
      DemAgingBehavior = DEM_AGING_TYPE_1
      DemAgingCounterBehavior = DEM_AGING_COUNT_ALWAYS
      DemAgingCounterReporting = DEM_AGING_NORMAL_REPORTING
      DemAgingRetainEnvironmentalData = false
      DemCompiledPostbuildCrc = 1532641051
      DemCompiledPostbuildCrcMode = DEM_POSTBUILD_CRC_AUTOMATIC
      DemEventDisplacementFallbackStrategy = DEM_FALLBACK_DISCARD_NEW_EVENT
      DemGeneralDiagnosticInfoSupport = true
      DemJ1939Support = false
      DemNvSynchronizeSupport = false
      DemPendingDtcProcessing = DEM_PROCESS_PDTC_ALL_DTC
      DemResetDebounceBehavior = DEM_RESET_DEBOUNCE_ON_DISABLE_ENABLE_CONDITIONS
      DemResetTestFailedOnOperationCycleStart = false
      DemRetryStorageSupport = false
      DemSafeBswChecks = false
      DemUseMemcopyMacros = false
      DemUseRte = true
      DemUserControlledWirBehavior = DEM_ENABLED_DURING_CONTROLDTCSETTING
      DemUserDefinedCompareAndSwap = false
      DemWarningIndicatorRequestedProcessing = DEM_PROCESS_WIR_STOREDONLY
      DemUseMultiPartitionFiM = false
      DemReportSuppressedDTCsInService19x0A = false
      DemSupportAgingForAllDTCs = false
      DemLatchTestFailedBehavior = DEM_LATCH_TF_CONFIRMED_AND_THIS_CYCLE
      DemEventMemorySet
      PowerCycle (DemOperationCycle): DemOperationCycleAutomaticEnd=false, DemOperationCycleAutostart=false, DemOperationCycleType=DEM_OPCYC_OTHER
      DemPostbuild: DemEventAvailableDefaultSupport=true, DemMaxSizeFreezeFrame=8, DemMaxNumberDtr=0, DemMaxSizeGlobalFreezeFrame=0
      DemClient: DemClientId=0
      POWER_MODE (DemOperationCycle): DemOperationCycleAutomaticEnd=false, DemOperationCycleAutostart=false, DemOperationCycleType=DEM_OPCYC_POWER
      Did_0x16E_MCU_Info (DemDidClass): DemDidIdentifier=366, DemDidDataClassRef=Data_Did_0x16E_MCU_Info
      Data_Did_0x16E_MCU_Info (DemDataClass): DemDataElementDataSize=8, DemDataElementStoreNonVolatile=true, DemDataElementUsePort=USE_DATA_CLIENT_SERVER_PORT
      DemFreezeFrameClass0 (DemFreezeFrameClass): DemDidClassRef=Did_0x16E_MCU_Info
      9 x DemEnableCondition, all with DemEnableConditionStatus=false:
        SC1_Control_DTC_Setting: DemEnableConditionId=1
        SC3_Local_Voltage: DemEnableConditionId=2
        SC4_System_Voltage: DemEnableConditionId=3
        Sc5_Transportation_Mode: DemEnableConditionId=4
        SC8_Communication_Status: DemEnableConditionId=5
        SC10_Debounce_Timer: DemEnableConditionId=6
        SC11_Debounce_Timer_Com: DemEnableConditionId=9
        SC12_Production_Mode: DemEnableConditionId=7
        SC14_Battery_CutOff_Switch: DemEnableConditionId=8
      DemEnableConditionGrou_Network_Communication (DemEnableConditionGroup):
        DemEnableConditionRef = SC1_Control_DTC_Setting
        DemEnableConditionRef = SC3_Local_Voltage
        DemEnableConditionRef = SC4_System_Voltage
        DemEnableConditionRef = Sc5_Transportation_Mode
        DemEnableConditionRef = SC8_Communication_Status
        DemEnableConditionRef = SC10_Debounce_Timer
        DemEnableConditionRef = SC11_Debounce_Timer_Com
        DemEnableConditionRef = SC12_Production_Mode
        DemEnableConditionRef = SC14_Battery_CutOff_Switch
      3 x DemNvRamBlockId:
        Dem_AdminData: DemNvRamBlockIdType=DEM_NVBLOCK_ADMIN, DemNvRamBlockIdRef=DemAdminDataBlock
        Dem_StatusData: DemNvRamBlockIdType=DEM_NVBLOCK_STATUS, DemNvRamBlockIdRef=DemStatusDataBlock
        Dem_PrimaryEntry0: DemNvRamBlockIdType=DEM_NVBLOCK_PRIMARY, DemNvRamBlockIdIndex=0, DemNvRamBlockIdRef=DemPrimaryDataBlock0
      DemFreezeFrameRecNumClass:
        DemFreezeFrameRecordNumber = 16
        DemFreezeFrameRecordUpdate = DEM_UPDATE_RECORD_NO
        DemFreezeFrameRecordTrigger = DEM_RECORD_TRIGGER_CONFIRMED
        DemFreezeFrameRecordNumber = 32
        DemFreezeFrameRecordTrigger = DEM_RECORD_TRIGGER_TESTFAILED
        DemFreezeFrameRecordUpdate = DEM_UPDATE_RECORD_YES
    DemConfigSet
      EVTID_WDG_FAULT (DemEventParameter):
        DemEventTimeSeries = DEM_TIMESERIES_SNAPSHOT_NONE
        DemEventAvailable = true
        DemEventId = 1
        DemEventKind = DEM_EVENT_KIND_SWC
        DemEventAvailableInVariant = true
        DemEventLatchTestFailed = false
        DemEventCreateInfoPort = true
        DemEventClass:
          DemAgingAllowed = false
          DemConsiderPtoStatus = false
          DemEventDestination = DEM_DTC_ORIGIN_PRIMARY_MEMORY
          DemEventPriority = 2
          DemFFPrestorageSupported = false
          DemOperationCycleRef = PowerCycle
          DemDebounceAlgorithmClass
            DemDebounceCounterBased:
              DemDebounceBehavior = DEM_DEBOUNCE_FREEZE
              DemDebounceCounterDecrementStepSize = 1
              DemDebounceCounterFailedThreshold = 127
              DemDebounceCounterIncrementStepSize = 1
              DemDebounceCounterJumpDown = true
              DemDebounceCounterJumpDownValue = 0
              DemDebounceCounterJumpUp = true
              DemDebounceCounterJumpUpValue = 0
              DemDebounceCounterPassedThreshold = -128
              DemDebounceCounterStorage = false
              DemDebounceContinuous = false
      DTC_0xDDD094_Event (DemEventParameter):
        DemEventTimeSeries = DEM_TIMESERIES_SNAPSHOT_NONE
        DemEventAvailable = true
        DemEventId = 2
        DemEventKind = DEM_EVENT_KIND_SWC
        DemEventAvailableInVariant = true
        DemEventLatchTestFailed = false
        DemEventCreateInfoPort = true
        DemFreezeFrameClassRef = DemFreezeFrameClass0
        DemDTCClassRef = DTCClass_DTC_0xDDD094
        DemFreezeFrameRecNumClassRef = DemFreezeFrameRecNumClass
        DemEventClass:
          DemAgingAllowed = false
          DemConsiderPtoStatus = false
          DemEventDestination = DEM_DTC_ORIGIN_PRIMARY_MEMORY
          DemEventPriority = 2
          DemFFPrestorageSupported = false
          DemOperationCycleRef = POWER_MODE
          DemAgingCycleRef = POWER_MODE
          DemEnableConditionGroupRef = DemEnableConditionGrou_Network_Communication
          DemDebounceAlgorithmClass
            DemDebounceMonitorInternal
              DemCallbackGetFDC
      DTCClass_DTC_0xDDD094 (DemDTCClass): DemImmediateNvStorage=true, DemDTCSeverity=DEM_DTC_SEV_NO_SEVERITY, DemUdsDTC=14536852
