AUTOSAR XML (schema 00048)
package /ActiveEcuC
  module config UdpNm: implementation-config-variant=VARIANT-PRE-COMPILE, module-description=UdpNm_Impl
    UdpNmGlobalConfig:
      UdpNmBusSynchronizationEnabled = false
      UdpNmComUserDataSupport = false
      UdpNmCoordinatorSyncSupport = false
      UdpNmDevErrorDetect = true
      UdpNmPassiveModeEnabled = (unset)
      UdpNmPduRxIndicationEnabled = false
      UdpNmRemoteSleepIndEnabled = false
      UdpNmStateChangeIndEnabled = false
      UdpNmUserDataEnabled = false
      UdpNmVersionInfoApi = false
      UdpNmRuntimeMeasurementSupport = (unset)
      UdpNmSafeBswChecks = true
      UdpNmRuntimeErrorReport = true
      UdpNmChannelConfig:
        UdpNmMainFunctionPeriod = 0.01
        UdpNmMsgCycleOffset = 0
        UdpNmMsgCycleTime = 0.1
        UdpNmMsgTimeoutTime = 0.06
        UdpNmNodeId = 0
        UdpNmPduCbvPosition = UDPNM_PDU_OFF
        UdpNmPduLength = 0
        UdpNmPduNidPosition = UDPNM_PDU_OFF
        UdpNmRemoteSleepIndTime = 0.5
        UdpNmRepeatMessageTime = 0.4
        UdpNmTimeoutTime = 1
        UdpNmUserDataLength = 0
        UdpNmWaitBusSleepTime = 0.75
        UdpNmImmediateNmTransmissions = 0
        UdpNmCarWakeUpRxEnabled = false
        UdpNmActiveWakeupBitEnabled = false
        UdpNmNodeIdEnabled = false
        UdpNmNodeDetectionEnabled = false
        UdpNmComControlEnabled = false
        UdpNmImmediateRestartEnabled = false
        UdpNmRepeatMsgIndEnabled = false
        UdpNmCriBitAlwaysEnabled = false
        UdpNmComMNetworkHandleRef = (unset)
        UdpNmRxPdu: UdpNmRxPduId=0, UdpNmRxPduRef=(unset)
      UdpNmGeneration: UdpNmOutOfBoundsWriteSanitizer=false, UdpNmOutOfBoundsReadSanitizer=false, UdpNmInterfacesForDeactivatedData=false
