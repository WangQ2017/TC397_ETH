AUTOSAR XML (schema 00048)
package /ActiveEcuC
  module config UdpNm: implementation-config-variant=VARIANT-PRE-COMPILE, module-description=UdpNm_Impl
    UdpNmGlobalConfig:
      UdpNmBusSynchronizationEnabled = false
      UdpNmComUserDataSupport = true
      UdpNmCoordinatorSyncSupport = false
      UdpNmDevErrorDetect = true
      UdpNmPassiveModeEnabled = false
      UdpNmPduRxIndicationEnabled = false
      UdpNmRemoteSleepIndEnabled = false
      UdpNmStateChangeIndEnabled = true
      UdpNmUserDataEnabled = false
      UdpNmVersionInfoApi = false
      UdpNmRuntimeMeasurementSupport = false
      UdpNmSafeBswChecks = true
      UdpNmRuntimeErrorReport = true
      UdpNmPnEiraCalcEnabled = true
      UdpNmPnResetTime = 1
      UdpNmPnEiraRxNSduRef = PncEiraEthRxPdu
      UdpNmChannelConfig_Vlan10 (UdpNmChannelConfig):
        UdpNmMainFunctionPeriod = 0.005
        UdpNmMsgCycleOffset = 0
        UdpNmMsgCycleTime = 0.1
        UdpNmMsgTimeoutTime = 0.06
        UdpNmNodeId = 0
        UdpNmPduCbvPosition = UDPNM_PDU_BYTE_0
        UdpNmPduLength = 8
        UdpNmPduNidPosition = UDPNM_PDU_OFF
        UdpNmRemoteSleepIndTime = 0.5
        UdpNmRepeatMessageTime = 0.4
        UdpNmTimeoutTime = 2.1
        UdpNmUserDataLength = 7
        UdpNmWaitBusSleepTime = 0.75
        UdpNmImmediateNmTransmissions = 5
        UdpNmCarWakeUpRxEnabled = false
        UdpNmActiveWakeupBitEnabled = true
        UdpNmNodeIdEnabled = false
        UdpNmNodeDetectionEnabled = false
        UdpNmComControlEnabled = true
        UdpNmImmediateRestartEnabled = false
        UdpNmRepeatMsgIndEnabled = false
        UdpNmCriBitAlwaysEnabled = false
        UdpNmPnHandleMultipleNetworkRequests = true
        UdpNmRetryFirstMessageRequest = true
        UdpNmAllNmMessagesKeepAwake = true
        UdpNmImmediateNmCycleTime = 0.02
        UdpNmPnEnabled = true
        UdpNmPnEraCalcEnabled = false
        UdpNmComMNetworkHandleRef = ComMChannel_Vlan10
        UdpNmRxPdu: UdpNmRxPduId=0, UdpNmRxPduRef=UdpNmRxPdu
        UdpNmUserDataTxPdu: UdpNmTxUserDataPduId=0, UdpNmTxUserDataPduRef=PncEiraEthTxPdu
        UdpNmTxPdu: UdpNmTxConfirmationPduId=0, UdpNmTxPduRef=UdpNmTxPdu
      UdpNmGeneration: UdpNmOutOfBoundsWriteSanitizer=false, UdpNmOutOfBoundsReadSanitizer=false, UdpNmInterfacesForDeactivatedData=false
      UdpNmPnInfo: UdpNmPnInfoLength=7, UdpNmPnInfoOffset=1
        7 x UdpNmPnFilterMaskByte:
          UdpNmPnFilterMaskByte0: UdpNmPnFilterMaskByteIndex=0, UdpNmPnFilterMaskByteValue=1
          UdpNmPnFilterMaskByte{1..6}: UdpNmPnFilterMaskByteIndex={1..6}, UdpNmPnFilterMaskByteValue=0
