AUTOSAR XML (schema 00048)
package /ActiveEcuC
  module config Sd: implementation-config-variant=VARIANT-PRE-COMPILE, module-description=Sd_Impl
    SdConfig
      SdInstance_Vlan23 (SdInstance): SdMaxNrDestAddr=10, SdInOutQueueSize=32, SdInQueueProcessLimit=0
        SdInstanceMulticastRxPdu: SdRxPduId=0, SdRxPduRef=SdCtrlMulticastRxPdu
        SdInstanceTxPdu: SdTxPduRef=SdCtrlTxPdu
        SdInstanceUnicastRxPdu: SdRxPduId=1, SdRxPduRef=SdCtrlRxPdu
        SdClientService_0xC3CB_VechicleSpeed (SdClientService):
          SdClientServiceAutoRequire = true
          SdClientServiceHandleId = 1
          SdClientServiceId = 50123
          SdClientServiceInstanceId = 23
          SdClientServiceMajorVersion = 1
          SdClientServiceMinorVersion = 0
          SdClientServiceTimerRef = SdClientServiceTimer
          SdClientServiceUdpRef = SCG_SD_UDP_fixe_10_23_0_33_40000
          SdConsumedEventGroup_0xC3CB_VechicleSpeed (SdConsumedEventGroup):
            SdConsumedEventGroupAutoRequire = true
            SdConsumedEventGroupHandleId = 0
            SdConsumedEventGroupId = 1
            SdConsumedEventGroupTimerRef = SdClientEventGroupTimer
            SdConsumedEventGroupMulticastGroupRef = SCG_SD_UDP_Multicast_Rx_Any_40000
            SdConsumedEventGroupMulticastActivationRef = SoAdRoutingGroup_VechicleSpeed_AM
            SdConsumedEventGroupUdpActivationRef = SoAdRoutingGroup_VechicleSpeed_AC
        SdClientServiceTimer (SdClientTimer):
          SdClientTimerTTL = 16777215
          SdClientTimerInitialFindDelayMax = 0.01
          SdClientTimerInitialFindDelayMin = 0.01
          SdClientTimerInitialFindRepetitionsBaseDelay = 0.055
          SdClientTimerInitialFindRepetitionsMax = 9
        SdClientEventGroupTimer (SdClientTimer): SdClientTimerTTL=16777215, SdClientTimerRequestResponseMinDelay=0, SdClientTimerRequestResponseMaxDelay=0.02
        SdClientService_0xC3CC_VechicleStatus (SdClientService):
          SdClientServiceAutoRequire = true
          SdClientServiceHandleId = 2
          SdClientServiceId = 50124
          SdClientServiceInstanceId = 23
          SdClientServiceMajorVersion = 1
          SdClientServiceMinorVersion = 0
          SdClientServiceTimerRef = SdClientServiceTimer
          SdClientServiceUdpRef = SCG_SD_UDP_fixe_10_23_0_33_40000
          SdConsumedEventGroup_0xC3CC_VechicleStatus (SdConsumedEventGroup):
            SdConsumedEventGroupAutoRequire = true
            SdConsumedEventGroupHandleId = 1
            SdConsumedEventGroupId = 1
            SdConsumedEventGroupTimerRef = SdClientEventGroupTimer
            SdConsumedEventGroupMulticastGroupRef = SCG_SD_UDP_Multicast_Rx_Any_40000
            SdConsumedEventGroupMulticastActivationRef = SoAdRoutingGroup_VechicleStatus_AM
            SdConsumedEventGroupUdpActivationRef = SoAdRoutingGroup_VechicleStatus_AC
        SdClientService_0xC3CD_VechicleInfo (SdClientService):
          SdClientServiceAutoRequire = true
          SdClientServiceHandleId = 0
          SdClientServiceId = 50125
          SdClientServiceInstanceId = 23
          SdClientServiceMajorVersion = 1
          SdClientServiceMinorVersion = 0
          SdClientServiceTimerRef = SdClientServiceTimer
          SdClientServiceTcpRef = SCG_SD_TCP_RX_fixed_10_23_0_23_47842
          SdConsumedEventGroup_0xC3CD_VechicleInfo (SdConsumedEventGroup):
            SdConsumedEventGroupAutoRequire = true
            SdConsumedEventGroupHandleId = 2
            SdConsumedEventGroupId = 1
            SdConsumedEventGroupTimerRef = SdClientEventGroupTimer
            SdConsumedEventGroupTcpActivationRef = SoAdRoutingGroup_VechicleInfo_AC
        SdServerServiceTimer (SdServerTimer):
          SdServerTimerRequestResponseMaxDelay = 0
          SdServerTimerRequestResponseMinDelay = 0
          SdServerTimerTTL = 16777215
          SdServerTimerInitialOfferDelayMax = 0.01
          SdServerTimerInitialOfferDelayMin = 0.01
          SdServerTimerInitialOfferRepetitionBaseDelay = 0.22
          SdServerTimerInitialOfferRepetitionsMax = 2
          SdServerTimerOfferCyclicDelay = 0.5
        SdServerEventHandlerTimer (SdServerTimer): SdServerTimerRequestResponseMaxDelay=0.1, SdServerTimerRequestResponseMinDelay=0.01, SdServerTimerTTL=5
        3 x SdServerService, all with SdServerServiceAutoAvailable=true, SdServerServiceInstanceId=23, SdServerServiceMajorVersion=1, SdServerServiceMinorVersion=0, SdServerServiceTimerRef=SdServerServiceTimer:
          SdServerService_0xC3C0_FaultInfo: SdServerServiceHandleId=1, SdServerServiceId=50112, SdServerServiceUdpRef=SCG_SD_UDP_fixe_10_23_0_33_40000
            SdEventHandler_0xC3C0_FaultInfo (SdEventHandler):
              SdEventHandlerEventGroupId = 1
              SdEventHandlerHandleId = 0
              SdEventHandlerMulticastThreshold = 2
              SdEventHandlerMaxRemoteClients = 0
              SdEventHandlerTimerRef = SdServerEventHandlerTimer
              SdEventHandlerUdp: SdEventActivationRef=SoAdRoutingGroup_FaultInfo_AC
              SdEventHandlerMulticast: SdMulticastEventSoConRef=SC_UDP_Multicast_Fixed_239_23_0_1_40000_remote, SdEventActivationRef=SoAdRoutingGroup_FaultInfo_AM
          SdServerService_0xC3C1_SenState: SdServerServiceHandleId=2, SdServerServiceId=50113, SdServerServiceUdpRef=SCG_SD_UDP_fixe_10_23_0_33_40000
            SdEventHandler_0xC3C1_SenState (SdEventHandler):
              SdEventHandlerEventGroupId = 1
              SdEventHandlerHandleId = 1
              SdEventHandlerMulticastThreshold = 2
              SdEventHandlerMaxRemoteClients = 0
              SdEventHandlerTimerRef = SdServerEventHandlerTimer
              SdEventHandlerUdp: SdEventActivationRef=SoAdRoutingGroup_SenState_AC
              SdEventHandlerMulticast: SdMulticastEventSoConRef=SC_UDP_Multicast_Fixed_239_23_0_1_40000_remote, SdEventActivationRef=SoAdRoutingGroup_SenState_AM
          SdServerService_0xC3C2_EcuState: SdServerServiceHandleId=0, SdServerServiceId=50114, SdServerServiceTcpRef=SCG_SD_TCP_TX_fixed_10_23_0_23_47843
            SdEventHandler_0xC3C2_EcuState (SdEventHandler):
              SdEventHandlerEventGroupId = 1
              SdEventHandlerHandleId = 2
              SdEventHandlerMulticastThreshold = 0
              SdEventHandlerMaxRemoteClients = 0
              SdEventHandlerTimerRef = SdServerEventHandlerTimer
              SdEventHandlerTcp: SdEventActivationRef=SoAdRoutingGroup_EcuState_AC
    SdGeneral:
      SdDevErrorDetect = true
      SdMainFunctionCycleTime = 0.005
      SdVersionInfoApi = false
      SdMaxNrOptionsPerMsg = 10
      SdRandomNumberFunctionIncludeFile = Appl_Rand.h
      SdRandomNumberFunction = Appl_Crypto_GetRandNo
      SdSafeBswChecks = false
      SdSetRemAddrOfClientRxMulticastSoCon = false
      SdSubscribeEventgroupRetryEnable = true
      SdGeneration:
        SdOutOfBoundsWriteProtectionStrategy = NONE
        SdOutOfBoundsWriteSanitizer = false
        SdOutOfBoundsReadSanitizer = false
        SdReduceConstantData2Define = false
        SdBoolDataInArrayOfStructStrategy = BOOLEAN
        SdDeduplicateIndirectedData = false
        SdDataDeduplicationStrategy = NONE
        SdReduceBoolDataByNegationThreshold = 0
        SdReduceBoolDataByNumericalComparisonThreshold = 0
        SdReduceBoolDataByNumericalRelationThreshold = 0
        SdReduceBoolDataByNumericalOperandStrategy = NONE
        SdReduceNumericalDataByOffsetThreshold = 0
        SdReduceNumericalDataByArraySubtractionThreshold = 0
        SdReduceDataByStreaming = false
        SdShortSymbols = false
        SdInterfacesForDeactivatedData = false
        SdReferringKeysInComments = false
