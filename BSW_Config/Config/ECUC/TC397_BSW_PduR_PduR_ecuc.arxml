AUTOSAR XML (schema 00048)
package /ActiveEcuC
  module config PduR: implementation-config-variant=VARIANT-PRE-COMPILE, module-description=PduR_Impl
    Com (PduRBswModules):
      PduRCancelReceive = false
      PduRCancelTransmit = false
      PduRChangeParameterRequestApi = false
      PduRCommunicationInterface = true
      PduRLowerModule = false
      PduRTransportProtocol = false
      PduRTriggertransmit = true
      PduRTxConfirmation = false
      PduRUpperModule = true
      PduRUseTag = false
      PduRBswModuleRef = Com
    PduRGeneral:
      PduRDevErrorDetect = true
      PduRVersionInfoApi = false
      PduRMetaDataSupport = false
      PduRPduCallback = false
      PduRSwitching = false
      PduRSafeBswChecks = false
      PduREnableDeferredTransmission = false
      PduREnableDeferredReception = false
      PduRSupportMulticore = false
      PduRRoutingTypeGateway = false
      PduRSpinlockRetryCounter = 4294967295
      PduRExtendedErrorChecks = false
      PduRGeneration:
        PduROutOfBoundsWriteProtectionStrategy = NONE
        PduROutOfBoundsWriteSanitizer = false
        PduROutOfBoundsReadSanitizer = false
        PduRNumericalDataTypeMinimizationStrategy = WITH_CAST
        PduRReduceConstantData2Define = false
        PduRBoolDataInArrayOfStructStrategy = BITMASKING
        PduRDeduplicateIndirectedData = true
        PduRDataDeduplicationStrategy = WITH_CAST
        PduRReduceBoolDataByNegationThreshold = 2
        PduRReduceBoolDataByNumericalComparisonThreshold = 2
        PduRReduceBoolDataByNumericalRelationThreshold = 2
        PduRReduceBoolDataByNumericalOperandStrategy = WITH_ANY_VALUE
        PduRReduceNumericalDataByOffsetThreshold = 2
        PduRReduceNumericalDataByArraySubtractionThreshold = 2
        PduRReduceDataByStreaming = false
        PduRShortSymbols = false
        PduRInterfacesForDeactivatedData = false
        PduRReferringKeysInComments = false
    PduRRoutingTables: PduRConfigurationId=0
      PduRRoutingTable
        PduRRoutingPath_Eira_ETH_Rx (PduRRoutingPath): PduRRoutingPathCommunicationType=COMMUNICATION_INTERFACE, PduRMulticoreRoutingPath=false, PduRLockRef=PduRLock_PduRExclusiveArea
          PduRDestPdu:
            PduRDestPduHandleId = 0
            PduRDestPduDirection = RECEIVE
            PduRDestPduRoutingType = API_FORWARDING
            PduRDestPduDataProcessing = IMMEDIATE
            PduRPduLengthHandlingStrategy = IGNORE
            PduRTransmissionConfirmation = false
            PduRDestPduRef = PncEiraEthRxPdu
            PduRDestPduPduRBswModulesRef = Com
          PduRSrcPdu: PduRSourcePduHandleId=0, PduRSrcPduDirection=RECEIVE, PduRSrcPduRef=PncEiraEthRxPdu, PduRSrcPduPduRBswModulesRef=UdpNm
        PduRRoutingPath_Eira_ETH_Tx (PduRRoutingPath): PduRRoutingPathCommunicationType=COMMUNICATION_INTERFACE, PduRMulticoreRoutingPath=false, PduRLockRef=PduRLock_PduRExclusiveArea
          PduRDestPdu:
            PduRDestPduHandleId = 0
            PduRDestPduDirection = TRANSMIT
            PduRDestPduRoutingType = API_FORWARDING
            PduRDestPduDataProcessing = IMMEDIATE
            PduRPduLengthHandlingStrategy = IGNORE
            PduRTransmissionConfirmation = false
            PduRDestPduDataProvision = PDUR_TRIGGERTRANSMIT
            PduRDestPduRef = PncEiraEthTxPdu
            PduRDestPduPduRBswModulesRef = UdpNm
          PduRSrcPdu: PduRSourcePduHandleId=0, PduRSrcPduDirection=TRANSMIT, PduRSrcPduRef=PncEiraEthTxPdu, PduRSrcPduPduRBswModulesRef=Com
      PduRLock_PduRExclusiveArea (PduRLock)
        PduRExclusiveArea: PduRExclusiveAreaId=0
      PduRRoutingPathGroup_Rx (PduRRoutingPathGroup): PduRIsEnabledAtInit=false, PduRRoutingPathGroupId=1, PduRDestPduRef=PduRRoutingPath_Eira_ETH_Rx/PduRDestPdu
      PduRRoutingPathGroup_Tx (PduRRoutingPathGroup): PduRIsEnabledAtInit=false, PduRRoutingPathGroupId=0, PduRDestPduRef=PduRRoutingPath_Eira_ETH_Tx/PduRDestPdu
    UdpNm (PduRBswModules):
      PduRCancelReceive = false
      PduRCancelTransmit = false
      PduRChangeParameterRequestApi = false
      PduRCommunicationInterface = true
      PduRLowerModule = true
      PduRTransportProtocol = false
      PduRTriggertransmit = true
      PduRTxConfirmation = false
      PduRUpperModule = false
      PduRUseTag = false
      PduRBswModuleRef = UdpNm
