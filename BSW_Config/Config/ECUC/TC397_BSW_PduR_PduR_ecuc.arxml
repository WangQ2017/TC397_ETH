AUTOSAR XML (schema 00048)
package /ActiveEcuC
  module config PduR: implementation-config-variant=VARIANT-PRE-COMPILE, module-description=PduR_Impl
    Com (PduRBswModules):
      PduRCancelReceive = false
      PduRCancelTransmit = false
      PduRChangeParameterRequestApi = false
      PduRCommunicationInterface = true
      PduRLowerModule = false
      PduRTransportProtocol = false
      PduRTriggertransmit = true
      PduRTxConfirmation = true
      PduRUpperModule = true
      PduRUseTag = false
      PduRBswModuleRef = Com
    PduRGeneral:
      PduRDevErrorDetect = true
      PduRVersionInfoApi = false
      PduRMetaDataSupport = false
      PduRPduCallback = false
      PduRSwitching = false
      PduRSafeBswChecks = false
      PduREnableDeferredTransmission = false
      PduREnableDeferredReception = false
      PduRSupportMulticore = false
      PduRRoutingTypeGateway = false
      PduRSpinlockRetryCounter = 4294967295
      PduRExtendedErrorChecks = false
      PduRGeneration:
        PduROutOfBoundsWriteProtectionStrategy = NONE
        PduROutOfBoundsWriteSanitizer = false
        PduROutOfBoundsReadSanitizer = false
        PduRNumericalDataTypeMinimizationStrategy = WITH_CAST
        PduRReduceConstantData2Define = false
        PduRBoolDataInArrayOfStructStrategy = BITMASKING
        PduRDeduplicateIndirectedData = true
        PduRDataDeduplicationStrategy = WITH_CAST
        PduRReduceBoolDataByNegationThreshold = 2
        PduRReduceBoolDataByNumericalComparisonThreshold = 2
        PduRReduceBoolDataByNumericalRelationThreshold = 2
        PduRReduceBoolDataByNumericalOperandStrategy = WITH_ANY_VALUE
        PduRReduceNumericalDataByOffsetThreshold = 2
        PduRReduceNumericalDataByArraySubtractionThreshold = 2
        PduRReduceDataByStreaming = false
        PduRShortSymbols = false
        PduRInterfacesForDeactivatedData = false
        PduRReferringKeysInComments = false
    PduRRoutingTables: PduRConfigurationId=0
      PduRRoutingTable
        8 x PduRRoutingPath, all with PduRRoutingPathCommunicationType=COMMUNICATION_INTERFACE, PduRMulticoreRoutingPath=false, PduRLockRef=PduRLock_PduRExclusiveArea:
          PduRRoutingPath_Eira_ETH_Rx
            PduRDestPdu_Eira_ETH_Rx (PduRDestPdu):
              PduRDestPduHandleId = 0
              PduRDestPduDirection = RECEIVE
              PduRDestPduRoutingType = API_FORWARDING
              PduRDestPduDataProcessing = IMMEDIATE
              PduRPduLengthHandlingStrategy = IGNORE
              PduRTransmissionConfirmation = false
              PduRDestPduRef = PncEiraEthRxPdu
              PduRDestPduPduRBswModulesRef = Com
            PduRSrcPdu_Eira_ETH_Rx (PduRSrcPdu): PduRSourcePduHandleId=0, PduRSrcPduDirection=RECEIVE, PduRSrcPduRef=PncEiraEthRxPdu, PduRSrcPduPduRBswModulesRef=UdpNm
          PduRRoutingPath_Eira_ETH_Tx
            PduRDestPdu_Eira_ETH_Tx (PduRDestPdu):
              PduRDestPduHandleId = 0
              PduRDestPduDirection = TRANSMIT
              PduRDestPduRoutingType = API_FORWARDING
              PduRDestPduDataProcessing = IMMEDIATE
              PduRPduLengthHandlingStrategy = IGNORE
              PduRTransmissionConfirmation = false
              PduRDestPduDataProvision = PDUR_TRIGGERTRANSMIT
              PduRDestPduRef = PncEiraEthTxPdu
              PduRDestPduPduRBswModulesRef = UdpNm
            PduRSrcPdu_Eira_ETH_Tx (PduRSrcPdu): PduRSourcePduHandleId=1, PduRSrcPduDirection=TRANSMIT, PduRSrcPduRef=PncEiraEthTxPdu, PduRSrcPduPduRBswModulesRef=Com
          PduRRoutingPath_VechicleSpeedRx
            PduRDestPdu_VechicleSpeedRx (PduRDestPdu):
              PduRDestPduHandleId = 2
              PduRDestPduDirection = RECEIVE
              PduRDestPduRoutingType = API_FORWARDING
              PduRDestPduDataProcessing = IMMEDIATE
              PduRPduLengthHandlingStrategy = IGNORE
              PduRTransmissionConfirmation = false
              PduRDestPduRef = SomeIpVechicleSpeedRxPdu_Ldcom
              PduRDestPduPduRBswModulesRef = LdCom
            PduRSrcPdu_VechicleSpeedRx (PduRSrcPdu): PduRSourcePduHandleId=2, PduRSrcPduDirection=RECEIVE, PduRSrcPduRef=SomeIpVechicleSpeedRxPdu_SoAd, PduRSrcPduPduRBswModulesRef=SoAd
          PduRRoutingPath_VechicleInfoRx
            PduRDestPdu_VechicleInfoRx (PduRDestPdu):
              PduRDestPduHandleId = 1
              PduRDestPduDirection = RECEIVE
              PduRDestPduRoutingType = API_FORWARDING
              PduRDestPduDataProcessing = IMMEDIATE
              PduRPduLengthHandlingStrategy = IGNORE
              PduRTransmissionConfirmation = false
              PduRDestPduRef = SomeIpVechicleInfoRxPdu_Com
              PduRDestPduPduRBswModulesRef = Com
            PduRSrcPdu_VechicleInfoRx (PduRSrcPdu): PduRSourcePduHandleId=1, PduRSrcPduDirection=RECEIVE, PduRSrcPduRef=SomeIpVechicleInfoRxPdu_SoAd, PduRSrcPduPduRBswModulesRef=SoAd
          PduRRoutingPath_FalutInfoTx
            PduRDestPdu_FalutInfoTx (PduRDestPdu):
              PduRDestPduHandleId = 2
              PduRDestPduDirection = TRANSMIT
              PduRDestPduRoutingType = API_FORWARDING
              PduRDestPduDataProcessing = IMMEDIATE
              PduRPduLengthHandlingStrategy = IGNORE
              PduRDestPduDataProvision = PDUR_DIRECT
              PduRTransmissionConfirmation = true
              PduRDestPduRef = SomeIpFalutInfoTxPdu_SoAd
              PduRDestPduPduRBswModulesRef = SoAd
            PduRSrcPdu_FalutInfoTx (PduRSrcPdu): PduRSourcePduHandleId=2, PduRSrcPduDirection=TRANSMIT, PduRSrcPduRef=SomeIpFalutInfoTxPdu_Com, PduRSrcPduPduRBswModulesRef=Com
          PduRRoutingPath_SenStateTx
            PduRDestPdu_SenStateTx (PduRDestPdu):
              PduRDestPduHandleId = 3
              PduRDestPduDirection = TRANSMIT
              PduRDestPduRoutingType = API_FORWARDING
              PduRDestPduDataProcessing = IMMEDIATE
              PduRPduLengthHandlingStrategy = IGNORE
              PduRDestPduDataProvision = PDUR_DIRECT
              PduRTransmissionConfirmation = true
              PduRDestPduRef = SomeIpSenStateTxPdu_SoAd
              PduRDestPduPduRBswModulesRef = SoAd
            PduRSrcPdu_SenStateTx (PduRSrcPdu): PduRSourcePduHandleId=3, PduRSrcPduDirection=TRANSMIT, PduRSrcPduRef=SomeIpSenStateTxPdu_Ldcom, PduRSrcPduPduRBswModulesRef=LdCom
          PduRRoutingPath_EcuStateTx
            PduRDestPdu_EcuStateTx (PduRDestPdu):
              PduRDestPduHandleId = 1
              PduRDestPduDirection = TRANSMIT
              PduRDestPduRoutingType = API_FORWARDING
              PduRDestPduDataProcessing = IMMEDIATE
              PduRPduLengthHandlingStrategy = IGNORE
              PduRDestPduDataProvision = PDUR_DIRECT
              PduRTransmissionConfirmation = false
              PduRDestPduRef = SomeIpEcuStateTxPdu_SoAd
              PduRDestPduPduRBswModulesRef = SoAd
            PduRSrcPdu_EcuStateTx (PduRSrcPdu): PduRSourcePduHandleId=0, PduRSrcPduDirection=TRANSMIT, PduRSrcPduRef=SomeIpEcuStateTxPdu_Ldcom, PduRSrcPduPduRBswModulesRef=LdCom
          PduRRoutingPath_VechicleStatusRx
            PduRDestPdu_VechicleStatusRx (PduRDestPdu):
              PduRDestPduHandleId = 3
              PduRDestPduDirection = RECEIVE
              PduRDestPduRoutingType = API_FORWARDING
              PduRDestPduDataProcessing = IMMEDIATE
              PduRPduLengthHandlingStrategy = IGNORE
              PduRTransmissionConfirmation = false
              PduRDestPduRef = SomeIpVechicleStatusRxPdu_Ldcom
              PduRDestPduPduRBswModulesRef = LdCom
            PduRSrcPdu_VechicleStatusRx (PduRSrcPdu): PduRSourcePduHandleId=3, PduRSrcPduDirection=RECEIVE, PduRSrcPduRef=SomeIpVechicleStatusRxPdu_SoAd, PduRSrcPduPduRBswModulesRef=SoAd
      PduRLock_PduRExclusiveArea (PduRLock)
        PduRExclusiveArea: PduRExclusiveAreaId=0
      PduRRoutingPathGroup_Rx (PduRRoutingPathGroup): PduRIsEnabledAtInit=false, PduRRoutingPathGroupId=1, PduRDestPduRef=PduRDestPdu_Eira_ETH_Rx
      PduRRoutingPathGroup_Tx (PduRRoutingPathGroup): PduRIsEnabledAtInit=false, PduRRoutingPathGroupId=0, PduRDestPduRef=PduRDestPdu_Eira_ETH_Tx
    3 x PduRBswModules, all with PduRCancelReceive=false, PduRCancelTransmit=false, PduRChangeParameterRequestApi=false, PduRCommunicationInterface=true, PduRTransportProtocol=false, PduRUseTag=false:
      UdpNm: PduRLowerModule=true, PduRTriggertransmit=true, PduRTxConfirmation=false, PduRUpperModule=false, PduRBswModuleRef=UdpNm
      SoAd: PduRLowerModule=true, PduRTriggertransmit=false, PduRTxConfirmation=true, PduRUpperModule=false, PduRBswModuleRef=SoAd
      LdCom: PduRLowerModule=false, PduRTriggertransmit=false, PduRTxConfirmation=true, PduRUpperModule=true, PduRBswModuleRef=LdCom
