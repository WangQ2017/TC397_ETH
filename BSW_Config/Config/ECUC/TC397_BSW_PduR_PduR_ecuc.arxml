AUTOSAR XML (schema 00048)
package /ActiveEcuC
  module config PduR: implementation-config-variant=VARIANT-PRE-COMPILE, module-description=PduR_Impl
    LdCom (PduRBswModules):
      PduRCancelReceive = false
      PduRCancelTransmit = false
      PduRChangeParameterRequestApi = false
      PduRCommunicationInterface = true
      PduRLowerModule = false
      PduRTransportProtocol = false
      PduRTriggertransmit = false
      PduRTxConfirmation = true
      PduRUpperModule = true
      PduRUseTag = false
      PduRBswModuleRef = LdCom
    PduRGeneral:
      PduRDevErrorDetect = true
      PduRVersionInfoApi = false
      PduRMetaDataSupport = false
      PduRPduCallback = false
      PduRSwitching = false
      PduRSafeBswChecks = false
      PduREnableDeferredTransmission = false
      PduREnableDeferredReception = false
      PduRSupportMulticore = false
      PduRRoutingTypeGateway = false
      PduRSpinlockRetryCounter = 4294967295
      PduRExtendedErrorChecks = false
      PduRGeneration:
        PduROutOfBoundsWriteProtectionStrategy = NONE
        PduROutOfBoundsWriteSanitizer = false
        PduROutOfBoundsReadSanitizer = false
        PduRNumericalDataTypeMinimizationStrategy = WITH_CAST
        PduRReduceConstantData2Define = false
        PduRBoolDataInArrayOfStructStrategy = BITMASKING
        PduRDeduplicateIndirectedData = true
        PduRDataDeduplicationStrategy = WITH_CAST
        PduRReduceBoolDataByNegationThreshold = 2
        PduRReduceBoolDataByNumericalComparisonThreshold = 2
        PduRReduceBoolDataByNumericalRelationThreshold = 2
        PduRReduceBoolDataByNumericalOperandStrategy = WITH_ANY_VALUE
        PduRReduceNumericalDataByOffsetThreshold = 2
        PduRReduceNumericalDataByArraySubtractionThreshold = 2
        PduRReduceDataByStreaming = false
        PduRShortSymbols = false
        PduRInterfacesForDeactivatedData = false
        PduRReferringKeysInComments = false
    PduRRoutingTables: PduRConfigurationId=0
      PduRRoutingTable
        PduRRoutingPath_udplog_Tx (PduRRoutingPath): PduRRoutingPathCommunicationType=COMMUNICATION_INTERFACE, PduRMulticoreRoutingPath=false, PduRLockRef=PduRLock_PduRExclusiveArea
          PduRDestPdu_udplog_Tx_SoAd (PduRDestPdu):
            PduRDestPduHandleId = 1
            PduRDestPduDirection = TRANSMIT
            PduRDestPduRoutingType = API_FORWARDING
            PduRDestPduDataProcessing = IMMEDIATE
            PduRPduLengthHandlingStrategy = IGNORE
            PduRDestPduDataProvision = PDUR_DIRECT
            PduRTransmissionConfirmation = true
            PduRDestPduRef = udplog_TxPdu_SoAd
            PduRDestPduPduRBswModulesRef = SoAd
          PduRSrcPdu_udplog_Tx_LdCom (PduRSrcPdu): PduRSourcePduHandleId=1, PduRSrcPduDirection=TRANSMIT, PduRSrcPduRef=udplog_TxPdu_LdCom, PduRSrcPduPduRBswModulesRef=LdCom
        PduRRoutingPath_TimeSyncStatus_Tx (PduRRoutingPath): PduRRoutingPathCommunicationType=COMMUNICATION_INTERFACE, PduRMulticoreRoutingPath=false, PduRLockRef=PduRLock_PduRExclusiveArea
          PduRDestPdu_TxPdu_SoAd (PduRDestPdu):
            PduRDestPduHandleId = 0
            PduRDestPduDirection = TRANSMIT
            PduRDestPduRoutingType = API_FORWARDING
            PduRDestPduDataProcessing = IMMEDIATE
            PduRPduLengthHandlingStrategy = IGNORE
            PduRDestPduDataProvision = PDUR_DIRECT
            PduRTransmissionConfirmation = false
            PduRDestPduRef = TimeSyncStatus_TxPdu_SoAd
            PduRDestPduPduRBswModulesRef = SoAd
          PduRSrcPdu: PduRSourcePduHandleId=0, PduRSrcPduDirection=TRANSMIT, PduRSrcPduRef=TimeSyncStatus_TxPdu_Com, PduRSrcPduPduRBswModulesRef=Com
      PduRLock_PduRExclusiveArea (PduRLock)
        PduRExclusiveArea: PduRExclusiveAreaId=0
    SoAd (PduRBswModules):
      PduRCancelReceive = false
      PduRCancelTransmit = false
      PduRChangeParameterRequestApi = false
      PduRCommunicationInterface = true
      PduRLowerModule = true
      PduRTransportProtocol = false
      PduRTriggertransmit = false
      PduRTxConfirmation = true
      PduRUpperModule = false
      PduRUseTag = false
      PduRBswModuleRef = SoAd
    Com (PduRBswModules):
      PduRCancelReceive = false
      PduRCancelTransmit = false
      PduRChangeParameterRequestApi = false
      PduRCommunicationInterface = true
      PduRLowerModule = false
      PduRTransportProtocol = false
      PduRTriggertransmit = false
      PduRTxConfirmation = false
      PduRUpperModule = true
      PduRUseTag = false
      PduRBswModuleRef = Com
