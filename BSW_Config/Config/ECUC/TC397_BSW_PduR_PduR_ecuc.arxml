AUTOSAR XML (schema 00048)
package /ActiveEcuC
  module config PduR: implementation-config-variant=VARIANT-PRE-COMPILE, module-description=PduR_Impl
    LdCom (PduRBswModules):
      PduRCancelReceive = false
      PduRCancelTransmit = false
      PduRChangeParameterRequestApi = false
      PduRCommunicationInterface = true
      PduRLowerModule = false
      PduRTransportProtocol = false
      PduRTriggertransmit = false
      PduRTxConfirmation = true
      PduRUpperModule = true
      PduRUseTag = false
      PduRBswModuleRef = LdCom
    PduRGeneral:
      PduRDevErrorDetect = true
      PduRVersionInfoApi = false
      PduRMetaDataSupport = false
      PduRPduCallback = false
      PduRSwitching = false
      PduRSafeBswChecks = false
      PduREnableDeferredTransmission = false
      PduREnableDeferredReception = false
      PduRSupportMulticore = false
      PduRRoutingTypeGateway = false
      PduRSpinlockRetryCounter = 4294967295
      PduRExtendedErrorChecks = false
      PduRGeneration:
        PduROutOfBoundsWriteProtectionStrategy = NONE
        PduROutOfBoundsWriteSanitizer = false
        PduROutOfBoundsReadSanitizer = false
        PduRNumericalDataTypeMinimizationStrategy = WITH_CAST
        PduRReduceConstantData2Define = false
        PduRBoolDataInArrayOfStructStrategy = BITMASKING
        PduRDeduplicateIndirectedData = true
        PduRDataDeduplicationStrategy = WITH_CAST
        PduRReduceBoolDataByNegationThreshold = 2
        PduRReduceBoolDataByNumericalComparisonThreshold = 2
        PduRReduceBoolDataByNumericalRelationThreshold = 2
        PduRReduceBoolDataByNumericalOperandStrategy = WITH_ANY_VALUE
        PduRReduceNumericalDataByOffsetThreshold = 2
        PduRReduceNumericalDataByArraySubtractionThreshold = 2
        PduRReduceDataByStreaming = false
        PduRShortSymbols = false
        PduRInterfacesForDeactivatedData = false
        PduRReferringKeysInComments = false
    PduRRoutingTables: PduRConfigurationId=0
      PduRRoutingTable
        11 x PduRRoutingPath, all with PduRMulticoreRoutingPath=false, PduRLockRef=PduRLock_PduRExclusiveArea:
          PduRRoutingPath_udplog_Tx: PduRRoutingPathCommunicationType=COMMUNICATION_INTERFACE
            PduRDestPdu_udplog_Tx_SoAd (PduRDestPdu):
              PduRDestPduHandleId = 4
              PduRDestPduDirection = TRANSMIT
              PduRDestPduRoutingType = API_FORWARDING
              PduRDestPduDataProcessing = IMMEDIATE
              PduRPduLengthHandlingStrategy = IGNORE
              PduRDestPduDataProvision = PDUR_DIRECT
              PduRTransmissionConfirmation = true
              PduRDestPduRef = udplog_TxPdu_SoAd
              PduRDestPduPduRBswModulesRef = SoAd
            PduRSrcPdu_udplog_Tx_LdCom (PduRSrcPdu): PduRSourcePduHandleId=5, PduRSrcPduDirection=TRANSMIT, PduRSrcPduRef=udplog_TxPdu_LdCom, PduRSrcPduPduRBswModulesRef=LdCom
          PduRRoutingPath_TimeSyncStatus_Tx: PduRRoutingPathCommunicationType=COMMUNICATION_INTERFACE
            PduRDestPdu_TxPdu_SoAd (PduRDestPdu):
              PduRDestPduHandleId = 3
              PduRDestPduDirection = TRANSMIT
              PduRDestPduRoutingType = API_FORWARDING
              PduRDestPduDataProcessing = IMMEDIATE
              PduRPduLengthHandlingStrategy = IGNORE
              PduRDestPduDataProvision = PDUR_DIRECT
              PduRTransmissionConfirmation = false
              PduRDestPduRef = TimeSyncStatus_TxPdu_SoAd
              PduRDestPduPduRBswModulesRef = SoAd
            PduRSrcPdu: PduRSourcePduHandleId=2, PduRSrcPduDirection=TRANSMIT, PduRSrcPduRef=TimeSyncStatus_TxPdu_Com, PduRSrcPduPduRBswModulesRef=Com
          PduRRoutingPath_DOIPPhyReqRx: PduRRoutingPathCommunicationType=TRANSPORT_PROTOCOL
            PduRDestPdu_DOIPPhyReqRx (PduRDestPdu):
              PduRDestPduHandleId = 1
              PduRDestPduDirection = RECEIVE
              PduRDestPduRoutingType = API_FORWARDING
              PduRDestPduDataProcessing = IMMEDIATE
              PduRPduLengthHandlingStrategy = UNUSED
              PduRDestPduRef = DoIPPhyReqRxPdu_PduR2Dcm
              PduRDestPduPduRBswModulesRef = Dcm
            PduRSrcPdu__DOIPPhyReqRx (PduRSrcPdu): PduRSourcePduHandleId=1, PduRSrcPduDirection=RECEIVE, PduRSrcPduRef=DoIPPhyReqRxPdu_DoIP2PduR, PduRSrcPduPduRBswModulesRef=DoIP
          PduRRoutingPath_DOIPFuncReqRx: PduRRoutingPathCommunicationType=TRANSPORT_PROTOCOL
            PduRDestPdu_DOIPFuncReqRx (PduRDestPdu):
              PduRDestPduHandleId = 0
              PduRDestPduDirection = RECEIVE
              PduRDestPduRoutingType = API_FORWARDING
              PduRDestPduDataProcessing = IMMEDIATE
              PduRPduLengthHandlingStrategy = UNUSED
              PduRDestPduRef = DoIPFuncReqRxPdu_PduR2Dcm
              PduRDestPduPduRBswModulesRef = Dcm
            PduRSrcPdu_DOIPFuncReqRx (PduRSrcPdu): PduRSourcePduHandleId=0, PduRSrcPduDirection=RECEIVE, PduRSrcPduRef=DoIPFuncReqRxPdu_DoIP2PduR, PduRSrcPduPduRBswModulesRef=DoIP
          PduRRoutingPath_DOIPPhyResTx: PduRRoutingPathCommunicationType=TRANSPORT_PROTOCOL
            PduRDestPdu_DOIPPhyResTx (PduRDestPdu):
              PduRDestPduHandleId = 0
              PduRDestPduDirection = TRANSMIT
              PduRDestPduRoutingType = API_FORWARDING
              PduRDestPduDataProcessing = IMMEDIATE
              PduRPduLengthHandlingStrategy = UNUSED
              PduRDestPduRef = DoIPPhyResTxPdu_PduR2DoIP
              PduRDestPduPduRBswModulesRef = DoIP
            PduRSrcPdu_DOIPPhyResTx (PduRSrcPdu): PduRSourcePduHandleId=0, PduRSrcPduDirection=TRANSMIT, PduRSrcPduRef=DoIPPhyResTxPdu_Dcm2PduR, PduRSrcPduPduRBswModulesRef=Dcm
          PduRRoutingPath_VechicleSpeedRx: PduRRoutingPathCommunicationType=COMMUNICATION_INTERFACE
            PduRDestPdu:
              PduRDestPduHandleId = 1
              PduRDestPduDirection = RECEIVE
              PduRDestPduRoutingType = API_FORWARDING
              PduRDestPduDataProcessing = IMMEDIATE
              PduRPduLengthHandlingStrategy = IGNORE
              PduRTransmissionConfirmation = false
              PduRDestPduRef = SomeIpVechicleSpeedRxPdu_Ldcom
              PduRDestPduPduRBswModulesRef = LdCom
            PduRSrcPdu_1 (PduRSrcPdu): PduRSourcePduHandleId=1, PduRSrcPduDirection=RECEIVE, PduRSrcPduRef=SomeIpVechicleSpeedRxPdu_SoAd, PduRSrcPduPduRBswModulesRef=SoAd
          PduRRoutingPath_VechicleStatusRx: PduRRoutingPathCommunicationType=COMMUNICATION_INTERFACE
            PduRDestPdu_1 (PduRDestPdu):
              PduRDestPduHandleId = 2
              PduRDestPduDirection = RECEIVE
              PduRDestPduRoutingType = API_FORWARDING
              PduRDestPduDataProcessing = IMMEDIATE
              PduRPduLengthHandlingStrategy = IGNORE
              PduRTransmissionConfirmation = false
              PduRDestPduRef = SomeIpVechicleStatusRxPdu_Ldcom
              PduRDestPduPduRBswModulesRef = LdCom
            PduRSrcPdu_2 (PduRSrcPdu): PduRSourcePduHandleId=2, PduRSrcPduDirection=RECEIVE, PduRSrcPduRef=SomeIpVechicleStatusRxPdu_SoAd, PduRSrcPduPduRBswModulesRef=SoAd
          PduRRoutingPath_VechicleInfoRx: PduRRoutingPathCommunicationType=COMMUNICATION_INTERFACE
            PduRDestPdu_2 (PduRDestPdu):
              PduRDestPduHandleId = 0
              PduRDestPduDirection = RECEIVE
              PduRDestPduRoutingType = API_FORWARDING
              PduRDestPduDataProcessing = IMMEDIATE
              PduRPduLengthHandlingStrategy = IGNORE
              PduRTransmissionConfirmation = false
              PduRDestPduRef = SomeIpVechicleInfoRxPdu_Com
              PduRDestPduPduRBswModulesRef = Com
            PduRSrcPdu_3 (PduRSrcPdu): PduRSourcePduHandleId=0, PduRSrcPduDirection=RECEIVE, PduRSrcPduRef=SomeIpVechicleInfoRxPdu_SoAd, PduRSrcPduPduRBswModulesRef=SoAd
          PduRRoutingPath_FaultInfoTx: PduRRoutingPathCommunicationType=COMMUNICATION_INTERFACE
            PduRDestPdu_3 (PduRDestPdu):
              PduRDestPduHandleId = 1
              PduRDestPduDirection = TRANSMIT
              PduRDestPduRoutingType = API_FORWARDING
              PduRDestPduDataProcessing = IMMEDIATE
              PduRPduLengthHandlingStrategy = IGNORE
              PduRTransmissionConfirmation = true
              PduRDestPduDataProvision = PDUR_DIRECT
              PduRDestPduRef = SomeIpFalutInfoTxPdu_SoAd
              PduRDestPduPduRBswModulesRef = SoAd
            PduRSrcPdu_4 (PduRSrcPdu): PduRSourcePduHandleId=1, PduRSrcPduDirection=TRANSMIT, PduRSrcPduRef=SomeIpFalutInfoTxPdu_Com, PduRSrcPduPduRBswModulesRef=Com
          PduRRoutingPath_senStateTx: PduRRoutingPathCommunicationType=COMMUNICATION_INTERFACE
            PduRDestPdu_4 (PduRDestPdu):
              PduRDestPduHandleId = 2
              PduRDestPduDirection = TRANSMIT
              PduRDestPduRoutingType = API_FORWARDING
              PduRDestPduDataProcessing = IMMEDIATE
              PduRPduLengthHandlingStrategy = IGNORE
              PduRTransmissionConfirmation = true
              PduRDestPduDataProvision = PDUR_DIRECT
              PduRDestPduRef = SomeIpSenStateTxPdu_SoAd
              PduRDestPduPduRBswModulesRef = SoAd
            PduRSrcPdu_5 (PduRSrcPdu): PduRSourcePduHandleId=3, PduRSrcPduDirection=TRANSMIT, PduRSrcPduRef=SomeIpSenStateTxPdu_Ldcom, PduRSrcPduPduRBswModulesRef=LdCom
          PduRRoutingPath_EcuStateTx: PduRRoutingPathCommunicationType=COMMUNICATION_INTERFACE
            PduRDestPdu_5 (PduRDestPdu):
              PduRDestPduHandleId = 0
              PduRDestPduDirection = TRANSMIT
              PduRDestPduRoutingType = API_FORWARDING
              PduRDestPduDataProcessing = IMMEDIATE
              PduRPduLengthHandlingStrategy = IGNORE
              PduRTransmissionConfirmation = true
              PduRDestPduDataProvision = PDUR_DIRECT
              PduRDestPduRef = SomeIpEcuStateTxPdu_SoAd
              PduRDestPduPduRBswModulesRef = SoAd
            PduRSrcPdu_6 (PduRSrcPdu): PduRSourcePduHandleId=4, PduRSrcPduDirection=TRANSMIT, PduRSrcPduRef=SomeIpEcuStateTxPdu_Ldcom, PduRSrcPduPduRBswModulesRef=LdCom
      PduRLock_PduRExclusiveArea (PduRLock)
        PduRExclusiveArea: PduRExclusiveAreaId=0
    4 x PduRBswModules, all with PduRCancelReceive=false, PduRCancelTransmit=false, PduRChangeParameterRequestApi=false, PduRTriggertransmit=false:
      SoAd: PduRCommunicationInterface=true, PduRLowerModule=true, PduRTransportProtocol=false, PduRTxConfirmation=true, PduRUpperModule=false, PduRUseTag=false, PduRBswModuleRef=SoAd
      Com: PduRCommunicationInterface=true, PduRLowerModule=false, PduRTransportProtocol=false, PduRTxConfirmation=true, PduRUpperModule=true, PduRUseTag=false, PduRBswModuleRef=Com
      Dcm: PduRCommunicationInterface=false, PduRLowerModule=false, PduRTransportProtocol=true, PduRTxConfirmation=false, PduRUpperModule=true, PduRUseTag=true, PduRBswModuleRef=Dcm
      DoIP: PduRCommunicationInterface=false, PduRLowerModule=true, PduRTransportProtocol=true, PduRTxConfirmation=false, PduRUpperModule=false, PduRUseTag=false, PduRBswModuleRef=DoIP
