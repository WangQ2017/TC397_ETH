AUTOSAR XML (schema 4-2-1)
package /MICROSAR/TcpIp_ib_bswmd/BswModuleDescriptions
  bsw module description TcpIp: provided-entrys=TcpIp_MainFunction
    bsw internal behavior TcpIpBehavior
      exclusive area TCPIP_EXCLUSIVE_AREA_0
      bsw schedulable entity TcpIp_MainFunction: implemented-entry=TcpIp_MainFunction
      bsw timing event TcpIp_MainFunctionTimingEvent0: starts-on-event=TcpIp_MainFunction, period=0.005
  bsw module entry TcpIp_MainFunction: call-type=SCHEDULED, execution-context=TASK
