AUTOSAR XML (schema 4-0-3)
package /MICROSAR
  bsw implementation Nm_Impl: programming-language=C, sw-version=13.00.00, used-code-generator=DaVinci Configurator, vendor-id=30, ar-release-version=4.00.03
