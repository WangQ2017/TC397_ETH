AUTOSAR XML (schema 4-2-1)
package /MICROSAR/EthTrcv_30_Tja1100_ib_bswmd/BswModuleDescriptions
  bsw module description EthTrcv: provided-entrys=EthTrcv_30_Tja1100_MainFunction
    bsw internal behavior EthTrcv_30_Tja1100Behavior
      exclusive area ETHTRCV_30_TJA1100_EXCLUSIVE_AREA_SEQUENCE
      bsw schedulable entity EthTrcv_30_Tja1100_MainFunction: implemented-entry=EthTrcv_30_Tja1100_MainFunction
      bsw timing event EthTrcv_30_Tja1100_MainFunctionTimingEvent0: starts-on-event=EthTrcv_30_Tja1100_MainFunction, period=0.001
  bsw module entry EthTrcv_30_Tja1100_MainFunction: call-type=SCHEDULED, execution-context=TASK
