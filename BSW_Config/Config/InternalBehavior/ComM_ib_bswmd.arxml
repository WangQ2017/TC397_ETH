AUTOSAR XML (schema 4-0-3)
package /MICROSAR
  bsw implementation ComM_Impl: programming-language=C, sw-version=13.00.01, used-code-generator=DaVinci Configurator, vendor-id=30, ar-release-version=4.00.03
package /MICROSAR/ComM_ib_bswmd/BswModuleDescriptions
  bsw module description ComM: provided-entrys=[ComM_MainFunction_0, ComM_MainFunction_1, ComM_MainFunction_2]
    bsw internal behavior ComMBehavior
      exclusive area COMM_EXCLUSIVE_AREA_0
      exclusive area COMM_EXCLUSIVE_AREA_1
      bsw schedulable entity ComM_MainFunction_{0..2}: implemented-entry=ComM_MainFunction_{0..2}
      bsw timing event ComM_MainFunction_{0..2}TimingEvent0: starts-on-event=ComM_MainFunction_{0..2}, period=0.005
  bsw module entry ComM_MainFunction_{0..2}: call-type=SCHEDULED, execution-context=TASK
