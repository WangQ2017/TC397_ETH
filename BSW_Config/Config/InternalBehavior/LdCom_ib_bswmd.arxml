AUTOSAR XML (schema 4-0-3)
package /MICROSAR
  bsw implementation LdCom_Impl: programming-language=C, sw-version=3.01.00, used-code-generator=DaVinci Configurator, vendor-id=30, ar-release-version=4.02.02
package /MICROSAR/LdCom_ib_bswmd/BswModuleDescriptions
  bsw module description LdCom
    bsw internal behavior LdComBehavior
