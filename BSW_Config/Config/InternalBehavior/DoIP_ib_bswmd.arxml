AUTOSAR XML (schema 4-2-1)
package /MICROSAR
  bsw implementation DoIP_Impl: programming-language=C, sw-version=9.00.03, used-code-generator=DaVinci Configurator, vendor-id=30, ar-release-version=4.02.02
package /MICROSAR/DoIP_ib_bswmd/BswModuleDescriptions
  bsw module description DoIP: provided-entrys=DoIP_MainFunction
    bsw internal behavior DoIPBehavior
      exclusive area DOIP_EXCLUSIVE_AREA_0
      bsw schedulable entity DoIP_MainFunction: implemented-entry=DoIP_MainFunction
      bsw timing event DoIP_MainFunctionTimingEvent0: starts-on-event=DoIP_MainFunction, period=0.005
  bsw module entry DoIP_MainFunction: call-type=SCHEDULED, execution-context=TASK
