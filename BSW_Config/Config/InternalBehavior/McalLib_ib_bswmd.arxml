AUTOSAR XML (schema 4-2-2)
package /AURIX2G/EcucDefs/McalLib_ib_bswmd/BswModuleDescriptions
  bsw module description McalLib
    bsw internal behavior McalLibBehavior
      4 x exclusive area:
        PeripheralEndInit
        SafetyEndInit
        CpuEndInit
        StmTimerResolution
