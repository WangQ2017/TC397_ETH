AUTOSAR XML (schema 4-0-3)
package /MICROSAR
  bsw implementation SoAd_Impl: programming-language=C, sw-version=16.05.01, used-code-generator=DaVinci Configurator, vendor-id=30, ar-release-version=4.02.02
