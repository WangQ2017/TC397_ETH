AUTOSAR XML (schema 4-0-3)
package /MICROSAR/SoAd_ib_bswmd/BswModuleDescriptions
  bsw module description SoAd: provided-entrys=SoAd_MainFunction
    bsw internal behavior SoAdBehavior
      exclusive area SOAD_EXCLUSIVE_AREA_0
      exclusive area SOAD_EXCLUSIVE_AREA_1
      bsw schedulable entity SoAd_MainFunction: implemented-entry=SoAd_MainFunction
      bsw timing event SoAd_MainFunctionTimingEvent0: starts-on-event=SoAd_MainFunction, period=0.005
  bsw module entry SoAd_MainFunction: call-type=SCHEDULED, execution-context=TASK
