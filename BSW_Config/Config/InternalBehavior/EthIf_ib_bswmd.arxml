AUTOSAR XML (schema 4-1-1)
package /MICROSAR/EthIf_ib_bswmd/BswModuleDescriptions
  bsw module description EthIf: provided-entrys=[EthIf_MainFunctionRx, EthIf_MainFunctionTx, EthIf_MainFunctionState]
    bsw internal behavior EthIfBehavior
      5 x exclusive area:
        ETHIF_EXCLUSIVE_AREA_CTRL_INIT
        ETHIF_EXCLUSIVE_AREA_SET_CTRL_MODE
        ETHIF_EXCLUSIVE_AREA_TX_MIRROR_ELEMENT
        ETHIF_EXCLUSIVE_AREA_RXTX_STATS
        ETHIF_EXCLUSIVE_AREA_SIGNAL_QUALITY
      bsw schedulable entity EthIf_MainFunctionRx: implemented-entry=EthIf_MainFunctionRx
      bsw schedulable entity EthIf_MainFunctionTx: implemented-entry=EthIf_MainFunctionTx
      bsw schedulable entity EthIf_MainFunctionState: implemented-entry=EthIf_MainFunctionState
      bsw timing event EthIf_MainFunctionRxTimingEvent0: starts-on-event=EthIf_MainFunctionRx, period=0.005
      bsw timing event EthIf_MainFunctionTxTimingEvent0: starts-on-event=EthIf_MainFunctionTx, period=0.005
      bsw timing event EthIf_MainFunctionStateTimingEvent0: starts-on-event=EthIf_MainFunctionState, period=0.025
  bsw module entry EthIf_MainFunctionRx: call-type=SCHEDULED, execution-context=TASK
  bsw module entry EthIf_MainFunctionTx: call-type=SCHEDULED, execution-context=TASK
  bsw module entry EthIf_MainFunctionState: call-type=SCHEDULED, execution-context=TASK
