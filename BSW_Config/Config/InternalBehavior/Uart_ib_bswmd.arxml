AUTOSAR XML (schema 00046)
package /AURIX2G/EcucDefs/Uart_ib_bswmd/BswModuleDescriptions
  bsw module description Uart: provided-entrys=[Uart_MainFunction_Read, Uart_MainFunction_Write]
    bsw internal behavior UartBehavior
      bsw schedulable entity Uart_MainFunction_Read: implemented-entry=Uart_MainFunction_Read
      bsw schedulable entity Uart_MainFunction_Write: implemented-entry=Uart_MainFunction_Write
      bsw timing event Uart_MainFunction_ReadTimingEvent0: starts-on-event=Uart_MainFunction_Read, period=0.005
      bsw timing event Uart_MainFunction_WriteTimingEvent0: starts-on-event=Uart_MainFunction_Write, period=0.005
  bsw module entry Uart_MainFunction_Read: call-type=SCHEDULED, execution-context=TASK
  bsw module entry Uart_MainFunction_Write: call-type=SCHEDULED, execution-context=TASK
