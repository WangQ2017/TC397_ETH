AUTOSAR XML (schema 4-0-3)
package /MICROSAR
  bsw implementation BswM_Impl: programming-language=C, sw-version=14.00.00, used-code-generator=DaVinci Configurator, vendor-id=30, ar-release-version=4.00.03
package /MICROSAR/BswM_ib_bswmd/BswModuleDescriptions
  bsw module description BswM
    provided-entrys:
      BswM_MainFunction
      BswM_MainFunction_OsApplication_OsCore0
      BswM_MainFunction_OsApplication_OsCore1
      BswM_MainFunction_OsApplication_OsCore5
      BswM_MainFunction_OsApplication_OsCore4
      BswM_MainFunction_OsApplication_OsCore3
      BswM_MainFunction_OsApplication_OsCore2
    bsw internal behavior BswMBehavior
      exclusive area BSWM_EXCLUSIVE_AREA_0
      bsw schedulable entity BswM_MainFunction: implemented-entry=BswM_MainFunction
      bsw timing event BswM_MainFunctionTimingEvent0: starts-on-event=BswM_MainFunction, period=0.01
  7 x bsw module entry, all with call-type=SCHEDULED, execution-context=TASK:
    BswM_MainFunction
    BswM_MainFunction_OsApplication_OsCore0
    BswM_MainFunction_OsApplication_OsCore1
    BswM_MainFunction_OsApplication_OsCore5
    BswM_MainFunction_OsApplication_OsCore4
    BswM_MainFunction_OsApplication_OsCore3
    BswM_MainFunction_OsApplication_OsCore2
