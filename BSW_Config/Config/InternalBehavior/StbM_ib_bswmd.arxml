AUTOSAR XML (schema 4-3-1)
package /MICROSAR
  bsw implementation StbM_Impl: programming-language=C, sw-version=8.01.00, used-code-generator=DaVinci Configurator, vendor-id=30, ar-release-version=4.05.00
package /MICROSAR/StbM_ib_bswmd/BswModuleDescriptions
  bsw module description StbM: provided-entrys=StbM_MainFunction
    bsw internal behavior StbMBehavior
      exclusive area STBM_EXCLUSIVE_AREA_0
      bsw schedulable entity StbM_MainFunction: implemented-entry=StbM_MainFunction
      bsw timing event StbM_MainFunctionTimingEvent0: starts-on-event=StbM_MainFunction, period=0.005
  bsw module entry StbM_MainFunction: call-type=SCHEDULED, execution-context=TASK
