AUTOSAR XML (schema 4-3-1)
package /MICROSAR
  bsw implementation StbM_Impl: programming-language=C, sw-version=8.01.00, used-code-generator=DaVinci Configurator, vendor-id=30, ar-release-version=4.05.00
