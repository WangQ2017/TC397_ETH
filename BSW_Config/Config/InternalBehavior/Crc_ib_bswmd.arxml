AUTOSAR XML (schema 00046)
package /AURIX2G/EcucDefs/Crc_ib_bswmd/BswModuleDescriptions
  bsw module description Crc
    bsw internal behavior CrcBehavior
      exclusive area CriticalSection
