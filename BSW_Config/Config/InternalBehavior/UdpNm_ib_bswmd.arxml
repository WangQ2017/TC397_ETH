AUTOSAR XML (schema 4-1-1)
package /MICROSAR
  bsw implementation UdpNm_Impl: programming-language=C, sw-version=6.00.00, used-code-generator=DaVinci Configurator, vendor-id=30, ar-release-version=4.01.01
package /MICROSAR/UdpNm_ib_bswmd/BswModuleDescriptions
  bsw module description UdpNm: provided-entrys=UdpNm_MainFunction_0
    bsw internal behavior UdpNmBehavior
      7 x exclusive area:
        UDPNM_EXCLUSIVE_AREA_0  # No interruption by any interrupt allowed (i.e. global interrupt locks)
        UDPNM_EXCLUSIVE_AREA_1  # No interruption of UdpNm_MainFunction or UdpNm_RequestBusSynchronization by UdpNm_SetUserData, UdpNm_SoAdIfTriggerTransmit or UdpNm_SetSleepReadyBit allowed
        UDPNM_EXCLUSIVE_AREA_2  # No interruption of UdpNm_SoAdIfTriggerTransmit by UdpNm_MainFunction, UdpNm_RequestBusSynchronization, UdpNm_SetUserData or UdpNm_SetSleepReadyBit allowed
        UDPNM_EXCLUSIVE_AREA_3  # No interruption of UdpNm_SetSleepReadyBit or UdpNm_SetUserData by UdpNm_MainFunction, UdpNm_RequestBusSynchronization or UdpNm_SoAdIfTriggerTransmit allowed
        UDPNM_EXCLUSIVE_AREA_4  # No interruption of UdpNm_SoAdIfRxIndication by UdpNm_GetUserData or UdpNm_GetPduData allowed
        UDPNM_EXCLUSIVE_AREA_5  # No interruption of UdpNm_GetUserData or UdpNm_GetPduData by UdpNm_SoAdIfRxIndication allowed
        UDPNM_EXCLUSIVE_AREA_6  # No interruption of UdpNm_MainFunction by UdpNm_RequestBusSynchronization allowed
      bsw schedulable entity UdpNm_MainFunction_0: implemented-entry=UdpNm_MainFunction_0
      bsw timing event UdpNm_MainFunction_0TimingEvent0: starts-on-event=UdpNm_MainFunction_0, period=0.005
  bsw module entry UdpNm_MainFunction_0: call-type=SCHEDULED, execution-context=TASK
