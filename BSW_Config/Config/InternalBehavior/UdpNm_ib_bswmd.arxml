AUTOSAR XML (schema 4-1-1)
package /MICROSAR
  bsw implementation UdpNm_Impl: programming-language=C, sw-version=6.00.00, used-code-generator=DaVinci Configurator, vendor-id=30, ar-release-version=4.01.01
