AUTOSAR XML (schema 4-0-3)
package /MICROSAR/EthSM_ib_bswmd/BswModuleDescriptions
  bsw module description EthSM: provided-entrys=EthSM_MainFunction
    bsw internal behavior EthSMBehavior
      bsw schedulable entity EthSM_MainFunction: implemented-entry=EthSM_MainFunction
      bsw timing event EthSM_MainFunctionTimingEvent0: starts-on-event=EthSM_MainFunction, period=0.005
  bsw module entry EthSM_MainFunction: call-type=SCHEDULED, execution-context=TASK
