AUTOSAR XML (schema 4-2-1)
package /MICROSAR/Eth_ib_bswmd/BswModuleDescriptions
  bsw module description Eth: provided-entrys=Eth_30_Tc3xx_MainFunction
    bsw internal behavior EthBehavior
      exclusive area ETH_30_TC3XX_EXCLUSIVE_AREA_DATA
      exclusive area ETH_30_TC3XX_EXCLUSIVE_AREA_MII
      exclusive area ETH_30_TC3XX_EXCLUSIVE_AREA_DISABLE_MAC
      bsw schedulable entity Eth_30_Tc3xx_MainFunction: implemented-entry=Eth_30_Tc3xx_MainFunction
      bsw timing event Eth_30_Tc3xx_MainFunctionTimingEvent0: starts-on-event=Eth_30_Tc3xx_MainFunction, period=0.005
  bsw module entry Eth_30_Tc3xx_MainFunction: call-type=SCHEDULED, execution-context=TASK
