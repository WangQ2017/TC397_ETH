AUTOSAR XML (schema 4-2-1)
package /MICROSAR
  bsw implementation Sd_Impl: programming-language=C, sw-version=9.03.00, used-code-generator=DaVinci Configurator, vendor-id=30, ar-release-version=4.02.01
package /MICROSAR/Sd_ib_bswmd/BswModuleDescriptions
  bsw module description Sd: provided-entrys=Sd_MainFunction
    bsw internal behavior SdBehavior
      exclusive area SD_EXCLUSIVE_AREA_0
      bsw schedulable entity Sd_MainFunction: implemented-entry=Sd_MainFunction
      bsw timing event Sd_MainFunctionTimingEvent0: starts-on-event=Sd_MainFunction, period=0.005
  bsw module entry Sd_MainFunction: call-type=SCHEDULED, execution-context=TASK
