AUTOSAR XML (schema 4-2-2)
package /AURIX2G/EcucDefs/Irq_ib_bswmd/BswModuleDescriptions
  bsw module description Irq
    bsw internal behavior IrqBehavior
