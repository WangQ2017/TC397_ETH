AUTOSAR XML (schema 00046)
package /MICROSAR/EthTSyn_ib_bswmd/BswModuleDescriptions
  bsw module description EthTSyn: provided-entrys=EthTSyn_MainFunction
    bsw internal behavior EthTSynBehavior
      exclusive area ETHTSYN_EXCLUSIVE_AREA_0  # Default exclusive area to ensure consistency of global RAM variables.
      exclusive area ETHTSYN_EXCLUSIVE_AREA_GET_TS  # Exclusive area to ensure consisteny of global RAM variables related to ingress and egress timestamping. Also used to minimize the delays when taking timestamps.
      exclusive area ETHTSYN_EXCLUSIVE_AREA_TIME_VALID  # Exlusive area to ensure consistency of time validation data.
      bsw schedulable entity EthTSyn_MainFunction: implemented-entry=EthTSyn_MainFunction
      bsw timing event EthTSyn_MainFunctionTimingEvent0: starts-on-event=EthTSyn_MainFunction, period=0.005
  bsw module entry EthTSyn_MainFunction: call-type=SCHEDULED, execution-context=TASK
