AUTOSAR XML (schema 4-0-3)
package /MICROSAR
  module config EcuC_Pre: definition=EcuC
    EcucGeneral:
      CPUType = CPU32Bit
      SizeOfInt = Size32Bit
      ByteOrder = LITTLE_ENDIAN
      BitOrder = LSB_to_MSB
      AtomicBitAccessInBitfield = 0
      AtomicVariableAccess = Atomic32BitAccess
  module config EcuC_Rec: definition=EcuC
    EcucGeneral:
      DummyFunction = 0
      DummyStatement = 1
      StructAlignment = Auto
      ArrayAlignment = Align8Bit
      StructInArrayAlignment = Auto
      SizeOfEnum = Size32Bit
      SizeOfROMPointer = Size32Bit
      SizeOfRAMPointer = Size32Bit
      PostbuildLoadable: AlignmentFillPattern=255
