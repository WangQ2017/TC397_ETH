AUTOSAR XML (schema 4-1-2)
# COPYRIGHT
# Copyright (c) 2018 by Vector Informatik GmbH. All rights reserved.
# This software is copyright protected and proprietary to Vector Informatik GmbH.
# Vector Informatik GmbH grants to you only those rights as set out in the license conditions.
package /MICROSAR
  bsw implementation Dem_Impl: programming-language=C, sw-version=19.07.00, used-code-generator=DaVinci Configurator, vendor-id=30, ar-release-version=4.01.02, behavior=DemBehavior, preconfigured-configuration=Dem_Pre, recommended-configuration=Dem_Rec, vendor-specific-module-def=Dem
  module definition Dem [0..1]: category=VENDOR_SPECIFIC_MODULE_DEFINITION, refined-module-def=Dem, variants pre-compile/post-build-loadable/post-build-selectable  # Configuration of the Dem (Diagnostic Event Manager) module.
    container DemConfigSet  # This container groups the Diagnostic Monitor configuration setup. One such data set can be activated during initialization in case of multiple configuration sets. Currently only one configuration set is supported.
      container DemDTCClass [0..65535]  # This container groups configuration options relating to the Diagnostic Trouble code (DTC) of a monitor. It is only valid if actually used by a monitor (see DemConfigSet/DemEventParameter/DemDTCClassRef). Unused DTCClass containers are ignored.
        integer DemDTCFunctionalUnit [0..1]: 0..255, scope=ECU, set at pre-compile, default-value=0  # A 1-byte value which identifies the corresponding basic vehicle / system function which monitors this DTC. This parameter is necessary for the report of severity information and will be returned in UDS services $19 08 and $19 09. If these services are not used, this parameter serves no use at all. This parameter has no further influence on the function of the Dem. If this parameter is not configured the value 0 is substituted, as required by AUTOSAR 4.3.
        enumeration DemDTCSeverity [0..1]: {DEM_DTC_SEV_CHECK_AT_NEXT_HALT, DEM_DTC_SEV_IMMEDIATELY, DEM_DTC_SEV_MAINTENANCE_ONLY, DEM_DTC_SEV_NO_SEVERITY}, scope=ECU, set at pre-compile, default-value=DEM_DTC_SEV_NO_SEVERITY  # DTC severity information. This parameter is reported by UDS service $19 09 and can serve as filter for UDS service $19 08. A missing configuration value (or parameter) is interpreted as NO_SEVERITY. This parameter has no further influence on the function of the Dem.
        boolean DemImmediateNvStorage: scope=ECU, set at pre-compile, default-value=false  # Select the write strategy for non-volatile storage of data. If enabled, this DTC will be written to NV backing storage when the related event data (extended data and snapshot data) changes. If disabled, the DTC will be persisted during shutdown.
        integer DemJ1939DTC [0..1]: 1..16777214, scope=ECU, set at pre-compile  # Unique Diagnostic Trouble Code value for J1939 (consisting of SPN and FMI).
        integer DemObdDTC [0..1]: 1..65535, scope=ECU, set at post-build in variant post-build-loadable+post-build-selectable / pre-compile in variant pre-compile  # OBD II DTC | Unique Diagnostic Trouble Code value for OBD II. This parameter is only valid if OBD II is supported (DemGeneral/DemOBDSupport == true and DemGeneral/DemGeneralOBD/DemOBDLegislation == DEM_OBD_LEGISLATION_OBDII) If a DTC is OBD II relevant (i.e. has this DTC number configured) certain legislated restrictions apply to the DTC configuration. Please refer to the OBD legislation.
        integer DemUdsDTC [0..1]: 1..16777214, scope=ECU, set at post-build in variant post-build-loadable+post-build-selectable / pre-compile in variant pre-compile  # Unique Diagnostic Trouble Code value for UDS (DTC number).
        enumeration DemWWHOBDDTCClass [0..1]: {DEM_DTC_WWHOBD_CLASS_A, DEM_DTC_WWHOBD_CLASS_B1, DEM_DTC_WWHOBD_CLASS_B2, DEM_DTC_WWHOBD_CLASS_C, DEM_DTC_WWHOBD_CLASS_NOCLASS}, scope=ECU, set at post-build in variant post-build-loadable+post-build-selectable / pre-compile in variant pre-compile, origin=Vector Informatik  # CLASS_A: If a DTC with this class occur, it is assumed that the OBD threshold limits (OTL) are exceeded. CLASS_B1: A DTC with this class has the potential to lead to emissions above the OBD threshold limits. CLASS_B2: The malfunction is assumed to influence the emissions but not in a level exceeding the OBD threshold limits. CLASS_C: The DTC is assumed to influence the emissions but not in a level above the regulated emission limits. CLASS_NOCLASS: The DTC does not influence the emissions.
        reference DemMILGroupRef [0..1]: set at post-build in variant post-build-loadable+post-build-selectable / pre-compile in variant pre-compile, origin=Vector Informatik, destination=DemMILGroup  # Reference to a MIL group that is needed if different symptoms shall use one common trip counter.
        reference DemJ1939DTC_NodeAddressRef [0..1]: set at pre-compile, destination=DemJ1939NodeAddress  # Reference to a J1939 NodeAddress.
        container DemCallbackInitMForF [0..*]  # Callback InitMonitorForFunction | The presence of this container sets up an initialization function (InitMonitorForFunction) for this DTC. The Dem will call this function each time the related DTC is cleared, or the operation (monitoring) cycle of the related monitor restarts. This function is usually called through a RTE port interface. This behavior can be changed by creating the sub-parameter 'DemCallbackInitMForFFnc'.
          function name DemCallbackInitMForFFnc [0..1]: scope=ECU, set at pre-compile  # Callback InitMonitorForFunction Function | Function name of an InitMonitorForFunction callout. If this parameter exists, it must give a valid C-Function which is called instead of using an RTE port interface. See DemGeneral/DemHeaderFileInclusion to specify a header file which declares this function.
      container DemDtrs [0..1]: post-build-changeable=true  # This container holds the configuration of DTRs collection.
        container DemDtr [0..65534]: post-build-changeable=true  # This container holds the configuration of one individual DTR.
          float DemDtrCompuDenominator0: 0..3.4028235E+38, scope=ECU, set at post-build in variant post-build-loadable+post-build-selectable / pre-compile in variant pre-compile, origin=Vector Informatik, default-value=1  # Part of the conversion between the binary representation and the physical meaning analogous to the SW-C Template conversion CompuRationalCoeffs with 2 numerator coefficients and 1 denominator coefficient in the direction compuInternalToPhys. The value must be greater than 0. In detail, the conversion of x (= old Value) to y (= new value) is given by y = (A*x + B)/C, where A = DemDtrCumpuNumerator1, B = DemDtrCompuNumerator0, C = DemDtrCompuDenominator0 (= this parameter).
          float DemDtrCompuNumerator0: -3.4028235E+38..3.4028235E+38, scope=ECU, set at post-build in variant post-build-loadable+post-build-selectable / pre-compile in variant pre-compile, origin=Vector Informatik, default-value=0  # Part of the conversion between the binary representation and the physical meaning analogous to the SW-C Template conversion CompuRationalCoeffs with 2 numerator coefficients and 1 denominator coefficient in the direction compuInternalToPhys. In detail, the conversion of x (= old Value) to y (= new value) is given by y = (A*x + B)/C, where A = DemDtrCumpuNumerator1, B = DemDtrCompuNumerator0 (= this parameter), C = DemDtrCompuDenominator0.
          float DemDtrCompuNumerator1: 0..3.4028235E+38, scope=ECU, set at post-build in variant post-build-loadable+post-build-selectable / pre-compile in variant pre-compile, origin=Vector Informatik, default-value=1  # Part of the conversion between the binary representation and the physical meaning analogous to the SW-C Template conversion CompuRationalCoeffs with 2 numerator coefficients and 1 denominator coefficient in the direction compuInternalToPhys. The value must be greater than 0. In detail, the conversion of x (= old Value) to y (= new value) is given by y = (A*x + B)/C, where A = DemDtrCumpuNumerator1 (= this parameter), B = DemDtrCompuNumerator0, C = DemDtrCompuDenominator0.
          integer DemDtrId: 0..65535, scope=ECU, set at pre-compile, origin=Vector Informatik, symbolic-name-value=true, default-value=65535  # The index identifier value assigned to this DTR. The value is generated during the Dem configuration process.
          integer DemDtrMid: 1..255, scope=ECU, set at post-build in variant post-build-loadable+post-build-selectable / pre-compile in variant pre-compile, origin=Vector Informatik  # The OBDMID of the DTR. The values 0x00, 0x20, 0x40, 0x60, 0x80, 0xA0, 0xC0, 0xE0 are reserved.
          integer DemDtrTid: 0..255, scope=ECU, set at post-build in variant post-build-loadable+post-build-selectable / pre-compile in variant pre-compile, origin=Vector Informatik  # The OBDTID of the DTR.
          integer DemDtrUasid: 0..255, scope=ECU, set at post-build in variant post-build-loadable+post-build-selectable / pre-compile in variant pre-compile, origin=Vector Informatik  # The UaSId the DTR data shall be scaled to, and reported together with the rescaled DTR data.
          enumeration DemDtrUpdateKind [0..1]: {DEM_DTR_UPDATE_ALWAYS, DEM_DTR_UPDATE_STEADY}, set at post-build in variant post-build-loadable+post-build-selectable / pre-compile in variant pre-compile, origin=Vector Informatik  # Update conditions applied by the Dem to reports of DTR values. Only supported if a related Event is configured. If no related Event is configured, the Dem behaves as if DemDtrUpdateKind is configured to "DEM_DTR_UPDATE_ALWAYS".
          reference DemDtrEventRef [0..1]: scope=ECU, set at post-build in variant post-build-loadable+post-build-selectable / pre-compile in variant pre-compile, origin=Vector Informatik, destination=DemEventParameter  # Reference to the DemEventParameter this DTR is related to. If the related event is not configured, the Dem cannot ensure consistency between the DTR and the event.
      container DemEventParameter [1..65534]  # This container contains the configuration of diagnostic events. These represent monitors and can be mapped onto a DTC.
        boolean DemEventAvailable: scope=ECU, set at post-build in variant post-build-loadable+post-build-selectable / pre-compile in variant pre-compile, default-value=true  # This parameter configures an Event as unavailable.
        integer DemEventId: 1..65535, scope=ECU, set at pre-compile, symbolic-name-value=true, default-value=65535  # Internal identifier of a diagnostic event. This number is calculated internally and shall not be configured manually. This parameter is only available to publish the result of this calculation. Applications using Dem APIs must not rely on the value of this parameter. Instead, they must use the symbolic constant (SymbolicNameValue) DemConf_DemEventParameter_{SHORT-NAME}.
        enumeration DemEventKind: {DEM_EVENT_KIND_BSW, DEM_EVENT_KIND_SWC}, set at pre-compile, default-value=DEM_EVENT_KIND_SWC  # This parameter is used to distinguish between SW-C and BSW events. SW-C events are reported through the RTE port interface DiagnosticMonitor, operation SetEventStatus. BSW events are reported by C-API Dem_SetEventStatus.
        integer DemMaxNumberFreezeFrameRecords [0..1]: 0..255, scope=ECU, set at pre-compile, default-value=0  # Max Number FreezeFrameRecords | This parameter defines the number of snapshot records which can be stored for this event. The parameter will be mandatory, if the snapshot numbers are CALCULATED (see DemGeneral/DemTypeOfFreezeFrameRecordNumeration) and a FreezeFrame is configured for this DemEventParameter (see DemFreezeFrameClassRef). For configured record numbers this value has no meaning and should be removed.
        boolean DemEventAvailableInVariant: set at pre-compile in variant post-build-loadable+pre-compile / post-build in variant post-build-selectable, origin=Vector Informatik, default-value=true  # This parameter is internally used and automatically calculated. DO NOT CHANGE MANUALLY.
        boolean DemEventLatchTestFailed: set at pre-compile, origin=Vector Informatik, default-value=false  # Event Latch TestFailed | Switch to block TestPassed results for a qualified event. See DemGeneral/DemLatchTestFailedBehavior for the effect of this switch.
        enumeration DemEventTimeSeries [0..1]: {DEM_TIMESERIES_SNAPSHOT_NONE, DEM_TIMESERIES_SNAPSHOT_NORMAL_RATE, DEM_TIMESERIES_SNAPSHOT_FAST_RATE}, set at pre-compile, origin=Vector Informatik, default-value=DEM_TIMESERIES_SNAPSHOT_NONE  # (not supported)
        boolean DemEventCreateInfoPort: set at pre-compile, origin=Vector Informatik, default-value=true  # Activate/deactivate the creation of the DiagnosticInfo port for the event. If this parameter is enabled, the interface DiagnosticInfo is provided for the event.
        boolean DemEventRecoverableInSameOperationCycle [0..0]: set at pre-compile, origin=Autosar  # Not supported. Please use the following parameters to configure the desired behavior DemEventRecoverableInSameOperationCycle = TRUE: DemEventLatchTestFailed = FALSE DemEventRecoverableInSameOperationCycle = FALSE: DemEventLatchTestFailed = TRUE AND DemGeneral/DemLatchTestFailedBehavior = DEM_LATCH_ONLY_THIS_CYCLE
        reference DemDTCClassRef [0..1]: set at pre-compile, destination=DemDTCClass  # DTC Class Ref | This parameter defines the DTC configuration associated with the diagnostic event, that means it maps the event onto a DTC number.
        foreign reference DemEventParameterSystemTemplateDiagnosticEventRef [0..1]: set at pre-compile, origin=Vector Informatik, destination-type=DIAGNOSTIC-EVENT  # EventParameter System Template DiagnosticEvent Ref | Reference to the DiagnosticEvent which is represented by this DemEventParameter.
        reference DemExtendedDataClassRef [0..1]: set at pre-compile, destination=DemExtendedDataClass  # ExtendedData Class Ref | This reference defines the list of extended data records available for this event.
        reference DemFreezeFrameClassRef [0..1]: set at pre-compile, destination=DemFreezeFrameClass  # FreezeFrame Class Ref | These references define the list of Data IDs (DIDs) stored in the snapshot records of this event.
        reference DemFreezeFrameRecNumClassRef [0..1]: scope=ECU, set at pre-compile, destination=DemFreezeFrameRecNumClass  # FreezeFrameRecNum Class Ref | This parameter defines the list of dedicated snapshot record numbers associated with the diagnostic event. These record numbers are assigned to the snapshot records. The parameter will be mandatory, if the snapshot numbers are CONFIGURED (see DemGeneral/DemTypeOfFreezeFrameRecordNumeration) and a FreezeFrame is configured for this DemEventParameter (see DemFreezeFrameClassRef). For calculated record numbers this value has no meaning and should be removed.
        reference DemJ1939ExpandedFreezeFrameClassRef [0..1]: set at pre-compile, destination=DemJ1939FreezeFrameClass  # J1939 Expanded FreezeFrame Class Ref | These references define the links to a J1939 freeze frame class sampler.
        reference DemJ1939FreezeFrameClassRef [0..1]: set at pre-compile, destination=DemJ1939FreezeFrameClass  # J1939 FreezeFrame Class Ref | These references define the links to a J1939 freeze frame class sampler.
        reference DemOBDGroupingAssociativeEventsRef [0..0]: scope=ECU, set at pre-compile, destination=DemEventParameter  # This parameter defines a reference which points to a representative event of one group of associate events. (Not supported, please use DemDTCClass/DemMILGroupRef instead)
        reference DemEventOsApplicationRef [0..1]: set at pre-compile, origin=Vector Informatik, destination=OsApplication  # OsApplication Ref for Event | Reference to the (satellite) partition, this event is assigned to. The Dem directly supports multi partition architectures, i.e. ECUs using multiple cores or memory protection for safety reasons. See chapter "Multi-Partition support" in the TechnicalReference for details.
        reference DemWWHOBDFreezeFrameClassRef [0..1]: set at post-build in variant post-build-loadable+post-build-selectable / pre-compile in variant pre-compile, origin=Vector Informatik, destination=DemFreezeFrameClass  # WWHOBD FreezeFrame Class Ref | This reference defines the link to a WWH-OBD freeze frame class sampler.
        container DemCallbackClearEventAllowed [0..1]  # Callback ClearEventAllowed | The presence of this container sets up a callout function 'ClearEventAllowed' for this DTC. The Dem will call this function each time the related DTC is about to be cleared by an external tool. (API Dem_ClearDTC, usually only called by Dcm). This function is usually called through a RTE port interface. This behavior can be changed by creating the sub-parameter 'DemCallbackClearEventAllowedFnc'.
          function name DemCallbackClearEventAllowedFnc [0..1]: scope=ECU, set at pre-compile  # Callback ClearEventAllowed Function | Function name of a 'ClearEventAllowed' callout. If this parameter exists, it must give a valid C-Function which is called instead of using an RTE port interface. See DemGeneral/DemHeaderFileInclusion to specify a header file which declares this function.
          enumeration DemClearEventAllowedBehavior: {DEM_NO_STATUS_BYTE_CHANGE, DEM_ONLY_THIS_CYCLE_AND_READINESS}, set at pre-compile, default-value=DEM_NO_STATUS_BYTE_CHANGE  # Defines the resulting UDS status byte for the related event, which must not be cleared according to the ClearEventAllowed callback. (not supported)
        container DemCallbackEventDataChanged [0..1]  # Callback EventDataChanged | The presence of this container sets up a callout function 'EventDataChanged' for this DTC. The Dem will call this function each time the stored data (extended record, snapshot record) has changed. Please note, data elements can be mapped to internal data. This callback is NOT called if such data changes, only if the stored data record is modified due to a new event report. Example: If an extended record is mapped to the fault detection counter, this API is not called each time the FDC changes even though a diagnostic service $19 06 would indeed return different data. This function is usually called through a RTE port interface. This behavior can be changed by creating the sub-parameter 'DemCallbackEventDataChangedFnc'. The presence of this container indicates that the Dem has access to an "EventDataChanged" callback. This container is ignored, if parameter DemGeneral/DemTriggerEventDataChangedCallback exists and has value False.
          function name DemCallbackEventDataChangedFnc [0..1]: scope=ECU, set at pre-compile  # Callback EventDataChanged Function | Function name of a 'EventDataChanged' callout. If this parameter exists, it must give a valid C-Function which is called instead of using an RTE port interface. See DemGeneral/DemHeaderFileInclusion to specify a header file which declares this function.
        container DemCallbackEventStatusChanged [0..*]  # Callback EventStatusChanged | The presence of this container sets up a callout function 'EventStatusChanged' for this DTC. The Dem will call this function each time the event status changes. Please note, the event status is independent of the DTC status availability mask (DemGeneral/DemDtcStatusAvailabilityMask). All transitions of status bits will be reported. Attention: Due to preemption it is possible that event status changes are reported in the wrong order. This is no issue if the Dem_Mainfunction is mapped to a non-preemptive task. This function is usually called through a RTE port interface. This behavior can be changed by creating the sub-parameter 'DemCallbackEventStatusChangedFnc'. This container is ignored, if parameter DemGeneral/DemTriggerEventStatusChangedCallback exists and has value False.
          function name DemCallbackEventStatusChangedFnc [0..1]: scope=ECU, set at pre-compile  # Callback EventStatusChanged Function | Function name of an 'EventStatusChanged' callout. If this parameter exists, it must give a valid C-Function which is called instead of using an RTE port interface. See DemGeneral/DemHeaderFileInclusion to specify a header file which declares this function.
        container DemCallbackInitMForE [0..1]  # Callback InitMonitorForEvent | The presence of this container sets up an initialization function 'InitMonitorForEvent' for this Event. The Dem will call this function each time this event is cleared, or the operation (monitoring) cycle restarts (see ./DemEventClass/DemOperationCycleRef). Using parameter DemTriggerMonitorInitForEnableConditions with value'true', this function will also be called if an enable condition or ControlDTC ($85 01) re-activates this event. This function is usually called through a RTE port interface. This behavior can be changed by creating the sub-parameter 'DemCallbackInitMForFFnc'.
          function name DemCallbackInitMForEFnc [0..1]: set at pre-compile  # Callback InitMonitorForEvent Function | Function name of a 'InitMonitorForEvent' callout. If this parameter exists, it must give a valid C-Function which is called instead of using an RTE port interface. See DemGeneral/DemHeaderFileInclusion to specify a header file which declares this function.
        container DemEventClass  # This container contains further configuration parameters for the event.
          boolean DemAgingAllowed: scope=ECU, set at pre-compile, default-value=false  # Switch to allow aging/unlearning of the event. If aging is supported, a valid aging cycle must be referenced (see DemAgingCycleRef) and a valid number of aging cycles must be set (see DemAgingCycleCounterThreshold).
          integer DemAgingCycleCounterThreshold [0..1]: 0..255, scope=ECU, set at post-build in variant post-build-loadable+post-build-selectable / pre-compile in variant pre-compile  # AgingCycle Counter Threshold | Number of aging cycles needed to unlearn/delete the event. A value of 0 (or when this parameter is missing) means, the event is aged immediately with a passed event status. A value of 1 means the event is aged at the end of the current aging cycle (if the event is passive at that moment). Larger values represent the n-th cycle e.g. 2 is the next, 3 the cycle after the next etc. This parameter is only needed in case aging is allowed for this event (see DemAgingAllowed).
          boolean DemConsiderPtoStatus: scope=ECU, set at pre-compile, default-value=false  # This parameter is currently unused.
          enumeration DemEventDestination: {DEM_DTC_ORIGIN_MIRROR_MEMORY, DEM_DTC_ORIGIN_PRIMARY_MEMORY, DEM_DTC_ORIGIN_SECONDARY_MEMORY}, scope=ECU, set at pre-compile, default-value=DEM_DTC_ORIGIN_PRIMARY_MEMORY  # Define the event memory this event belongs to. Events in PRIMARY_MEMORY can be reported and cleared using the 'usual' UDS services $19, $14 and so on. That means the event will be cleared with $14 FFFFFF (independent of a valid DTC number for this event (see ../DemDTCClassRef). OBD relevant events must be located in primary memory. Events in SECONDARY_MEMORY are not supported by UDS services and must be reported/cleared by integration specific means. Events in MIRROR_MEMORY are currently not supported. An event is not able to be located in more than one memory at the same time, this is a restriction because event notifications have no way to tell which memory's event status has changed.
          integer DemEventFailureCycleCounterThreshold [0..1]: 0..254, scope=ECU, set at post-build in variant post-build-loadable+post-build-selectable / pre-compile in variant pre-compile, default-value=0  # Event FailureCycleCounter Threshold | Number of operation cycles needed to confirm the event. When the parameter is missing or has the value 0, use the standard UDS behavior of confirming the event (ConfirmedDTC status bit becomes set) with the first qualified FAILED result. A value of 1 means the event becomes confirmed if it fails again in the next operation cycle. Larger values represent confirmation in the n-th cycle e.g. 2 is confirmation in cycle after the next cycle, etc. All DTCs, that are in the same MIL Group, must have the same threshold value (refer to parameter /Dem/DemGeneral/DemMILGroup).
          integer DemEventMemoryEntryFdcThresholdStorageValue [0..0]: 0..255, set at pre-compile  # Threshold to allocate an event memory entry and to capture the Freeze Frame. (Not supported - please use DemConfigSet/DemEventParameter/DemEventClass/DemDebounceAlgorithmClass/DemDebounceTimeBase/DemDebounceTimeStorageThreshold or DemConfigSet/DemEventParameter/DemEventClass/DemDebounceAlgorithmClass/DemDebounceCounterBased/DemEventDebounceCounterStorageThreshold instead.)
          enumeration DemEventOBDReadinessGroup [0..1]: {DEM_OBD_RDY_AC, DEM_OBD_RDY_BOOSTPR, DEM_OBD_RDY_CAT, DEM_OBD_RDY_CMPRCMPT, DEM_OBD_RDY_EGSENS, DEM_OBD_RDY_EGR, DEM_OBD_RDY_EVAP, DEM_OBD_RDY_FLSYS, DEM_OBD_RDY_FLSYS_NONCONT, DEM_OBD_RDY_HCCAT, DEM_OBD_RDY_HTCAT, DEM_OBD_RDY_MISF, DEM_OBD_RDY_NONE, DEM_OBD_RDY_NOXCAT, DEM_OBD_RDY_O2SENS, DEM_OBD_RDY_O2SENSHT, DEM_OBD_RDY_PMFLT, DEM_OBD_RDY_SECAIR}, scope=ECU, set at post-build in variant post-build-loadable+post-build-selectable / pre-compile in variant pre-compile, default-value=DEM_OBD_RDY_NONE  # Select the Event OBD Readiness group. This parameter is only needed if OBD support is enabled (see DemGeneral/DemOBDSupport). The parameter is needed for PID $01 and PID $41 computation and to classify faults according to OBD requirements (e.g. OBD freeze frame related to misfire or fuel system faults can displace other freeze frames). Readiness group DEM_OBD_RDY_AC is not supported.
          integer DemEventPriority: 1..255, scope=ECU, set at post-build in variant post-build-loadable+post-build-selectable / pre-compile in variant pre-compile, default-value=2  # Set the priority of the event. A lower number represent higher priority. Same level priority is allowed. This value influences the event displacement in case the respective memory is completely filled at the time of event confirmation. Lower priority events will never displace higher priority events. Equal priority events will displace passive entries. See also DemGeneral/DemMaxNumberEventEntryPrimary resp. DemGeneral/DemMaxNumberEventEntrySecondary. This parameter only has an effect if event displacement is supported (see DemGeneral/DemEventDisplacementSupport).
          enumeration DemEventSignificance [0..1]: {DEM_EVENT_SIGNIFICANCE_FAULT, DEM_EVENT_SIGNIFICANCE_OCCURRENCE}, scope=ECU, set at pre-compile, default-value=DEM_EVENT_SIGNIFICANCE_FAULT  # Significance of the event, which indicates additional information concerning fault classification and resolution. This value can optionally be selected to be reported as event data (e.g. as data element inside an extended data record). It has no further effect on the Dem.
          boolean DemFFPrestorageSupported: scope=ECU, set at pre-compile, default-value=false  # FreezeFrame Prestorage Supported | Select the event for prestorage support. Only events with this flag enabled may request data prestorage (Port interface DiagnosticMonitor, operation PrestoreFreezeFrame). This parameter only has an effect if prestorage is enabled (see DemGeneral/DemMaxNumberPrestoredFF).
          choice reference DemAgingCycleRef [0..1]: scope=ECU, set at post-build in variant post-build-loadable+post-build-selectable / pre-compile in variant pre-compile, origin=AUTOSAR_ECUC V1.0.0, destination=DemOperationCycle  # AgingCycle Ref | Select the cycle which triggers aging/unlearning of this event. This can either be the same as the operation cycle of the event (see DemOperationCycleRef) or a different cycle. Note: DemAgingCycle container (Dem/DemGeneral/DemAgingCycle) references are currently not supported. Use a DemOperationCycle container (Dem/DemGeneral/DemOperationCycle) instead for the same effect.
          reference DemEnableConditionGroupRef [0..1]: scope=ECU, set at post-build in variant post-build-loadable+post-build-selectable / pre-compile in variant pre-compile, origin=AUTOSAR_ECUC V1.0.0, destination=DemEnableConditionGroup  # EnableCondition Group Ref | References an enable condition group. An event status report ((Pre)Failed or (Pre)Passed) will only have an effect if all EnableConditions belonging to the referenced group are met at the time of report. Otherwise the result will be discarded.
          reference DemEventFailureCycleRef [0..1]: scope=ECU, set at pre-compile, origin=AUTOSAR_ECUC V1.0.0, destination=DemOperationCycle  # Event FailureCycle Ref | Select the cycle which is used as base of counting failures of this event. This must be the same value as the operation cycle of the event (see DemOperationCycleRef). Therefore this parameter value here is always ignored and (internally) substituted by the DemOperationCycleRef value. You can safely delete this parameter - it has no impact on your configuration.
          reference DemOperationCycleRef: scope=ECU, set at post-build in variant post-build-loadable+post-build-selectable / pre-compile in variant pre-compile, origin=AUTOSAR_ECUC V1.0.0, destination=DemOperationCycle  # OperationCycle Ref | Select the operation/monitoring cycle for the event. This cycle is used: - to reset the NotTestedThisCycle and FailedThisCycle bits of the event status, - as the basis of event confirmation in case multiple trips are required (see DemEventFailureCycleCounterThreshold), - as the basis for healing of the WarningIndicatorRequests bit in case multiple passed cycles are required (e.g. to disable the MIL).
          reference DemStorageConditionGroupRef [0..1]: scope=ECU, set at post-build in variant post-build-loadable+post-build-selectable / pre-compile in variant pre-compile, origin=AUTOSAR_ECUC V1.0.0, destination=DemStorageConditionGroup  # StorageCondition Group Ref | References a storage condition group. An event status report will not result in an event entry to be created or updated unless all StorageConditions belonging to the referenced group are met at the time of report. This means PendingDTC or ConfirmedDTC will not be set, and Indicators will not be enabled. Already stored events can still stop to age and heal, and the remaining status bits are modified if needed.
          choice container DemDebounceAlgorithmClass  # DebounceAlgorithm Class | Select the debouncing algorithm used for the event.
            container DemDebounceCounterBased [0..1]  # Debounce CounterBased | Counter based debouncing will increment a counter with each Prefailed result, and decrement the counter with each Prepassed result. A qualified 'Passed' or 'Failed' result will be generated when a given threshold value is reached. This debouncing type is ideal for cyclic monitors that generate a monitoring result regularly since it involves little overhead. The debounce value is mapped to a faultdetection count (FDC) as such: If the Failed threshould is reached, FDC is 127. If the DebounceCounter is 0, FDC is 0. If the Passed threshold is reached, FDC is -128. Values between 0 and the threshold values are linearly mapped to 1..126 respectively -1..-127.
              enumeration DemDebounceBehavior: {DEM_DEBOUNCE_FREEZE, DEM_DEBOUNCE_RESET}, set at post-build in variant post-build-loadable+post-build-selectable / pre-compile in variant pre-compile, default-value=DEM_DEBOUNCE_FREEZE  # This parameter defines how the event debounce algorithm will behave, if a related enable condition is not fulfilled or ControlDTCSetting of the related event is disabled. FREEZE: The FDC will continue at the current value when enable conditions / ControlDTCSetting allow event reports again. RESET: The FDC will revert to 0. See also (DemGeneral/DemResetDebounceBehavior)
              integer DemDebounceCounterDecrementStepSize: 1..32768, scope=ECU, set at post-build in variant post-build-loadable+post-build-selectable / pre-compile in variant pre-compile, default-value=1  # DebounceCounter Decrement Step Size | The debounce counter will be decremented by this amount with each PREPASSED monitor result. Note: The value is subtracted, so it must be positive.
              integer DemDebounceCounterFailedThreshold: 1..32767, scope=ECU, set at post-build in variant post-build-loadable+post-build-selectable / pre-compile in variant pre-compile, default-value=127  # DebounceCounter Failed Threshold | If a PREFAILED monitor result increments the debounce counter to(or above) this value, a qualified FAILED result is generated.
              integer DemDebounceCounterIncrementStepSize: 1..32767, scope=ECU, set at post-build in variant post-build-loadable+post-build-selectable / pre-compile in variant pre-compile, default-value=1  # DebounceCounter Increment Step Size | The debounce counter will be incremented by this amount with each PREFAILED monitor result.
              boolean DemDebounceCounterJumpDown: scope=ECU, set at post-build in variant post-build-loadable+post-build-selectable / pre-compile in variant pre-compile, default-value=true  # DebounceCounter Jump Down | Select the jump down behavior. If enabled, the debounce counter is set to the value of DemDebounceCounterJumpDownValue before decrementing, unless the counter already is smaller. This can be used to achieve constant times for a qualified PASSED result.
              integer DemDebounceCounterJumpDownValue: -32768..32767, scope=ECU, set at post-build in variant post-build-loadable+post-build-selectable / pre-compile in variant pre-compile, default-value=0  # DebounceCounter Jump Down Value | This is the debounce counter value set if a 'JumpDown' is triggered. This parameter is used only if DemDebounceCounterJumpDown is enabled.
              boolean DemDebounceCounterJumpUp: scope=ECU, set at post-build in variant post-build-loadable+post-build-selectable / pre-compile in variant pre-compile, default-value=true  # DebounceCounter Jump Up | Select the jump up behavior. If enabled, the debounce counter is set to the value of DemDebounceCounterJumpUpValue before incrementing, unless the counter already is larger. This can be used to achieve constant times for a qualified FAILED result.
              integer DemDebounceCounterJumpUpValue: -32768..32767, scope=ECU, set at post-build in variant post-build-loadable+post-build-selectable / pre-compile in variant pre-compile, default-value=0  # DebounceCounter Jump Up Value | This is the debounce counter value which is set if a 'JumpUp' is triggered. Usually this is set to 0 as shown in ISO14229. This parameter is used only if DemDebounceCounterJumpUp is enabled.
              integer DemDebounceCounterPassedThreshold: -32768..-1, scope=ECU, set at post-build in variant post-build-loadable+post-build-selectable / pre-compile in variant pre-compile, default-value=-128  # DebounceCounter Passed Threshold | If a PREPASSED monitor result decrements the debounce counter to (or below) this value, a qualified PASSED result is generated.
              boolean DemDebounceCounterStorage: set at pre-compile, default-value=false  # Switch to store the debounce counter value non-volatile or not. When activating this feature, the configuration needs an additional NV-RAM block with DemNvRamBlockIdType "DEM_NVBLOCK_DEBOUNCE".
              integer DemEventDebounceCounterStorageThreshold [0..1]: 1..32767, set at post-build in variant post-build-loadable+post-build-selectable / pre-compile in variant pre-compile, origin=Vector Informatik, default-value=127  # DebounceCounter Storage Threshold | If a PREFAILED monitor result increments the debounce counter to (or above) this value, a FDC TRIP result is generated. This value has to be less or equal to DemDebounceCounterFailedThreshold. This parameter is only relevant if data is stored at a time where the DTC fault detection counter passes a threshold lower than the failed threshold.
              boolean DemDebounceContinuous: set at post-build in variant post-build-loadable+post-build-selectable / pre-compile in variant pre-compile, origin=Vector Informatik, default-value=false  # This parameter defines whether the event debounce algorithm will continue counting while enable conditions are not fulfilled / ControlDTCSetting is enabled. To prevent the event from qualifying after the enable conditions become enabled / ControlDTCSetting is disabled again, it is recommended to set DemDebounceBehavior to DEM_DEBOUNCE_RESET if this option is used.
            container DemDebounceMonitorInternal [0..1]  # Debounce MonitorInternal | Monitor internal debouncing is used for monitors that implement the debouncing themselves, and only report qualified results (PASSED/FAILED) to the Dem. In order to implement the diagnostic services that report the fault detection counter, a callout function is required.
              container DemCallbackGetFDC [0..1]  # Callback GetFDC | This container sets up the callout function 'DemCallbackGetFDC' for this Event. The Dem will call this function each time the value of the fault detection counter is needed, e.g. requested by the Dcm. This function is usually called through a RTE port interface. This behavior can be changed by creating the sub-parameter 'DemCallbackGetFDCFnc'.
                function name DemCallbackGetFDCFnc [0..1]: scope=ECU, set at pre-compile  # Callback GetFaultDetectionCounter Function | Function name of a 'DemCallbackGetFDC' callout. If this parameter exists, it must give a valid C-Function which is called instead of using an RTE port interface. See DemGeneral/DemHeaderFileInclusion to specify a header file which declares this function.
            container DemDebounceTimeBase [0..1]  # Debounce TimeBase | Time based debouncing will use a timer started in either passed or failed direction with an unqualified result. The timer is not restarted in case it is already running, unless a direction change is detected - e.g. after a PrePassed result the next PrePassed result will not restart the timer, a following PreFailed will stop the passed timer and start the failed timer. Timer supervision incurs a substantial runtime and RAM overhead compared to counter based denouncing and should be used sparingly. The debounce value is mapped to a faultdetection count as such: If the Failed time is reached, FDC is 127. If no timer is running (and no qualified result has been reached), FDC is 0. If the Passed time is reached, FDC is -128. If the timer is currently running in either direction, the timer is linearly mapped to 1..126 respectively -1..-127.
              enumeration DemDebounceBehavior: {DEM_DEBOUNCE_FREEZE, DEM_DEBOUNCE_RESET}, set at post-build in variant post-build-loadable+post-build-selectable / pre-compile in variant pre-compile, default-value=DEM_DEBOUNCE_FREEZE  # This parameter defines how the event debounce algorithm will behave, if a related enable condition is not fulfilled or ControlDTCSetting of the related event is disabled. FREEZE: The debounce timer will pause while enable conditions are not active. To continue, report prepassed/prefailed after the enableconditions are fulfilled / ControlDTCSetting is enabled RESET: The FDC will revert to 0. See also (DemGeneral/DemResetDebounceBehavior)
              float DemDebounceTimeFailedThreshold: 0.001..3600, scope=ECU, set at post-build in variant post-build-loadable+post-build-selectable / pre-compile in variant pre-compile  # DebounceTime Failed Threshold | Time after a PreFailed report, after which a qualified FAILED result is generated. The AUTOSAR configuration standard is to use SI units, so in the EcuC file this parameter is stored as float value in seconds - the DaVinci Configurator 5 GUI will convert the value when using a diffenent unit.
              float DemDebounceTimeStorageThreshold [0..1]: 0.001..3600, set at post-build in variant post-build-loadable+post-build-selectable / pre-compile in variant pre-compile, origin=Vector Informatik  # DebounceTime Storage Threshold | If a monitor fails for this time, a FDC TRIP result is generated. This value has to be less than or equal to DemDebounceTimeFailedThreshold. This parameter is only relevant if data is stored at a time where the DTC fault detection counter passes a threshold lower than the failed threshold.
              float DemDebounceTimePassedThreshold: 0.001..3600, scope=ECU, set at post-build in variant post-build-loadable+post-build-selectable / pre-compile in variant pre-compile  # DebounceTime Passed Threshold | Time after a PrePassed report, after which a qualified PASSED result is generated. The AUTOSAR configuration standard is to use SI units, so in the EcuC file this parameter is stored as float value in seconds - the DaVinci Configurator 5 GUI will convert the value when using a diffenent unit.
              boolean DemDebounceContinuous: set at pre-compile, origin=Vector Informatik, default-value=false  # This parameter defines whether the event debounce algorithm will continue counting while enable conditions are not fulfilled / ControlDTCSetting is enabled. To prevent the event from qualifying after the enable conditions become enabled / ControlDTCSetting is disabled again, it is recommended to set DemDebounceBehavior to DEM_DEBOUNCE_RESET if this option is used. If DemDebounceBehavior is set to DEM_DEBOUNCE_FREEZE, an active debounce timer is paused, but the timer can be re-started while enable conditions are inactive.
          container DemIndicatorAttribute [0..255]  # This container maps the event to a list of indicators which can be enabled due to the event failing.
            enumeration DemIndicatorBehaviour: {DEM_INDICATOR_BLINKING, DEM_INDICATOR_BLINK_CONT, DEM_INDICATOR_CONTINUOUS, DEM_INDICATOR_FAST_FLASH, DEM_INDICATOR_SLOW_FLASH}, scope=ECU, set at post-build in variant post-build-loadable+post-build-selectable / pre-compile in variant pre-compile, default-value=DEM_INDICATOR_CONTINUOUS  # Select how the referenced indicator will react on this event (Blink, continuous light, application decides)
            integer DemIndicatorFailureCycleCounterThreshold [0..1]: 0..255, scope=ECU, set at pre-compile  # Indicator FailureCycle Counter Threshold | Number of continuous failed cycles until the indicator is enabled. This parameter is only valid if DemIndicatorFailureCycleSource is set to INDICATOR, so this parameter is effectively not supported. All DTCs, that are in the same MIL Group, must have the same threshold value (refer to parameter /Dem/DemGeneral/DemMILGroup).
            enumeration DemIndicatorFailureCycleSource: {DEM_FAILURE_CYCLE_EVENT, DEM_FAILURE_CYCLE_INDICATOR}, scope=ECU, set at pre-compile, default-value=DEM_FAILURE_CYCLE_EVENT  # Indicator FailureCycle Source | Select if the indicator is enabled as defined by the event status, or if the indicator requires a different set of event status bits to determine indicator state. This feature is required if an indicator is not enabled together with the event confirmation, but e.g. uses a different cycle or confirmation threshold. This parameter is currently not supported and is assumed to be set to 'DEM_FAILURE_CYCLE_EVENT'
            integer DemIndicatorHealingCycleCounterThreshold: 0..255, scope=ECU, set at post-build in variant post-build-loadable+post-build-selectable / pre-compile in variant pre-compile, default-value=3  # Indicator HealingCycle Counter Threshold | Defines the number of consecutive cycles in which the event has been tested passed, and not tested failed until this indicator heals. Currently it is only supported to set the same value for each indicator attached to this event.
            reference DemIndicatorFailureCycleRef [0..1]: scope=ECU, set at pre-compile, destination=DemOperationCycle  # Indicator FailureCycle Ref | Set the DemOperationCycle as base of the failure counting used to confirm the indicator. This parameter is only valid if DemIndicatorFailureCycleSource is set to INDICATOR.
            reference DemIndicatorHealingCycleRef: scope=ECU, set at pre-compile, destination=DemOperationCycle  # Indicator HealingCycle Ref | Set the DemOperationCycle as base of the healing counting used to heal the indicator. This parameter is not supported. Currently the value of DemEventClass/DemOperationCycleRef is used to heal indicators. Use that setting here too, to get a consistent configuration.
            reference DemIndicatorRef [0..1]: scope=ECU, set at post-build in variant post-build-loadable+post-build-selectable / pre-compile in variant pre-compile, destination=DemIndicator  # Reference to the used indicator.
      container DemJ1939NodeAddress [0..255]  # Contains the parameters for the support of a logical J1939 node (identified by an ECU address).
        symbolic name reference DemJ1939NmNodeRef [1..255]: scope=ECU, set at pre-compile, destination=J1939NmNode  # Reference to the corresponding J1939Nm node.
      container DemPidClass [0..255]  # Only relevant for OBD II. These containers represent the different PIDs stored in the single global OBD relevant freeze frame. Each PID consists of one or several data elements.
        integer DemPidIdentifier: 0..255, scope=ECU, set at pre-compile  # PID Identifier | PID Identifier as requested in Mode $02
        container DemPidDataElement [1..255]: requires-index=true  # PID DataElement | These containers are used to reference the different data elements contained in the specific PID.
          reference DemPidDataClassRef: scope=ECU, set at pre-compile, origin=Vector Informatik, destination=DemDataClass  # PID Data Class Ref | This reference contains the link to a data element class.
    container DemGeneral  # This container groups the constant configuration options, e.g. options that can not have different values in multiple configurations.
      enumeration DemAgingCycleCounterProcessing: {DEM_PROCESS_AGINGCTR_EXTERN, DEM_PROCESS_AGINGCTR_INTERN}, scope=ECU, set at pre-compile, default-value=DEM_PROCESS_AGINGCTR_INTERN  # AgingCycle Counter Processing | This parameter is obsolete and ignored, since no DemAgingCycle is supported. The same functionality can be achieved with operation cycles.
      boolean DemAgingRequieresTestedCycle: scope=ECU, set at pre-compile, default-value=false  # Defines if the aging cycle counter is processed every aging cycles or if only tested aging cycle are considered. (Not supported, please use DemGeneral/DemAgingBehavior instead)
      enumeration DemAvailabilitySupport: {DEM_EVENT_AVAILABILITY, DEM_NO_AVAILABILITY}, set at pre-compile, default-value=DEM_NO_AVAILABILITY  # This configuration switch defines, whether support for runtime configuration of the availability of events is enabled or not. If enabled, a corresponding API for switching availability of events at runtime is provided.
      boolean DemAvailabilityStorage: set at pre-compile, origin=Vector Informatik, default-value=false  # This configuration switch defines, whether runtime changes of the event's availability are persisted in NVRAM. If this option is disabled, changing the event availability is not persisted and API Dem_SetEventAvailable() will work as described in the Autosar SWS. When activating this feature, the configuration needs an additional NV-RAM block with DemNvRamBlockIdType "DEM_NVBLOCK_AVAILABILITY". The referenced NV block must be configured to hold the configured number of DemEventParameter containers + 1, divided by 8, fraction rounded up to integer. Enabling this option will prevent API Dem_SetEventAvailable() from working before Dem_Init(), as the NV data must be restored first. If this option is enabled, you also need DemGeneral/DemAvailabilitySupport == TRUE - otherwise the availability is not persisted in NVRAM.
      integer DemBswErrorBufferSize: 0..255, scope=ECU, set at pre-compile, default-value=0  # BswError Buffer Size | Dem processing queue size. The Dem will process qualified events (Failed/Passed) during the next task cycle. This value specifies how many events can be queued. When this queue overflows you will not lose reports, but the surplus events are not processed in reporting order. Also run-time is greately increased as surplus events need to be searched for the pending event change. A sufficient queue size can not be deduced from the Dem configuration, you need to analyze how your system reports events: set the size to the maximum amount of monitors that may report a qualified result (e.g. finish debouncing) during a single task cycle of the Dem. With queue overflow the run time of the Dem_MainFunction can spike, so you need to verify its run-time does not exceed your system limit (e.g. causes a task overflow) when the maximum amount of your monitors qualify at the same time.
      enumeration DemClearDTCBehavior: {DEM_CLRRESP_NONVOLATILE_FINISH, DEM_CLRRESP_NONVOLATILE_TRIGGER, DEM_CLRRESP_VOLATILE}, scope=ECU, set at pre-compile, default-value=DEM_CLRRESP_VOLATILE  # ClearDTC Behavior | Select the point in time a clear DTC request will result in a positive response from the Dcm. VOLATILE: The Dem will clear all DTCs in RAM before the API Dem_ClearDTC returns a final result to the Dcm. If power is cut right after that and your ECU does not allow for a controled shut down in that case, DTCs will still be visible after the ECU restarts. NONVOLATILE_TRIGGER: ClearDTC will return a final result after the NvM has been informed about the modification. This setting is not supported by this implementation. NONVOLATILE_FINISH: ClearDTC will return a final result only after the NvM has finished persisting the cleared state of DTCs. Depending on your NV system this can result in several seconds of NRC $78 - response pending. On the upside, if power is cut after the positive response, all DTCs remain cleared.
      enumeration DemClearDTCLimitation: {DEM_ALL_SUPPORTED_DTCS, DEM_ONLY_CLEAR_ALL_DTCS, DEM_ONLY_CLEAR_OBDII_AND_ALL_DTCS, DEM_ONLY_CLEAR_SINGLE_AND_ALL_DTCS, DEM_ONLY_CLEAR_WWHOBD_AND_ALL_DTCS}, scope=ECU, set at pre-compile, default-value=DEM_ALL_SUPPORTED_DTCS  # Defines the supported Dem_{...}ClearDTC API scope. ALL_SUPPORTED_DTCS: The API accepts all supported DTC values, as well as all DTC values which are configured in DemGroupDTCs and DEM_DTC_GROUP_ALL_DTCS (default). ONLY_CLEAR_ALL_DTCS: The API accepts ClearAllDTCs only (DTC Group 0xFFFFFF). ONLY_CLEAR_OBDII_AND_ALL_DTCS: The API accepts ClearAllDTCs only (DTC Groups 0x000000, 0xFFFFFF). ONLY_CLEAR_SINGLE_AND_ALL_DTCS: The API accepts DTC numbers and ClearAllDTCs (DTC Group, 0xFFFFFF). ONLY_CLEAR_WWHOBD_AND_ALL_DTCS: The API accepts ClearAllDTCs only (DTC Groups 0xFFFF33, 0xFFFFFF).
      enumeration DemDataElementDefaultEndianness: {BIG_ENDIAN, LITTLE_ENDIAN, OPAQUE}, set at pre-compile, default-value=LITTLE_ENDIAN  # Defines the default endianness of the data belonging to a data element which is applicable if the DemExternalSRDataElementClass does not define a endianness. (not supported)
      boolean DemDebounceCounterBasedSupport: scope=ECU, set at pre-compile, default-value=true  # Debounce CounterBased Support | This configuration switch defines, whether support for counter based debouncing is enabled or not (see DemConfigSet/DemEventParameter/DemEventClass/DemDebounceAlgorithmClass/DemDebounceCounterBased). If events are configured to use counter based debouncing, this option must be enabled.
      boolean DemDebounceTimeBasedSupport: scope=ECU, set at pre-compile, default-value=false  # Debounce TimeBased Support | This configuration switch defines, whether support for time based debouncing is enabled or not (see DemConfigSet/DemEventParameter/DemEventClass/DemDebounceAlgorithmClass/DemDebounceTimeBase). If events are configured to use timer based debouncing, this option must be enabled.
      boolean DemDevErrorDetect: set at pre-compile, default-value=true  # Development Error Detect | Activate/Deactivate the Development Error Detection and Notification. If this option is enabled, integration errors are reported to the DET module (e.g. calling APIs with invalid arguments that would cause a malfunction of the Dem module). In a production system this option can be disabled as all code should be tested to correctly use the Dem API.
      integer DemDtcStatusAvailabilityMask: 0..255, scope=ECU, set at pre-compile, default-value=255  # DTC StatusAvailabilityMask | Mask for the supported DTC status bits of the Dem. This mask is used by UDS service 0x19. Internally, all status bits are supported as required by the Dem specification. This internal status byte is used e.g. for internal event notification callout functions. Externally, all status bits are ANDed with this mask, e.g. for diagnostic services like 0x19 or DTC status change notifications. This mask is also reported as status availability mask in the respective 0x19 subfunctions.
      boolean DemEnableConditionSupport: scope=ECU, set at pre-compile, default-value=false  # EnableCondition Support | This configuration switch defines, whether support for enable conditions is enabled or not. If enable conditions are set up for events (DemConfigSet/DemEventParameter/DemEventClass/DemEnableConditionGroupRef) this option must be enabled.
      enumeration DemEventCombinationSupport: {DEM_EVCOMB_DISABLED, DEM_EVCOMB_TYPE1, DEM_EVCOMB_TYPE2}, scope=ECU, set at pre-compile, default-value=DEM_EVCOMB_DISABLED  # Merge several events to one specific DTC and a combined UDS DTC status byte. DISABLED: No event combination is supported. TYPE1: Multiple events can be combined to a single DTC. The DTC defines the data stored. TYPE2: Multiple events can be combined to a single DTC. Each event defines the data stored. Data of each stored event of the requested DTC is combined and reported to the Dcm.
      enumeration DemEventDisplacementStrategy: {DEM_DISPLACEMENT_FULL, DEM_DISPLACEMENT_NONE, DEM_DISPLACEMENT_PRIO_OCC, DEM_DISPLACEMENT_LEGACY_403}, scope=ECU, set at pre-compile, default-value=DEM_DISPLACEMENT_LEGACY_403  # This configuration switch is back-ported from AR4.1.1 and specifies the event displacement when the event memory is currently filled completely. It replaces the AR4.0.3 parameter DemEventDisplacementSupport. Please note, the DTC selected by the displacement algorithm is only displaced if it is a better match than the new DTC that has to be entered into the memory. If the new DTC is the better match, or no matching DTCs are found in the event memory, the fall-back strategy DemEventDisplacementFallbackStrategy is implemented. NONE: No displacement. If the event memory is filled, a new event will always be displaced immediately. Please note, the only supported fall-back strategy for this case is DISCARD_NEW_EVENT. PRIO_OCC: Displacement is active. If the event memory is filled, the DTC(s) with lowest priority are selected. If multiple DTCs share this lowest priority, the oldest is selected. FULL: Displacement is active. If the event memory is filled, the DTC(s) with the lowest priority are selected. If multiple DTCs share this lowest priority, the oldest passive DTC is selected. If no passive DTCs are among the lowest priority list, the oldest active, but untested DTC is selected. LEGACY_403: Vector extension that corresponds to the displacement behavior defined in Autosar 4.0.3. If the event memory is filled, the DTC(s) with the lowest priority are selected. If multiple DTCs share this lowest priority, the oldest passive DTC is selected.
      enumeration DemEventMemoryEntryStorageTrigger: {DEM_STORAGE_ON_CONFIRMED, DEM_STORAGE_ON_FDC_THRESHOLD, DEM_STORAGE_ON_PENDING, DEM_STORAGE_ON_TEST_FAILED}, set at pre-compile, default-value=DEM_STORAGE_ON_TEST_FAILED  # EventMemory Entry Storage Trigger | This parameter describes the trigger for the allocation of an event memory entry, i.e. the point of time when the corresponding DTC is initially stored in the referenced event memory. CONFIRMED: An event entry is allocated once its corresponding DTC confirms (bit3 transitions 0->1). FDC_THRESHOLD: An event entry is allocated once the fault detection counter of its corresponding DTC exceeds its DemDebounceCounterPreconfirmedThreshold. PENDING: An event entry is allocated once its corresponding DTC gets pending (bit2 transitions 0->1). TEST_FAILED: An event entry is allocated once its corresponding DTC fails (bit0 transitions 0->1). Restriction: If FDC_THRESHOLD is selected, monitor internal debouncing cannot be used to store event data at pre-failed.
      enumeration DemExtendedDataCapture [0..1]: {DEM_TRIGGER_EVENT_MEMORY_STORAGE, DEM_TRIGGER_TESTFAILED}, scope=ECU, set at pre-compile, default-value=DEM_TRIGGER_EVENT_MEMORY_STORAGE  # ExtendedData Capture | This parameter defines the point in time, when the extended data collection is done. TESTFAILED: The data is collected directly in the context of the SetEventStatus call. This option is not supported. MEMORY_STORAGE: The data is collected during the next Dem task cycle, in case a memory entry can be created for the DTC (see DemEventDisplacementSupport)
      enumeration DemExtendedDataVisibility [0..1]: {DEM_VISIBILITY_ALL_DTC, DEM_VISIBILITY_STOREDONLY}, set at pre-compile, origin=Vector Informatik, default-value=DEM_VISIBILITY_ALL_DTC  # ExtendedData Visibility | This parameter defines the point in time when extended data will be reported in diagnostic response messages. This parameter affects extended data records that consist solely of statistical data which is by its nature at any time available, see DemInternalDataElement. Using this parameter allows to reduce visibility of such extended data records until the DTC is actually stored. ALL_DTC: The data is reported independent of an existing memory entry. STOREDONLY: The data is reported only if a memory entry exists for the reported DTC. Example: The current fault detection counter exists at any time for all DTCs. If this parameter is set to ALL_DTC, service 19 06 will report the value of the FDC for DTCs that are not currently stored. If this parameter is set to STOREDONLY, Dcm will instead send a positive response without any content for those DTCs.
      enumeration DemFreezeFrameCapture [0..1]: {DEM_TRIGGER_EVENT_MEMORY_STORAGE, DEM_TRIGGER_TESTFAILED}, scope=ECU, set at pre-compile, default-value=DEM_TRIGGER_EVENT_MEMORY_STORAGE  # FreezeFrame Capture | This parameter defines the point in time, when the freeze frame data collection is done. TESTFAILED: The data is collected directly in the context of the SetEventStatus call. This option is not supported. MEMORY_STORAGE: The data is collected during the next Dem task cycle, in case a memory entry can be created for the DTC (see DemEventDisplacementSupport).
      boolean DemGeneralInterfaceSupport: scope=ECU, set at pre-compile, default-value=false  # The interfaces GeneralEvtInfo, GeneralCallbackEventDataChanged and GeneralCallbackEventStatusChange are provided if DemGeneralInterfaceSupport is equal to true. (Not supported, please use - DemGeneral/DemGeneralDiagnosticInfoSupport, - DemGeneral/DemTriggerGlobalEventDataChangedCallback, - DemGeneral/DemTriggerGlobalEventStatusChangedCallback instead.)
      string DemHeaderFileInclusion [0..*]: scope=ECU, set at pre-compile  # HeaderFile Inclusion | Name of the header file(s) to be included by the Dem module containing the used C-callback declarations. The different callout configurations allow to specify a C-Callback instead of a port interface. If you choose so, you need to add a header file here with the appropriate declaration of the function. see DemConfigSet/DemDTCClass/DemCallbackInitMForF/DemCallbackInitMForFFnc, see DemConfigSet/DemEventParameter/DemCallbackClearEventAllowed/DemCallbackClearEventAllowedFnc, see DemConfigSet/DemEventParameter/DemCallbackEventDataChanged/DemCallbackEventDataChangedFnc, see DemConfigSet/DemEventParameter/DemCallbackEventStatusChanged/DemCallbackEventStatusChangedFnc, see DemConfigSet/DemEventParameter/DemCallbackInitMForE/DemCallbackInitMForEFnc, see DemConfigSet/DemEventParameter/DemEventClass/DemDebounceAlgorithmClass/DemDebounceMonitorInternal/DemCallbackGetFDC/DemCallbackGetFDCFnc, see DemGeneral/DemCallbackDTCStatusChanged/DemCallbackDTCStatusChangedFnc, see DemGeneral/DemDataClass/DemDataElementReadFnc.
      integer DemImmediateNvStorageLimit [0..1]: 1..255, scope=ECU, set at pre-compile  # ImmediateNvStorage Limit | This parameter defines a limit for the number of immediate write accesses to the non-volatile memory. This option is only relevant if immediate NV storage is used for DTCs (see DemGeneral/DemImmediateNvStorageSupport and DemConfigSet/DemDTCClass/DemImmediateNvStorage). If configured the non-volatile immediate storages for a DTC is only triggered until OccurenceCounter reaches the configured value. Note that the number of immediate write accesses for a DTC can be higher than the configured value (for detailed description see Technical Reference).
      integer DemMaxNumberEventEntryMirror: 0..255, scope=ECU, set at pre-compile, default-value=0  # Maximum number of events which can be stored in the mirror memory. The mirror memory is currently not supported, so this value should be set to 0.
      integer DemMaxNumberEventEntryOBDFreezeFrame: 0..255, set at pre-compile, origin=Vector Informatik, default-value=0  # Max Number Event Entry OBD FreezeFrame | Maximum number of events which can concurrently store an OBD II Freeze Frame. With WWH OBD each memory entry stores an OBD Freeze Frame, so this parameter is ignored. OBD II Freeze Frame memory is only available if OBD II is supported.
      integer DemMaxNumberEventEntryPermanent: 0..255, scope=ECU, set at pre-compile, default-value=0  # Maximum number of events which can be stored in the permanent memory. Permanent memory is only available in case of OBD II and MIL support (see DemOBDSupport, DemOBDLegislation and DemMILIndicatorRef).
      integer DemMaxNumberEventEntryPrimary: 1..255, scope=ECU, set at pre-compile, default-value=8  # Maximum number of events which can be stored in the primary memory. Primary memory is the 'standard' memory reported by the standard UDS $19 services.
      integer DemMaxNumberEventEntrySecondary: 0..255, scope=ECU, set at pre-compile, default-value=0  # Maximum number of events which can be stored in the secondary memory. In context of the UDS Services secondary memory is an 'User Defined Memory'.
      integer DemMaxNumberPrestoredFF: 0..255, scope=ECU, set at pre-compile, default-value=0  # Defines the maximum number for prestored freeze frames.
      integer DemMaxNumberTimeSeriesSnapshots: 0..32, set at pre-compile, origin=Vector Informatik, default-value=0  # (not supported)
      enumeration DemOBDSupport: {DEM_OBD_DEP_SEC_ECU, DEM_OBD_MASTER_ECU, DEM_OBD_NO_OBD_SUPPORT, DEM_OBD_PRIMARY_ECU}, scope=ECU, set at pre-compile in variant post-build-loadable+pre-compile / post-build in variant post-build-selectable, default-value=DEM_OBD_NO_OBD_SUPPORT  # DEM_OBD_NO_OBD_SUPPORT: OBD support is disabled, the DEM operates in UDS mode. DEP_SEC_ECU: OBD support is enabled, the DEM operates in secondary/dependent ECU mode. (not supported) PRIMARY_ECU: OBD support is enabled, the DEM operates in primary ECU mode. MASTER_ECU: OBD support is enabled, the DEM operates in master ECU mode. (not supported) If OBD support is NOT disabled, use parameter Dem/DemGeneral/DemGeneralOBD/DemOBDLegislation to choose either OBD II or WWH-OBD support. If OBD support is disabled, all configured OBD relevant parameters (e.g. the parameters in Dem/DemGeneral/DemGeneralOBD) are ignored.
      enumeration DemOccurrenceCounterProcessing: {DEM_PROCESS_OCCCTR_CDTC, DEM_PROCESS_OCCCTR_TF}, scope=ECU, set at pre-compile, default-value=DEM_PROCESS_OCCCTR_TF  # OccurrenceCounter Processing | The occurrence counter is incremented each time the event status transitions from 'passed' to 'failed'. TF (TestFailed) : The counter is incremented each time. CDTC (Confirmed): The counter is incremented only after the event is confirmed - Effectively the counter starts incrementing after N cycles (see DemConfigSet/DemEventParameter/DemEventClass/DemEventFailureCycleCounterThreshold).
      enumeration DemOperationCycleProcessing [0..1]: {DEM_PROCESS_OPCYC_COUNTER, DEM_PROCESS_OPCYC_STATE}, scope=ECU, set at pre-compile, default-value=DEM_PROCESS_OPCYC_STATE  # OperationCycle Processing | This parameter is obsolete since the option DEM_PROCESS_OPCYC_COUNTER is not longer supported by AUTOSAR. OPCYC_STATE: Cycles are reported by SetOperationCycleState(Start/Stop) and the Dem counts the cycles internally. OPCYC_COUNTER: Cycles are counted externally. The current count is reported to the Dem by SetOperationCycleCounter. Only OPCYC_STATE is supported at the moment.
      boolean DemOperationCycleStatusStorage: scope=ECU, set at pre-compile, default-value=false  # OperationCycle Status Storage | Defines if the operation cycle state is available over the power cycle (stored non-volatile) or not. If this value is disabled, operation cycles are considered 'stopped' at the time of Dem_Init. Cycles must be started first to allow monitor reports to be processed, but starting a cycle involves event status changes. So if you have operation cycles that are longer than the power cycle of your ECU, you need to enable this option. This parameter is only valid if DemOperationCycleProcessing is set to OPCYC_STATE.
      boolean DemPTOSupport: scope=ECU, set at pre-compile, default-value=false  # This configuration switch defines, whether PTO support (and therefore PID $1E support) is enabled or not. This parameter is not supported.
      boolean DemResetConfirmedBitOnOverflow: set at pre-compile, default-value=true  # Status Bit ConfirmedDTC Reset on Overflow | This configuration switch defines, whether the ConfirmedDTC UDS status bit is reset or not when an event memory entry will be displaced. If enabled, a DTC will immediately 'age', i.e. lose its ConfirmedDTC bit if it is displaced. If disabled, a DTC will stop aging on displacement. Its ConfirmedDTC status bit will stay active until the DTC can allocate a new aging counter, at which point the aging process will start from the beginning. Alternatively, ClearDTC will also clear such a DTC.
      enumeration DemStatusBitHandlingTestFailedSinceLastClear: {DEM_STATUS_BIT_AGING_AND_DISPLACEMENT, DEM_STATUS_BIT_NORMAL, DEM_STATUS_BIT_AGING}, scope=ECU, set at pre-compile, default-value=DEM_STATUS_BIT_NORMAL  # Status Bit TestFailedSinceLastClear Handling | This configuration switch defines whether the aging and displacement mechanism shall be applied to the "TestFailedSinceLastClear" status bits. AGING_AND_DISPLACEMENT: The status bit 'TestFailedSinceLastClear' is only set if an event can be enteren into its event memory. (In case the event is not mapped to any destination it is never set!) The status bit is reset due to aging, clearing and displacement of the memory entry. NORMAL: The status bit 'TestFailedSinceLastClear' set for all events, irrespective of successful allocation of an event memory entry. It is reset to 0 only when the event is cleared. AGING: The status bit 'TestFailedSinceLastClear' set for all events, irrespective of successful allocation of an event memory entry. It is reset to 0 when the event ages, or is cleared.
      boolean DemStatusBitStorageTestFailed: scope=ECU, set at pre-compile, default-value=true  # Status Bit TestFailed Storage | Activate/Deactivate the permanent storage of the "TestFailed" status bits. If disabled, the TestFailed bit is reset during initilization. Please note that this does not suffice to start aging of the event.
      boolean DemStorageConditionSupport: scope=ECU, set at pre-compile, default-value=false  # StorageCondition Support | This configuration switch defines, whether support for storage conditions is enabled or not. If storage conditions are set up for events (DemConfigSet/DemEventParameter/DemEventClass/DemStorageConditionGroupRef) this option must be enabled.
      enumeration DemSuppressionSupport: {DEM_DTC_SUPPRESSION, DEM_EVENT_AND_DTC_SUPPRESSION, DEM_EVENT_SUPPRESSION, DEM_NO_SUPPRESSION}, set at pre-compile, default-value=DEM_NO_SUPPRESSION  # This configuration switch defines, whether support for suppression is enabled or not. According AUTOSAR 4.3, this DEM implementation only supports the suppression by DTC, not the suppression by Event. DTC_SUPPRESSION: Support suppression by DTC. EVENT_AND_DTC_SUPPRESSION: Support suppression by Event and DTC. Equivalent to DTC_SUPPRESSION, as suppression by Event is not supported. EVENT_SUPPRESSION: Support suppression by Event. Equivalent to NO_SUPPRESSION, as suppression by Event is not supported. NO_SUPPRESSION: Suppression is not supported.
      float DemTaskTime: 0.001..0.1, scope=ECU, set at pre-compile, origin=AUTOSAR_ECUC V1.0.0, default-value=0.01  # Allow to configure the time for the periodic cyclic task. This value is used to set up the Dem Service-Description and BSW scheduler. This time is also used as time base in case time based debouncing is supported (see DemDebounceTimeBasedSupport, DemConfigSet/DemEventParameter/DemEventClass/DemDebounceAlgorithmClass/DemDebounceTimeBase). The AUTOSAR configuration standard is to use SI units, so in the EcuC file this parameter is stored as float value in seconds - the DaVinci Configurator 5 GUI will convert the value when using a diffenent unit.
      boolean DemTriggerDcmReports: scope=ECU, set at pre-compile, default-value=false  # If enabled, the Dcm module is notified about DTC status changes in primary memory. Status changes caused by Dem_<...>ClearDTC do not trigger this callback. Notifications must be enabled using API Dem_DcmControlDTCStatusChangedNotification. For ASR4.0.3 compatible behavior, disable this option, and configure the Dcm trigger function in parameter 'DemCallbackDTCStatusChangedFnc'. This is required to implement RoE - OnDTCChange supervision, please refer to the Dcm configuration for details.
      boolean DemTriggerDltReports: scope=ECU, set at pre-compile, default-value=false  # Activate/Deactivate the notification to the Diagnostic Log and Trace.
      boolean DemTriggerFiMReports: scope=ECU, set at pre-compile, default-value=false  # Trigger FiM Reports | Activate/Deactivate the notification to the Function Inhibition Manager. This option must be enabled if the FiM requires monitor status change notification (see FiM/FiMGeneral/FiMEventUpdateTriggeredByDem). It enables MonitorStatusChange and FiM_DemInit according AR4.3.0.
      boolean DemTriggerFiMReportsExtended: scope=ECU, set at pre-compile, origin=Vector Informatik, default-value=false  # Trigger FiM Reports (Extended) | Activate/Deactivate the notification to the Function Inhibition Manager. This option must be enabled if the FiM requires event status change notification. It is used for Vector FiM's OBD extension, and also provides backward compatibility for older FiM version (ASR 4.2 and older)
      boolean DemTriggerMonitorInitBeforeClearOk: scope=ECU, set at pre-compile, default-value=true  # Trigger MonitorInit Before Clear Ok | Defines if the monitor re-initialization has to be triggered before or after the Dem module returns DEM_CLEAR_OK. This option is not supported. InitMonitor callbacks are always triggered during the clear operation, and have completed before the final result is returned to the Dcm.
      boolean DemTriggerMonitorInitForEnableConditions: scope=ECU, set at pre-compile, origin=Vector Informatik, default-value=false  # Trigger MonitorInit For Enable Conditions | Defines if the monitor re-initialization is triggered when enable conditions re-activate a disabled monitor This option requires AR4.1.2 API compatibility.
      enumeration DemTypeOfDTCSupported: {DEM_DTC_TRANSLATION_ISO11992_4, DEM_DTC_TRANSLATION_ISO14229_1, DEM_DTC_TRANSLATION_ISO15031_6, DEM_DTC_TRANSLATION_SAEJ1939_73, DEM_DTC_TRANSLATION_J2012DA_FORMAT_04}, scope=ECU, set at pre-compile, default-value=DEM_DTC_TRANSLATION_ISO14229_1  # This parameter defines the format returned by Dem_GetTranslationType and does not relate to/influence the supported Dem functionality. Its value is returned by some of the $19 services. ISO11992_4: ISO11992-4 DTC format. ISO14229_1: ISO14229-1 DTC format. ISO15031_6: ISO15031-6 DTC format/SAE J2012-DA_DTCFormat_00 DTC format. SAEJ1939_73: SAEJ1939-73 DTC format. J2012DA_FORMAT_04: SAE_J2012-DA_DTCFormat_04 DTC format.
      enumeration DemTypeOfFreezeFrameRecordNumeration: {DEM_FF_RECNUM_CALCULATED, DEM_FF_RECNUM_CONFIGURED}, scope=ECU, set at pre-compile, default-value=DEM_FF_RECNUM_CALCULATED  # Type Of FreezeFrameRecord Numeration | This parameter defines the type of assigning snapshot record numbers. CALCULATED: The snapshot records are enumerated from one (1) up to DemConfigSet/DemEventParameter/DemMaxNumberFreezeFrameRecords for each event. Once a event memory entry is created at event confirmation time, additional snapshots are stored at each FAILED transition. CONFIGURED: The snapshot record numbers are taken from DemConfigSet/DemEventParameter/DemFreezeFrameRecNumClassRef. Storage triggers and update conditions can be configured.
      boolean DemVersionInfoApi: set at pre-compile, default-value=false  # Activate/Deactivate the version information API.
      enumeration DemBswApiVersion: {DEM_BSW_API_4_XX_XX, DEM_BSW_API_3_XX_XX}, set at pre-compile, origin=Vector Informatik, default-value=DEM_BSW_API_4_XX_XX  # Specifies the AUTOSAR version of the integrated BSW stack API that Dem shall be able to interact with. This setting will modify the symbolic names, that are offered by the DEM and used by other BSW modules. See the additional parameters for the reverse (the DEM uses a symbolic name that is offered by another module): DemGeneral/DemBswApiVersionNvM, DemGeneral/DemBswApiVersionFiM. API_4_XX_XX: The DEM offers only symbolic names according the definition of AUTOSAR 4 for interaction with other BSW modules. API_3_XX_XX: The DEM creates additional symbolic names according the definition of AUTOSAR 3 for interaction with other BSW modules: The DEM itself will offer additional symbolic names (that may be used by AUTOSAR 3 BSW modules) for: - DemAgingCycle identifier - DemEnableConditionId - DemEventId - DemGroupDTCs - DemIndicatorID - DemMILGroup identifier - DemOperationCycle identifier - DemStorageConditionId
      enumeration DemBswApiVersionNvM: {DEM_BSW_API_4_XX_XX, DEM_BSW_API_3_XX_XX}, set at pre-compile, origin=Vector Informatik, default-value=DEM_BSW_API_4_XX_XX  # Bsw Api Version NvM | Specifies the AUTOSAR version of the integrated NvM API that Dem shall be able to interact with. Switches Dem interaction to the corresponding AUTOSAR version of NvM (DemNvRamBlockIdRef->NvMBlockDescriptor). API_4_XX_XX: The DEM uses symbolic names according the definition of AUTOSAR 4 for interaction with the NvM module. This is the default. API_3_XX_XX: The DEM uses symbolic names according the definition of AUTOSAR 3 for interaction with the NvM module. Use this setting when the NvM offers its symbolic names only according the AUTOSAR 3 naming convention (for example AUTOSAR 3 "NvM_DemAdminDataBlock" vs. AUTOSAR 4 "NvMConf_NvMBlockDescriptor_DemAdminDataBlock").
      enumeration DemBswApiVersionFiM: {DEM_BSW_API_4_XX_XX, DEM_BSW_API_3_XX_XX}, set at pre-compile, origin=Vector Informatik, default-value=DEM_BSW_API_4_XX_XX  # Bsw Api Version FiM | Specifies the AUTOSAR version of the integrated FiM API that Dem shall be able to interact with. Switches Dem interaction to the corresponding AUTOSAR version of FiM (DemFunctionIdRef->FiMFID, DemSecondaryFunctionIdRef->FiMFID, DemIgnitionCycleFunctionIdRef->FiMFID). API_4_XX_XX: The DEM uses symbolic names according the definition of AUTOSAR 4 for interaction with the FiM module. This is the default. API_3_XX_XX: The DEM uses symbolic names according the definition of AUTOSAR 3 for interaction with the FiM module. Use this setting when the FiM offers its symbolic names only according the AUTOSAR 3 naming convention (for example AUTOSAR 3 "FiM_FiMFID_001" vs. AUTOSAR 4 "FiMConf_FiMFID_FiMFID_001").
      enumeration DemAgingAfterHealing: {DEM_AGING_WHILE_HEALING, DEM_AGING_AFTER_HEALING, DEM_AGING_AFTER_HEALING_ALL_DTC}, set at pre-compile, origin=Vector Informatik, default-value=DEM_AGING_WHILE_HEALING  # This parameter selects how aging and healing interact. DEM_AGING_WHILE_HEALING will allow events that meet the configured aging criteria (DemAgingBehavior) to start aging. In theory, this could mean that events can age while they still request an indicator. Use well defined operation cycles to avoid this effect, i.e. aging cycles should not complete faster than operation cycles. DEM_AGING_AFTER_HEALING will allow aging only after the event has finished healing, i.e. after resetting the warningIndicatorRequested status bit. This setting only has an effect on events with an indicators. This is the behavior defined by the AUTOSAR standard. DEM_AGING_AFTER_HEALING_ALL_DTC behaves like DEM_AGING_AFTER_HEALING, but extends the healing process to events without indicator. I.e. even though the events do not set the WIR bit, they will only start aging after they would have reset it. This way, both events with and without indicators age after the same amount of cycles. Events configured to use the MIL will always behave according to DEM_AGING_AFTER_HEALING.
      enumeration DemAgingBehavior: {DEM_AGING_TYPE_1, DEM_AGING_TYPE_2, DEM_AGING_TYPE_3, DEM_AGING_TYPE_4, DEM_AGING_TYPE_5, DEM_AGING_TYPE_6}, set at pre-compile, origin=Vector Informatik, default-value=DEM_AGING_TYPE_1  # This parameter selects the algorithm for the aging of the events. AGING_TYPE_1: Initial trigger to start the aging is the test result PASSED. The aging counter is incremented at the end of the aging cycle. Events with DemAgingCycleCounterThreshold == 0 will age with the PASSED test result. AGING_TYPE_2: Initial trigger to start the aging is the end of operation cycle if the event was tested PASSED and was never tested FAILED in this cycle. The aging counter is incremented at the end of the aging cycle. Events with DemAgingCycleCounterThreshold == 0 will age at the end of the operation cycle if the event was tested PASSED and was not tested FAILED in this cycle. AGING_TYPE_3: Initial trigger to start the aging is the end of operation cycle if the event was tested PASSED and was never tested FAILED in this cycle. The aging counter is incremented at the end of the aging cycle if the event was tested PASSED and was never tested FAILED in this cycle. Events with DemAgingCycleCounterThreshold == 0 will age at the end of the operation cycle if the event was tested PASSED and was not tested FAILED in this cycle. AGING_TYPE_4: Initial trigger to start the aging is the test result PASSED. The aging counter is incremented at the end of the aging cycle if the event was tested PASSED. Events with DemAgingCycleCounterThreshold == 0 will age with the PASSED test result. AGING_TYPE_5: Initial trigger to start the aging is the end of operation cycle if the event was tested PASSED and was never tested FAILED in this cycle. The aging counter is incremented at the end of the aging cycle if the event was tested PASSED and was never tested FAILED in this cycle. Events with DemAgingCycleCounterThreshold == 0 will age with the PASSED test result, if the event was not tested FAILED in this cycle. AGING_TYPE_6: Initial trigger to start the aging is the test result PASSED, if the event was never tested FAILED in this cycle. The aging counter is incremented at the end of the aging cycle if the event was tested PASSED and was never tested FAILED in this cycle. Events with DemAgingCycleCounterThreshold == 0 will age with the PASSED test result.
      enumeration DemAgingCounterBehavior: {DEM_AGING_COUNT_ALWAYS, DEM_AGING_COUNT_ONLY_AGEABLE}, set at pre-compile, origin=Vector Informatik, default-value=DEM_AGING_COUNT_ALWAYS  # Control whether an aging counter is incremented / decremented for events that do not support aging (see parameter DemAgingAllowed). DEM_AGING_COUNT_ALWAYS: The aging counter is incremented/decremented for every event. If an event does not support aging, incrementing aging counters latch at 255 and decrementing aging counters stop at 0. DEM_AGING_COUNT_ONLY_AGEABLE: The aging counter is incremented/decremented only for events supporting aging. If an event does not support aging, incrementing counters remain at 0, decrementing counters remain at the configured threshold value.
      enumeration DemAgingCounterReporting: {DEM_AGING_NORMAL_REPORTING, DEM_AGING_ZERO_AS_ONE_REPORTING}, set at pre-compile, origin=Vector Informatik, default-value=DEM_AGING_NORMAL_REPORTING  # This parameter changes how the aging counter is reported in an extended record. AGING_NORMAL_REPORTING: The counter is reported as defined by the internal data element (UPCOUNT/DOWNCOUNT) AGING_ZERO_AS_ONE_REPORTING: For upward counting, the counter value 0x00 is reported as value 0x01 in the cycle where aging is started. This has no effect on downward counting and on events with aging cycle counter threshold 0.
      boolean DemAgingRetainEnvironmentalData: set at pre-compile, origin=Vector Informatik, default-value=false  # If this option is enabled, environmental data stored with a DTC is not deleted on aging. This includes snapshot data and extended data records. The data is reported for UDS services as if the DTC was still confirmed, although Bit3 is not set anymore in the DTC status byte. Aged event entries will be treated as empty as far as displacment is concerned, even if DTC displacement is deactivated by DemEventDisplacementStategy. If this option is disabled, event memory entries including all stored data are cleared on aging. This setting corresponds to the behavior defined by AUTOSAR.
      integer DemClearDTCRuntimeLimit [0..1]: 1..255, set at pre-compile, origin=Vector Informatik  # ClearDTC Runtime Limit | If this parameter exists, ClearDTC will not clear more than this amount of DTCs at once. This parameter can be used to reduce the run time of the Dem_MainFunction during ClearDTC.
      integer DemCompiledConfigId [0..1]: 0..65535, set at post-build in variant post-build-loadable+post-build-selectable / pre-compile in variant pre-compile, origin=Vector Informatik, default-value=0  # Change this value to force the Dem to clear all NV data on next initialization (startup). This is useful if the flash eeprom emulation is not cleared during flashing of a new software version. When this parameter is missing, the value 0 is assumed.
      integer DemCompiledPostbuildCrc: 0..4294967295, set at post-build in variant post-build-loadable+post-build-selectable / pre-compile in variant pre-compile, origin=Vector Informatik, default-value=0  # This parameter contains a variant specific checksum (CRC) over all postbuiild-changeable configuration items. This value is internally used to detect changes in the configuration. The non-volatile stored data is always configuration specific. Reading the NvData with a different configuration will give a new interpretation to that binary data, that is usually wrong. So with configuration changes the DEM shall typically discard the previous NvData. In mode AUTOMATIC (see parameter DemCompiledPostbuildCrcMode) the DaVinci Configurator5 will automatically evaluate a checksum over the relevant data, that will differ between incompatible configurations. In mode MANUAL the user himself is responsible to use different values for incompatible configurations. Generally: a value here, that is different from the previous value (that was used when storing the non-volatile data) will cause the DEM to discard the previously stored NvData.
      enumeration DemCompiledPostbuildCrcMode: {DEM_POSTBUILD_CRC_AUTOMATIC, DEM_POSTBUILD_CRC_MANUAL}, set at post-build in variant post-build-loadable+post-build-selectable / pre-compile in variant pre-compile, origin=Vector Informatik, default-value=DEM_POSTBUILD_CRC_AUTOMATIC  # Switch the mode for the calculation of the variant specific checksum (CRC) over all postbuiild-changeable configuration items. See parameter DemCompiledPostbuildCrc. AUTOMATIC: the DaVinci Configurator5 calculates the checksum value MANUAL: the user defines the checksum - use this setting only when the NvData shall not be cleared with a configuration change. Take care to manually change the checksum when the stored non-volatile data becomes incompatible to the current configuration.
      boolean DemDcmSupport [0..1]: set at pre-compile, origin=Vector Informatik, default-value=true  # When this parameter is missing, the Dem assumes the Dcm being configured (that means you use a standard AUTOSAR stack). If the parameter exists with value FALSE there is no Dcm module in the system: the Dem doesn't offer the APIs defined in file "Dem_Dcm.h" any more, and it does not offer the Dcm port interfaces. Use this setting when your ECU doesn't implement UDS diagnostic services. A J1939Dcm in system will then still offer J1939 diagnostic services. If the parameter exists with value TRUE (or is missing) the standard Dem behaviour and APIs are available.
      float DemDebounceTimeLowResThreshold [0..1]: 0.15..3600, set at pre-compile, origin=Vector Informatik, default-value=5  # TimeBased Debouncing - LowRes Timer Threshold | Largest time duration (excl.) for using the high resolution timer. To reduce CPU load and reduce configuration code size, the feature Time Base Debounce can use 2 different timers: the high resolution timer will tick with the configured DemTaskTime (typ. 10ms), the additional low resolution timer will tick with 150ms. This configuration value defines the min. debounce time for an event to be handled by the low-res timer. Default: 5s Refer to configuration values DemDebounceTimeFailedThreshold and DemDebounceTimePassedThreshold of each event: - if both time values of an event are lower than the threshold (typ. 5s), the event's debounce is using the high-res timer with a jitter of DemTaskTime (typ. 10ms); - otherwise the debounce algorithms are using the low-res timer (with a jitter of 150ms) and a reduced CPU load. The AUTOSAR configuration standard is to use SI units, so in the EcuC file this parameter is stored as float value in seconds - the GUI will convert the value when using a diffenent unit.
      boolean DemEvMemOverflowIndicationSupport [0..1]: set at pre-compile, origin=Vector Informatik, default-value=true  # EventMemory Overflow Indication Support | Provide the Port-Interface EvMemOverflowIndication. If this parameter is disabled, the Dem will not provide the port interface or the C functions to read the overflow status of the event memories.
      enumeration DemEventDisplacementFallbackStrategy: {DEM_FALLBACK_DISCARD_NEW_EVENT, DEM_FALLBACK_DISPLACE_OLDEST_EVENT}, configuration-class-affection=affection-kind=PC-AFFECTS-LT-AND-PB, set at pre-compile, origin=Vector Informatik, default-value=DEM_FALLBACK_DISCARD_NEW_EVENT  # Fallback strategy for event displacement: DISCARD_NEW_EVENT: Standard behavior defined by AUTOSAR. In case no candidate for displacement is found, a new event is silently discarded. DISPLACE_OLDEST_EVENT: In case no better candidate for displacement can be found, the oldest event is displaced unconditionally. Note: Active OBD DTCs are not affected from this configuration.
      enumeration DemEventStorageTrigger [0..0]: {DEM_STORAGE_TRIGGER_CONFIRMED, DEM_STORAGE_TRIGGER_FAILED, DEM_STORAGE_TRIGGER_FDC}, set at pre-compile, origin=Vector Informatik, default-value=DEM_STORAGE_TRIGGER_FAILED  # EventStorage Trigger | Not supported any more, please use the AUTOSAR 4.1.2 compliant definition in /Dem/DemGeneral/DemEventMemoryEntryStorageTrigger. Define the trigger of the event storage. If an event triggers this condition, an event entry is created for it. CONFIRMED: An event entry is created once a DTC confirms (bit3 transitions 0->1). FAILED: An event entry is created once a DTC fails (bit0 transitions 0->1). FDC: An event entry is created once the fault detection counter of a DTC exceeds its DemDebounceCounterPreconfirmedThreshold. Restriction: If FDC is selected, monitor internal debouncing cannot be used to store event data at pre-Failed.
      function name DemGeneralCallbackMonitorStatusChangedFnc [0..1]: scope=ECU, set at pre-compile, origin=Vector Informatik  # General Callback MonitorStatus Changed Fnc | Function name of prototype "<Module>_DemTriggerOnMonitorStatus". If configured, the DEM will call this function with each MonitorStatus change of an event. The function's signature is: void NN_DemTriggerOnMonitorStatus( Dem_EventIdType EventId ); For FiM monitor status notification, use the configuration parameter DemGeneral/DemTriggerFiMReports.
      boolean DemGeneralDiagnosticInfoSupport: set at pre-compile, origin=Vector Informatik, default-value=true  # General DiagnosticInfo Support | Provide the Port-Interface GeneralDiagnosticInfo.
      boolean DemImmediateNvStorageSupport [0..1]: set at pre-compile, origin=Vector Informatik, default-value=false  # ImmediateNvStorage Support | TRUE: For all DTCs for which DemConfigSet/DemDTCClass/DemImmediateNvStorage parameter is enabled, DTC related data is stored immediately in NvRam. For all DTCs for which DemConfigSet/DemDTCClass/DemImmediateNvStorage parameter is disabled, only OBD relevant data is synchronized immediately. FALSE or when this parameter is missing: If at least one of the following conditions is fulfilled, the feature will be switched on (same behavior as TRUE): - at least one of the DemConfigSet/DemDTCClass/DemImmediateNvStorage parameters is enabled - DemGeneral/DemNvSynchronizeSupport is set to TRUE - DemGeneral/DemClearDTCBehavior is set to DEM_CLRRESP_NONVOLATILE_FINISH Otherwise the feature is disabled.
      boolean DemJ1939Support: set at pre-compile, origin=Vector Informatik, default-value=false  # Globally activate the support for J1939. If this feature is active, the configuration of J1939 in container DemGeneral/DemGeneralJ1939 is mandatory.
      integer DemMemoryBlockDistribution [0..1]: 1..255, set at pre-compile, origin=Vector Informatik, default-value=1  # This parameter has no effect
      boolean DemMultipleTripSupport [0..1]: set at pre-compile, origin=Vector Informatik, default-value=false  # FALSE: Multitrip behavior is not allowed for any event. DemConfigSet/DemEventParameter/DemEventClass/DemEventFailureCycleCounterThreshold has to be 0 or 1. TRUE: Multitrip behavior is possible, but not mandatory, i.e. confirmation handling is still according to the settings of DemConfigSet/DemEventParameter/DemEventClass/DemEventFailureCycleCounterThreshold. Trip counter information is available for all events. Example: If all events have a single trip behavior, enabling MultipleTripSupport may be useful for configuration variants, e.g. to calibrate a different value for DemEventFailureCycleCounterThreshold later. When this parameter is missing, the Dem will select the confirmation handling according to the settings of DemConfigSet/DemEventParameter/DemEventClass/DemEventFailureCycleCounterThreshold or DemConfigSet/DemEventParameter/DemEventClass/DemIndicatorAttribute/DemIndicatorHealingCycleCounterThreshold.
      boolean DemNvSynchronizeSupport: set at pre-compile, origin=Vector Informatik, default-value=false  # Provides API Dem_RequestNvSynchronization. If this option is enabled, API Dem_RequestNvSynchronization is provided which can be used to request full NV synchronization. For SWC, the API is available as operation SynchronizeNvData in port interface DemServices. Use this API in case the AUTOSAR defined synchronization points do not suffice for your project.
      enumeration DemPendingDtcProcessing: {DEM_PROCESS_PDTC_STOREDONLY, DEM_PROCESS_PDTC_ALL_DTC}, set at pre-compile, origin=Vector Informatik, default-value=DEM_PROCESS_PDTC_STOREDONLY  # Status Bit PendingDTC Processing | Select behavior of PendingDTC status bit. STOREDONLY: Set the status bit2 (PendingDTC) only if a memory entry could be allocated successfully. With this setting the status bit PendingDTC is also reset when the event is displaced from memory. ALL_DTC: Set the status bit2 (PendingDTC) independently from successful event storage. With this setting the status bit PendingDTC is not modified in case the DTC is displaced from memory.
      enumeration DemResetDebounceBehavior: {DEM_RESET_DEBOUNCE_ON_ENABLE_ENABLE_CONDITIONS, DEM_RESET_DEBOUNCE_ON_DISABLE_ENABLE_CONDITIONS}, set at pre-compile, origin=Vector Informatik, default-value=DEM_RESET_DEBOUNCE_ON_DISABLE_ENABLE_CONDITIONS  # Controls the point in time debouncing is reset when enable conditions of an event are not fulfilled. DEM_RESET_DEBOUNCE_ON_DISABLE_ENABLE_CONDITIONS Reset the debouncing values when the events preconditions are no longer fullfilled DEM_RESET_DEBOUNCE_ON_ENABLE_ENABLE_CONDITIONS Reset the debouncing values when the events preconditions return to fulfilled state, after they had been unfulfilled. This option only effects events configured to reset debouncing (DemDebounceBehavior==DEM_DEBOUNCE_RESET)
      boolean DemResetTestFailedOnOperationCycleStart: set at pre-compile, origin=Vector Informatik, default-value=false  # Reset TestFailed on OperationCycle Start | If this option is enabled, (re)starting an operation cycle also resets the TestFailed bit of events using the cycle as operation cycle. This is not counted as a qualified test result.
      boolean DemRetryStorageSupport: set at pre-compile, origin=Vector Informatik, default-value=false  # When enabled, the Dem will retry to store events that could not be stored; e.g. due to missing storage conditions, or filled up event memory. An attempt to store is triggered for FAILED DTCs (Bit0 set) with every PRE_FAILED report (while the FDC is at 128) or FAILED report.
      boolean DemSafeBswChecks: set at pre-compile, origin=Vector Informatik, default-value=false  # SafeBSW Checks | Selects if safety checks are used. These checks improve robustness as e.g. invalid parameters are checked before function is executed. This attribute has to be enabled for safety projects where this component is mapped to an ASIL partition.
      boolean DemTriggerControlDTCSetting [0..1]: set at pre-compile, origin=Vector Informatik, default-value=false  # Trigger ControlDTCSetting | The application is triggered if diagnostic service 0x85 - ControlDtcSetting is processed in DEM. In case the ECU does not support an RTE (DemUseRte == False), the Dem calls function Appl_Dem_CBControlDTCSetting_ControlDTCSettingChanged, which must be supplied by the application
      boolean DemTriggerDtcStatusChangedCallback [0..1]: set at pre-compile, origin=Vector Informatik, default-value=true  # Trigger DtcStatusChanged Callback | Globally disable DTC status notifications. You can use this parameter to suppress all dtc status notification callbacks, usually because none are used in the first place. You can also use this parameter as a temporary measure to allow compilation until all notification callouts are actually available. If you want notifications, it is recommended to remove the parameter completely.
      boolean DemTriggerEventDataChangedCallback [0..1]: set at pre-compile, origin=Vector Informatik, default-value=true  # Trigger EventDataChanged Callback | Globally disable DTC data change notifications. You can use this parameter to suppress all data change notification callbacks, usually because none are used in the first place. You can also use this parameter as a temporary measure to allow compilation until all notification callouts are actually available. If you want notifications, it is recommended to remove the parameter completely.
      boolean DemTriggerEventStatusChangedCallback [0..1]: set at pre-compile, origin=Vector Informatik, default-value=true  # Trigger EventStatusChanged Callback | Globally disable event status notifications. You can use this parameter to suppress all event status notification callbacks, usually because none are used in the first place. You can also use this parameter as a temporary measure to allow compilation until all notification callouts are actually available. If you want notifications, it is recommended to remove the parameter completely.
      boolean DemTriggerGlobalEventDataChangedCallback [0..1]: set at pre-compile, origin=Vector Informatik, default-value=false  # Trigger GlobalEventDataChanged Callback | If this parameter exists, you can explicitly control if the Dem requires the port interface 'GlobalEventDataChanged' (set: True) or not (set: False). It is used as a 'one for all' callout in case event data changes. If this parameter is missing (not set), the global interface is always required in addition to any DemConfigSet/DemEventParameter/DemCallbackEventDataChanged callout as demanded by AUTOSAR. This parameter here is irrelevant, if parameter DemGeneral/DemTriggerEventDataChangedCallback exists and has value False. In case the ECU does not support an RTE (DemUseRte == False), the Dem calls function Appl_Dem_GeneralCBDataEvt_EventDataChanged, which must be supplied by the application.
      boolean DemTriggerGlobalEventStatusChangedCallback [0..1]: set at pre-compile, origin=Vector Informatik, default-value=false  # Trigger GlobalEventStatusChanged Callback | If this parameter exists, you can explicitly control if the port interface 'GlobalEventStatusChanged' will be required (set: True) or not (set: False) by the Dem. It is used as a 'one for all' callout in case event status changes. If this parameter is missing (not set), the global interface is always required in addition to any DemConfigSet/DemEventParameter/DemCallbackEventStatusChanged callout as demanded by AUTOSAR. This parameter here is irrelevant, if parameter DemGeneral/DemTriggerEventStatusChangedCallback exists and has value False. In case the ECU does not support an RTE (DemUseRte == False), the Dem calls function Appl_Dem_GeneralCBStatusEvt_EventStatusChanged, which must be supplied by the application.
      boolean DemUseMemcopyMacros: set at pre-compile, origin=Vector Informatik, default-value=false  # Control use of VStdLib. If this switch is enabled, the Dem implementation uses macro implementations for memcopy and memset routines. These macros can be defined within a user config file (see DemUserConfigFile) if so desired: #define Dem_MemCpy_Macro(dst, src, len) /* some implementation */ #define Dem_MemSet_Macro(dst, val, len) /* some implementation */ If no definition is given by user config file, the Dem automatically uses a default implementation. If the switch is disabled, VStdLib is used.
      boolean DemUseNvm [0..1]: set at pre-compile, origin=Vector Informatik, default-value=true  # When this parameter is missing, the Dem will select the usage of NvM based on the existence of DemNvRamBlockId containers. Containers with warnings or errors are ignored here and considered as non-existant. If the parameter exists, you can control manually if the Dem will report modified blocks to the NvM or runs completely from RAM mirrors without persistence. This can be useful in early integration phases where you have not yet completely set up the NvM but still need the Dem for production error reporting of the communication stack. The use of this parameter is discouraged in production ECUs, but could be used to implement an integration defined persistence strategy. Please note that if this option is (existing and) set to disabled all features concerning NV memory will not be available.
      boolean DemUseRte: set at pre-compile, origin=Vector Informatik, default-value=true  # Set to FALSE to disable the usage of RTE callbacks. If disabled, all callouts are replaced by direct function calls. This is supported only for ECUs with neither RTE nor BRE. If the ECU uses an RTE or BRE, this option must be enabled.
      string DemUserConfigFile [0..1]: set at pre-compile, origin=Vector Informatik  # User Configuration File | Path to an external user configuration file used by the DaVinci Configurator 5 generation tool. If you want to overwrite some of the settings in the generated configuration file (Dem_Cfg.h), you can specify a path to a user defined configuration file. The user defined configuration file will be included at the end of the generated preprocessor switches. Definitions in the user defined configuration file can overwrite definitions in the generated configuration file. To specify the file name, you can use "$(var)" sequence(s) in the specified path. Each such sequence is replaced by the content of the related environment variable "var". Additionally you can use following predefined sequences: $(DpaProjectFolder) Absolute directory of the loaded *.dpa file. $(EcuProjectName) Name of the project defined in the loaded *.dpa file. $(EcucFile) Absolute directory "ECUC", defined by the loaded *.dpa file, containing files $(EcuProjectName).ecuc.arxml and $(EcuProjectName).ecuc.Initial.arxml . $(EcucFolder) Parent directory of $(EcucFile). $(SipRootPath) Absolute directory "SIP", defined by the loaded *.dpa file. $(OutputFolder) (Relative) directory "GenData", defined by the loaded *.dpa file. See setting "Root Target Folder" of Configurator 5. $(ServiceSwcFolder) Absolute directory "ServiceComponents", defined by the loaded *.dpa file. $(cwd) Current working directory when starting Configurator 5. RESTRICTIONS: Not all of the settings can be overwritten simply by triggering the preprocessor switch. Some of the options are complex and the code generator generates less or more code depending on the setting. USE SUCH A FILE ONLY AFTER DISCUSSION WITH VECTOR.
      string DemUserConfigFilePost [0..1]: set at pre-compile, origin=Vector Informatik  # User Configuration File - Late Inclusion | Path to an external user configuration file used by the DaVinci Configurator 5 generation tool. If you want to overwrite some of the settings in the generated configuration file (Dem_LCfg.h), you can specify a path to a user defined configuration file. The user defined configuration file will be included at the end of the file. Definitions in the user defined configuration file can overwrite definitions in the generated configuration file. To specify the file name, you can use "$(var)" sequence(s) in the specified path. Each such sequence is replaced by the content of the related environment variable "var". Additionally you can use following predefined sequences: $(DpaProjectFolder) Absolute directory of the loaded *.dpa file. $(EcuProjectName) Name of the project defined in the loaded *.dpa file. $(EcucFile) Absolute directory "ECUC", defined by the loaded *.dpa file, containing files $(EcuProjectName).ecuc.arxml and $(EcuProjectName).ecuc.Initial.arxml . $(EcucFolder) Parent directory of $(EcucFile). $(SipRootPath) Absolute directory "SIP", defined by the loaded *.dpa file. $(OutputFolder) (Relative) directory "GenData", defined by the loaded *.dpa file. See setting "Root Target Folder" of Configurator 5. $(ServiceSwcFolder) Absolute directory "ServiceComponents", defined by the loaded *.dpa file. $(cwd) Current working directory when starting Configurator 5. RESTRICTIONS: Usually it is sufficient to use only the DemUserConfigFile. This option should be only used with extreme caution. USE SUCH A FILE ONLY AFTER DISCUSSION WITH VECTOR.
      enumeration DemUserControlledWirBehavior: {DEM_DISABLED_DURING_CONTROLDTCSETTING, DEM_ENABLED_DURING_CONTROLDTCSETTING}, set at pre-compile, origin=Vector Informatik, default-value=DEM_ENABLED_DURING_CONTROLDTCSETTING  # Status Bit WarningIndicatorRequest User Controlled Behavior | This setting has effect only when DemUserControlledWirSupport == True. (Status Bit WarningIndicatorRequest User Controlled == True) DISABLED_DURING_CONTROLDTCSETTING: The API Dem_SetWIRStatus will return E_NOT_OK while ControlDTCSetting has disabled DTC storage. ENABLED_DURING_CONTROLDTCSETTING Dem_SetWIRStatus will process changes while ControlDTCSetting has disabled DTC storage.
      boolean DemUserDefinedCompareAndSwap: set at pre-compile, origin=Vector Informatik, default-value=false  # Implement and use a hardware optimized ApplDem_SyncCompareAndSwap() function. The API ApplDem_SyncCompareAndSwap(uint32* AddressPtr, uint32 OldValue, uint32 NewValue) performs an atomic compare and swap of memory contents. If disabled, the DEM uses an internal implementation, that needs the critical section 'CrossCoreComm'. If enabled, the DEM uses an external implementation.
      boolean DemUserControlledWirSupport [0..1]: set at pre-compile, origin=Vector Informatik, default-value=false  # Status Bit WarningIndicatorRequest User Controlled | Activate the external modifiability of the WarningIndicatorRequest Status Bit. If this option is enabled, the API Dem_SetWIRStatus is provided, which allows the user to override the current WarningIndicatorRequest Bit of the DTC status. Additionally, the API Dem_GetWIRStatus can be used the read the current override status (WIR controlled / not controlled by user). If this option is disabled, overriding the WarningIndicatorRequest Bit is deactivated, and the APIs Dem_SetWIRStatus and Dem_GetWIRStatus are not available.
      enumeration DemWarningIndicatorRequestedProcessing: {DEM_PROCESS_WIR_STOREDONLY, DEM_PROCESS_WIR_ALL_DTC}, set at pre-compile, origin=Vector Informatik, default-value=DEM_PROCESS_WIR_STOREDONLY  # Status Bit WarningIndicatorRequested Processing | Select behavior of WarningIndicatorRequested status bit. STOREDONLY: Set the status bit7 (WarningIndicatorRequested) only if a memory entry could be allocated successfully. ALL_DTC: Set the status bit7 (WarningIndicatorRequested) independently from successful event storage. Independent of the selected behavior the status bit 7 is not cleared due to displacement.
      boolean DemUseMultiPartitionFiM: set at pre-compile, origin=Vector Informatik, default-value=false  # Use Multi Partition FiM | This configuration switch defines, whether a Multi Partition FiM is used. If this parameter is enabled, the Dem calls the APIs FiM_DemInitMaster and FiM_DemInitSatellite instead of FiM_DemInit during initialization. This parameter is only relevant, if the FiM is notified about monitor status changes (see Dem/DemGeneral/DemTriggerFiMReports).
      boolean DemReportSuppressedDTCsInService19x0A: set at pre-compile, origin=Vector Informatik, default-value=false  # Report Suppressed DTCs In Service 19x0A | If this parameter is enabled, suppressed DTCs are reported in UDS service $19 0A. If this parameter is disabled, suppressed DTCs are not reported in UDS service $19 0A.
      boolean DemSupportAgingForAllDTCs: set at pre-compile, origin=Vector Informatik, default-value=false  # Support Aging For All DTCs | If this parameter is enabled, all DTCs can age independently of a memory entry. If this parameter is disabled, only DTCs with a memory entry can age.
      boolean DemSupportStorageIndependentCycleCounters [0..1]: set at pre-compile, origin=Vector Informatik, default-value=false  # Event Storage Independent Cycle Counters | If this parameter is enabled, Dem internal data elements FAILED_CYCLES and FAULT_PENDING_COUNTER are calculated and reported independently of an event memory entry (if configured for event). When activating this feature, the configuration needs an additional NV-RAM block with DemNvRamBlockIdType "DEM_NVBLOCK_CYCLECOUNTER". Additional two bytes per DTC are required for NVRAM. If this parameter is disabled or does not exist, the counters are only tracked and reported if the event has a memory entry. Set Dem/DemGeneral/DemExtendedDataVisibility to 'ALL_DTC' for full benefit of this feature.
      enumeration DemLatchTestFailedBehavior: {DEM_LATCH_TF_CONFIRMED_AND_THIS_CYCLE, DEM_LATCH_TF_ONLY_THIS_CYCLE}, set at pre-compile, origin=Vector Informatik, symbolic-name-value=true, default-value=DEM_LATCH_TF_CONFIRMED_AND_THIS_CYCLE  # Defines the behavior of events that have DemConfigSet/DemEventParameter/DemEventLatchTestFailed enabled. DEM_LATCH_TF_ONLY_THIS_CYCLE: After a qualified FAILED result, a PASSED result for the event is ignored during the current operation cycle. DEM_LATCH_TF_CONFIRMED_AND_THIS_CYCLE: After a qualified FAILED result, a PASSED result for the event is ignored during the current operation cycle. Additionally if the event is confirmed, no PASSED result is processed for that event until it is cleared. As a consequence, the event cannot age.
      boolean DemSupportService19x16 [0..1]: set at pre-compile, origin=Vector Informatik, default-value=false  # Support Service 19x16 | If this parameter is enabled, subfunction 0x16 (reportDTCExtDataRecordByRecordNumber) of UDS service 0x19 (ReadDTCInformation) is supported.
      reference DemMILIndicatorRef [0..1]: scope=ECU, set at pre-compile, destination=DemIndicator  # This parameter defines the indicator representing the MIL. If no indicator is selected, the MIL is not supported by this ECU. When J1939 is supported, the MIL indicator must differ from the J1939 indicators.
      symbolic name reference DemIgnitionCycleFunctionIdRef [0..1]: set at pre-compile, origin=Vector Informatik, destination=FiMFID  # IgnitionCycle FunctionId Ref | Define a FID that is disabled when the input signals to calculate the ignition cycle are defective. This FID is required if RatioIDs are used in OBD configurations. Otherwise it is not supported.
      reference DemMasterOsApplicationRef [0..1]: set at pre-compile, origin=Vector Informatik, destination=OsApplication  # OsApplication Ref for Master | The central partition for a multi partition DEM, see chapter "Multi-Partition support" in the TechnicalReference. This partition is used as DEM Master partition. When this configuration value is missing, a pseudo partition "0" is substituted. See also configuration parameter /Dem/DemConfigSet/DemEventParameter/DemOsApplicationRef for the mapping of events to the DEM satellite's partition. This value DemMasterOsApplicationRef here acts as a default for not configured DemOsApplicationRef values.
      reference DemOsApplicationRef [0..*]: set at pre-compile, origin=Vector Informatik, destination=OsApplication  # OsApplication Ref | List of references to partitions, the DEM is running at. The Dem directly supports multi partition architectures, i.e. ECUs using multiple cores or memory protection for safety reasons. See chapter "Multi-Partition support" in the TechnicalReference for details. This list here implicitly contains all configured /Dem/DemConfigSet/DemEventParameter/DemOsApplicationRef references as well as the configured /Dem/DemGeneral/DemMasterOsApplicationRef reference - even if they are not configured here explicitly.
      reference DemRestartCycleOnInitRef [0..1]: set at pre-compile, origin=Vector Informatik, destination=DemOperationCycle  # Automatically start the referenced cycle with Dem_PreInit(). BSW events need a started cycle (typically the power cycle) to not be discarded. Event changes will not be notified (Callbacks OnStatusChange, FiM, etc) since the RTE is not necessarily available at this point in time. Make sure dependent modules (e.g. FiM) are set up accordingly.
      container DemAgingCycle [0..0]  # AgingCycle | Aging cycles are not supported. Use OperationCycles instead.
      container DemCallbackDTCStatusChanged [0..*]  # Callback DTCStatusChanged | The presence of this container sets up a callout function 'DTCStatusChanged' for this DTC. The Dem will call this function each time a DTC status changes. This function is usually called through a RTE port interface. This behavior can be changed by creating the sub-parameter 'DemCallbackDTCStatusChangedFnc'.
        function name DemCallbackDTCStatusChangedFnc [0..1]: scope=ECU, set at pre-compile  # Callback DTCStatusChanged Function | Function name of a 'DTCStatusChanged' callout. If this parameter exists, it must give a valid C-Function which is called instead of using an RTE port interface. See DemGeneral/DemHeaderFileInclusion to specify a header file which declares this function.
      container DemClient [0..255]  # This container contains possible clients that are using the Dem APIs.
        integer DemClientId: 0..254, scope=ECU, set at pre-compile, origin=Vector Informatik, symbolic-name-value=true, default-value=254  # Defines a unique identifier for a Dem client. This number is used by this client in the ClientID parameter in all API with this parameter.
      container DemDataClass [0..65534]  # This container groups the configuration (parameters) of a data element. Data elements are used to build DIDs, PIDs and ExtendedDataRecords
        integer DemDataElementDataSize: 1..255, scope=ECU, set at pre-compile, origin=Vector Informatik  # DataElement Data Size | Defines the size of the data element in bytes.
        enumeration DemDataElementDataType [0..1]: {BOOLEAN, SINT16, SINT32, SINT8, SINT8_N, UINT16, UINT32, UINT8, UINT8_N}, set at pre-compile, origin=Vector Informatik  # Provide the implementation data type of data belonging to a external data. For DemDataElementDataSize > 1 the configured data type UINT8/SINT8 is treated as UINT8_N/SINT8_N to establish compatibility with the DCM.
        enumeration DemDataElementEndianness [0..1]: {BIG_ENDIAN, LITTLE_ENDIAN, OPAQUE}, set at pre-compile, origin=Vector Informatik  # Defines the endianness of the data belonging to an external data.
        enumeration DemDataElementInternalData [0..1]: {DEM_AGINGCTR, DEM_AGINGCTR_UPCNT, DEM_AGINGCTR_INVERTED, DEM_AGINGCTR_DOWNCNT, DEM_OCCCTR, DEM_OCCCTR_2BYTE, DEM_OVFLIND, DEM_SIGNIFICANCE, DEM_PRIORITY, DEM_CURRENT_FDC, DEM_MAX_FDC_SINCE_LAST_CLEAR, DEM_MAX_FDC_DURING_CURRENT_CYCLE, DEM_CYCLES_SINCE_FIRST_FAILED, DEM_CYCLES_SINCE_LAST_FAILED, DEM_FAILED_CYCLES, DEM_CONSECUTIVE_FAILED_CYCLES, DEM_CYCLES_TESTED_SINCE_FIRST_FAILED, DEM_CYCLES_TESTED_SINCE_LAST_FAILED, DEM_HEALINGCTR_DOWNCNT, DEM_ROOTCAUSE_EVENTID, DEM_OBDDTC, DEM_OBDDTC_3BYTE, DEM_OBD_RATIO, DEM_FAULT_PENDING_COUNTER, DEM_AGED_COUNTER, DEM_WUC_SINCE_LAST_FAILED}, scope=ECU, set at pre-compile, origin=Vector Informatik  # Internal DataElement | Select the Dem-internal data value, which is mapped to the data element. AGINGCTR / AGINGCTR_UPCNT: (1 Byte) Current value of the aging counter, counting from 1...255. The value latches at aging counter threshold (for events that allow aging) or 255 (for events with aging not allowed, refer to DemGeneral/DemAgingCounterBehavior). If DemGeneral/DemSupportAgingForAllDTCs is disabled, this value is processed and readable only for currently stored events. If DemGeneral/DemSupportAgingForAllDTCs is enabled, depending on the configuration, this value is always readable (refer to Dem/DemGeneral/DemExtendedDataVisibility). AGINGCTR_INVERTED / AGINGCTR_DOWNCNT: (1 Byte) Current value of the aging counter, counting backwards from the configured maximum value down to 0. If DemGeneral/DemSupportAgingForAllDTCs is disabled, this value is processed and readable only for currently stored events. If DemGeneral/DemSupportAgingForAllDTCs is enabled, depending on the configuration, this value is always readable (refer to Dem/DemGeneral/DemExtendedDataVisibility). OCCCTR: (1 Byte) Current value of the occurrence counter, counting from 1...255. The value is incremented on each transition of the TestFailed Bit from 0 to 1 and latches at 255. This value is processed and readable only for currently stored events. OCCCTR_2BYTE: (2 Byte) Current value of the occurrence counter, counting from 1...65535. The value is incremented on each transition of the TestFailed Bit from 0 to 1 and latches at 65535. This value is processed and readable only for currently stored events. OVFLIND: (1 Byte) Value 1 if the primary memory has overflown, 0 otherwise. Will be reset on ClearAllDTC request. This value is always available. SIGNIFICANCE: (1 Byte) Value 1 if the event is configured as OCCURRENCE, 0 if the event is configured as FAILURE. This value is always available. PRIORITY: (1 Byte) The DTC priority which is mapped into the environmental data. This value is always available. CURRENT_FDC: (1 Byte) Current value of the DTC fault detection counter. This value is always available. MAX_FDC_SINCE_LAST_CLEAR: (1 Byte) Maximum value of the DTC fault detection counter reached since last clear. 0 is the minimum value reported. The counter is processed and readable only for currently stored events. MAX_FDC_DURING_CURRENT_CYCLE: (1 Byte) Maximum value of the DTC fault detection counter reached in the current operation cycle. 0 is the minimum value reported. This value is always available. CYCLES_SINCE_FIRST_FAILED: (1 Byte) Number of completed operation cycles, since the cycle of the first transition of the TestFailed Bit from 0 to 1 of the DTC. The value latches at 255. The counter is processed and readable only for currently stored events. CYCLES_SINCE_LAST_FAILED: (1 Byte) Number of completed operation cycles, since the last transition of the TestFailed Bit from 0 to 1 of the DTC. The value is reset at the first failed result in the operation cycle, latches at 255. The counter is processed and readable only for currently stored events. FAILED_CYCLES: (1 Byte) Number of operation cycles, since last DTC clear in which the DTC was tested 'failed', including the current cycle. The value is incremented at the first failed result in the operation cycle, latches at 255. If Dem/DemGeneral/DemSupportStorageIndependentCycleCounters is not enabled the counter is processed and readable only for currently stored events. Otherwise the counter is processed and readable at all times (see also Dem/DemGeneral/DemExtendedDataVisibility). CONSECUTIVE_FAILED_CYCLES: (1 Byte): Number of consecutive operation cycles in which the DTC was tested 'failed', including the current cycle. The value is incremented at the first failed result in the operation cycle and reset at the end of an operation cycle that was tested and not tested 'failed'.The value latches at 255. The counter is processed and readable only for currently stored events. CYCLES_TESTED_SINCE_FIRST_FAILED: (1 Byte) Number of completed and tested operation cycles since the cycle of the first transition of the TestFailed Bit from 0 to 1 of the DTC. The value latches at 255. The counter is processed and readable only for currently stored events. CYCLES_TESTED_SINCE_LAST_FAILED: (1 Byte) Number of completed and tested operation cycles, since the last transition of the TestFailed Bit from 0 to 1 of the DTC (Healing Counter). The value is reset at the first failed result in the operation cycle, latches at 255. The value is always available. HEALINGCTR_DOWNCNT: (1 Byte) Number of complete and tested operation cycles until WIR bit will be cleared (independently of whether Dem/DemConfigSet/DemEventParameter/DemEventClass/DemIndicatorAttribute/DemIndicatorRef is set or not). If healing has not started yet, Dem/DemConfigSet/DemEventParameter/DemEventClass/DemIndicatorAttribute/DemIndicatorHealingCycleCounterThreshold is reported. If healing is completed, 0 is reported. The value is always available. ROOTCAUSE_EVENTID: (2 Byte) The event id that caused the storage/update of the environmental data. Can be used in context of the feature 'combined event' to store the root cause DemEventId value. The value is processed and readable only for currently stored events OBDDTC: (2 Byte) The corresponding OBD II DTC for the requested UDS DTC. If no OBD II DTC is configured, the returned value will be 0. This value is always available. OBDDTC_3BYTE: (3 Byte) The corresponding OBD II DTC for the requested UDS DTC in format [HiByte LoByte 0x00]. If no OBD II DTC is configured, the returned value will be 0. This value is always available. OBD_RATIO: (4 Byte) If the DTC has a ratio attached, the numerator and denominator are returned in the following format: [NumHiByte NumLoByte DenomHiByte DenomLoByte]. If the DTC does not have a ratio attached, the returned value is [0x00 0x00 0x00 0x00]. This value is always available. FAULT_PENDING_COUNTER: (1 Byte) Number of consecutive operation cycles in which the DTC was tested 'failed', including the current cycle. The value is incremented at the first failed result in the operation cycle and reset at the end of an operation cycle that was tested and not tested 'failed'. In contrast to the 'Consecutive Failed Cycle Counter' the value latches at DemEventFailureCycleCounterThreshold + 1. If Dem/DemGeneral/DemSupportStorageIndependentCycleCounters is not enabled the counter is processed and readable only for currently stored events. Otherwise the counter is processed and readable at all times (see also Dem/DemGeneral/DemExtendedDataVisibility). AGED_COUNTER: (1 Byte) Current value of the aged counter. The value is incremented, if the DTC is aged and reset, if the DTC is cleared. The value latches at 255 and is always available. WUC_SINCE_LAST_FAILED: (1 Byte) Number of completed warm up cycles, since the last transition of the TestFailed Bit from 0 to 1 of the DTC. The value latches at 255. The counter is processed and readable only for currently stored events.
        function name DemDataElementReadFnc [0..1]: scope=ECU, set at pre-compile, origin=Vector Informatik  # In case of DemDataElementUsePort is USE_DATA_FUNCTION_CALL this parameter defines the prototype of the C function "ReadDataElement" used to get the according value.
        boolean DemDataElementStoreNonVolatile: set at pre-compile, origin=Vector Informatik, default-value=true  # Select if the data element needs to be stored in NVRam. Ususally, snapshots of a system value (like temperature, voltage...) need to be stored in NVRam. If the data element is stored, the Dem will collect the current value into NVRam at the DTC storage time. Reading access will return the stored data (e.g. for diagnostic service $19) Disabling NV storage for this data element will cause the Dem to fetch the data with each read access. This is useful if this data element is something that will not change over time, or is already stored outside the Dem.
        enumeration DemDataElementUsePort: {USE_DATA_CLIENT_SERVER_PORT, USE_DATA_CLIENT_SERVER_PORT_WITH_EVENTID, USE_DATA_FUNCTION_CALL, USE_DATA_FUNCTION_CALL_WITH_EVENTID, USE_DATA_SENDER_RECEIVER, USE_DATA_INTERNAL}, scope=ECU, set at pre-compile, origin=Vector Informatik, default-value=USE_DATA_CLIENT_SERVER_PORT  # Defines which interface shall be used to access the data.
        foreign reference DemDataElementSystemTemplateDiagnosticDataElementRef [0..1]: set at pre-compile, origin=Vector Informatik, destination-type=DIAGNOSTIC-DATA-ELEMENT  # DataElement System Template Diagnostic DataElement Ref | Reference to the DiagnosticDataElement which is represented by this DemDataClass.
        choice container DemDiagnosisScaling [0..1]  # This container contains the configuration (parameters) of an alternative Diagnosis Representation. Out if this the scaling between Diagnosis and ECU internal representation and vice versa can be calculated. (not supported)
          container DemAlternativeDataInterface [0..1]  # This container contains the configuration (parameters) of an alternative Diagnosis Representation by the means of a VariableDataPrototoype in a DataInterface. (not supported)
            foreign reference DemDataElement: set at pre-compile, origin=Vector Informatik, destination-type=VARIABLE-DATA-PROTOTYPE  # Alternative Diagnosis Representation for the data defined by the means of a VariableDataPrototoype in a DataInterface. (not supported)
            foreign reference DemPortInterfaceMapping [0..1]: set at pre-compile, origin=Vector Informatik, destination-type=PORT-INTERFACE-MAPPING  # Optional reference to PortInterfaceMapping which defines the mapping rules. (not supported)
          container DemAlternativeDataProps [0..1]  # This container contains the configuration (parameters) of an alternative Diagnosis Representation by the means of ECU configuration parameters. (not supported)
            enumeration DemDataTypeCategory: {SCALE_LINEAR_AND_TEXTTABLE, TEXTTABLE}, scope=ECU, set at pre-compile, origin=Vector Informatik  # Data category of the alternative Diagnosis Representation. (not supported)
            container DemLinearScale [0..1]  # This container contains the configuration (parameters) of an linear scale of the alternative Diagnosis Representation. (not supported)
              float DemDiagnosisRepresentationDataLowerRange: -1.7976931348623157E+308..1.7976931348623157E+308, scope=ECU, set at pre-compile, origin=Vector Informatik  # Lower Range for this scale of the data in the alternative Diagnosis Representation. (not supported)
              float DemDiagnosisRepresentationDataOffset: 0..1.7976931348623157E+308, scope=ECU, set at pre-compile, origin=Vector Informatik, default-value=0  # Data offset of the alternative Diagnosis Representation for this scale. (not supported)
              float DemDiagnosisRepresentationDataResolution: 0..1.7976931348623157E+308, scope=ECU, set at pre-compile, origin=Vector Informatik  # Data resolution of the alternative Diagnosis Representation for this scale. (not supported)
              float DemDiagnosisRepresentationDataUpperRange: 0..1.7976931348623157E+308, scope=ECU, set at pre-compile, origin=Vector Informatik  # Upper Range for this scale of the data in the alternative Diagnosis Representation. (not supported)
            container DemTextTableMapping [0..*]  # This container contains the configuration (parameters) of the mapping a DataPrototype typed by AutosarDataType that refer to a CompuMethods of category TEXTTABLE or SCALE_LINEAR_AND_TEXTTABLE. (not supported)
              integer DemDiagnosisRepresentationDataValue: 0..18446744073709551615, scope=ECU, set at pre-compile, origin=Vector Informatik  # The data value in the diagnosis representation. (not supported)
              integer DemInternalDataValue: 0..18446744073709551615, scope=ECU, set at pre-compile, origin=Vector Informatik  # The ECU internal data value. (not supported)
          container DemAlternativeDataType [0..1]  # This container contains the configuration (parameters) of an alternative Diagnosis Representation by the means of an ApplicationDataType. (not supported)
            foreign reference DemApplicationDataType: set at pre-compile, origin=Vector Informatik, destination-type=APPLICATION-PRIMITIVE-DATA-TYPE  # Alternative Diagnosis Representation for the data defined by the means of a ApplicationPrimitiveDataType of category VALUE or BOOLEAN. (not supported)
            container DemTextTableMapping [0..*]  # This container contains the configuration (parameters) of the mapping a DataPrototype typed by AutosarDataType that refer to a CompuMethods of category TEXTTABLE or SCALE_LINEAR_AND_TEXTTABLE. (not supported)
              integer DemDiagnosisRepresentationDataValue: 0..18446744073709551615, scope=ECU, set at pre-compile, origin=Vector Informatik  # The data value in the diagnosis representation. (not supported)
              integer DemInternalDataValue: 0..18446744073709551615, scope=ECU, set at pre-compile, origin=Vector Informatik  # The ECU internal data value. (not supported)
        choice container DemSRDataElementClass [0..1]  # This container defines the source of data in a provided port which shall be read for a external data element. (not supported)
          container DemDataElementInstance [0..1]  # Instance Reference to the primitive data in a port where the data element is typed with an ApplicationPrimitveDataType or an ImplementationDataType. (not supported)
            instance reference DemDataElementInstanceRef: set at pre-compile, origin=Vector Informatik, destination-context=ROOT-SW-COMPOSITION-PROTOTYPE SW-COMPONENT-PROTOTYPE PORT-PROTOTYPE, destination-type=AUTOSAR-DATA-PROTOTYPE  # Instance Reference to the primitive data which shall be read or written. (not supported)
          container DemSubElementInDataElementInstance [0..1]  # Instance Reference to the primitve sub-element (at any level) of composite data in a port where the data element is typed with an ApplicationCompositeDataType. (not supported)
            instance reference DemSubElementInDataElementInstanceRef: set at pre-compile, origin=Vector Informatik, destination-context=ROOT-SW-COMPOSITION-PROTOTYPE SW-COMPONENT-PROTOTYPE PORT-PROTOTYPE AUTOSAR-DATA-PROTOTYPE APPLICATION-COMPOSITE-ELEMENT-DATA-PROTOTYPE*, destination-type=AUTOSAR-DATA-PROTOTYPE  # Instance Reference to the primitve sub-element (at any level) of composite data in a port which shall be read or written. (not supported)
          container DemSubElementInImplDataElementInstance [0..1]  # Instance Reference to the primitve sub-element (at any level) of composite data in a port where the data element is typed with an ImplementationDataType of category STRUCTURE or ARRAY. (not supported)
            instance reference DemSubElementInImplDataElementInstanceRef: set at pre-compile, origin=Vector Informatik, destination-context=ROOT-SW-COMPOSITION-PROTOTYPE SW-COMPONENT-PROTOTYPE PORT-PROTOTYPE AUTOSAR-DATA-PROTOTYPE IMPLEMENTATION-DATA-TYPE-ELEMENT*, destination-type=IMPLEMENTATION-DATA-TYPE-ELEMENT  # Instance Reference to the primitve sub-element (at any level) of composite data in a port which shall be read or written. (not supported)
      container DemDidClass [0..65025]  # This container represents a Data Identifier (DID) as defined by the UDS protocol. Each DID is assembled out of one or several data elements.
        integer DemDidIdentifier: 0..65535, set at post-build in variant post-build-loadable+post-build-selectable / pre-compile in variant pre-compile  # Identifier of the Data ID as returned e.g. in $19 04.
        reference DemDidDataClassRef [1..255]: scope=ECU, set at pre-compile, origin=Vector Informatik, requires-index=true, destination=DemDataClass  # Did Data Class Ref | These references select the data elements contained in the DID. The data elements are ordered as in the XML file.
        foreign reference DemDidSystemTemplateDiagnosticDataIdentifierRef [0..1]: set at pre-compile, origin=Vector Informatik, destination-type=DIAGNOSTIC-DATA-IDENTIFIER  # Reference to the DiagnosticDataIdentifier which is represented by this DemDidClass.
      container DemEnableCondition [0..254]  # EnableCondition | This container represents a single enable condition. Please note: enable conditions can not be used directly but must be grouped (see DemEnableConditionGroup).
        integer DemEnableConditionId: 1..255, scope=ECU, set at pre-compile, symbolic-name-value=true, default-value=255  # EnableCondition Id | Internal identifier of the enable condition. This number is calculated internally and shall not be configured manually. This parameter is only available to publish the result of this calculation. Applications using Dem APIs must not rely on the value of this parameter. Instead, they must use the symbolic constant (SymbolicNameValue) DemConf_DemEnableCondition_{SHORT-NAME}. The ID value 0 is reserved for internal purpose.
        boolean DemEnableConditionStatus: scope=ECU, set at pre-compile, default-value=true  # EnableCondition Status | Defines the initial status of this enable condition. The initial value will be set during pre-initialization in Dem_PreInit() and is never stored persistently.
      container DemEnableConditionGroup [0..255]: post-build-changeable=true  # EnableCondition Group | This container groups several enable conditions. EventParameters only reference one of these groups, not individual enable conditions.
        reference DemEnableConditionRef [1..254]: scope=ECU, set at post-build in variant post-build-loadable+post-build-selectable / pre-compile in variant pre-compile, origin=AUTOSAR_ECUC V1.0.0, destination=DemEnableCondition  # EnableCondition Ref | References an enable condition.
      container DemEventMemorySet  # This container is a collection of referenced event memories and related information for a Dem client.
        container DemClearDTCNotification [0..255]  # Contains callback function definition which are called during clear DTC operations.
          function name DemClearDtcNotificationFnc [0..1]: set at pre-compile, origin=Vector Informatik  # Notification callback function name which is called on a clear DTC operation (refer to <Module>_ClearDtcNotification).
          enumeration DemClearDtcNotificationTime: {FINISH, START}, set at pre-compile, origin=Vector Informatik  # Configure, whether the callback shall be called on start of a clear or after finishing a clear DTC operation (refer to <Module>_ClearDtcNotification)
      container DemExtendedDataClass [0..*]  # ExtendedData Class | This class groups several extended data records. EventParameters only reference these groups, not individual extended data records.
        reference DemExtendedDataRecordClassRef [1..253]: set at pre-compile, destination=DemExtendedDataRecordClass  # ExtendedDataRecord Class Ref | This reference contains the link to an extended data class record.
      container DemExtendedDataRecordClass [0..253]  # ExtendedDataRecord Class | This container represents a single extended data record. Each extended data record is assembled out of one or several data elements.
        integer DemExtendedDataRecordNumber: 1..253, scope=ECU, set at pre-compile  # ExtendedDataRecord Number | The unique identifier of the extended data record as requested and reported by $19 06. Please note that extended data records are unique per ECU, e.g. the number references a defined set of data independent of the DTC it is related to.
        enumeration DemExtendedDataRecordTrigger [0..1]: {DEM_RECORD_TRIGGER_TESTFAILED, DEM_RECORD_TRIGGER_FDC_FIRST_IN_CYCLE, DEM_RECORD_TRIGGER_CONFIRMED, DEM_RECORD_TRIGGER_PASSED}, set at pre-compile, default-value=DEM_RECORD_TRIGGER_TESTFAILED  # This parameter defines the trigger to store and update ExtendedDataRecords, if configured. FDC_FIRST_IN_CYCLE: The extended data record capture/ update is triggered by the event's fault detection counter exceeding the configured storage threshold. This trigger is only processed once per operationcycle. TESTFAILED: The extended data record capture/ update is triggered by the TestFailed bit transition from 0 to 1. CONFIRMED: The extended data record capture is triggered by the Confirmed bit transition from 0 to 1. (currently not supported, can lead to undefined behavior) PASSED: The extended data record capture/ update is triggered by a qualified 'Passed' report that resets the TestFailed bit from 1 to 0.
        enumeration DemExtendedDataRecordUpdate [0..1]: {DEM_UPDATE_RECORD_NO, DEM_UPDATE_RECORD_YES}, scope=ECU, set at pre-compile  # ExtendedDataRecord Update | This parameter defines if this record is captured only once (UPDATE_RECORD_NO) or updated with each following trigger ((UPDATE_RECORD_YES). Please note that internal data elements are updated continuously and can not be frozen to their value at the time of confirmation.
        reference DemDataClassRef [1..255]: set at pre-compile, origin=Vector Informatik, requires-index=true, destination=DemDataClass  # Data Class Ref | These references select the data elements contained in the extended data record. The data elements are ordered as in the XML file.
      container DemFreezeFrameClass [0..65534]  # FreezeFrame Class | This container groups DIDs into a snapshot record. These records are sampled at different points in time, and each of these samples is identified by the snapshot record number.
        reference DemDidClassRef [1..21844]: scope=ECU, set at post-build in variant post-build-loadable+post-build-selectable / pre-compile in variant pre-compile, requires-index=true, destination=DemDidClass  # These references select the DIDs contained in the snapshot record. The DIDs are ordered as in the XML file.
      container DemFreezeFrameRecNumClass [0..255]  # FreezeFrameRecNum Class | This container contains a list of dedicated, different snapshot record numbers assigned to an event. These containers are only relevant in case DemGeneral/DemTypeOfFreezeFrameRecordNumeration is set to CONFIGURED.
        integer DemFreezeFrameRecordNumber [1..8]: 1..254, set at pre-compile, origin=Vector Informatik, requires-index=true  # FreezeFrameRecord Number | This parameter defines a record number for a freeze frame record. This record number is unique per freeze frame record number class.
        enumeration DemFreezeFrameRecordUpdate [1..8]: {DEM_UPDATE_RECORD_YES, DEM_UPDATE_RECORD_NO}, set at pre-compile, origin=Vector Informatik, requires-index=true  # FreezeFrameRecord Update | This parameter defines the case, whether the captured freeze frame record is updated with each trigger. DEM_UPDATE_RECORD_NO: The snapshot record is captured only once. DEM_UPDATE_RECORD_YES: The snapshot is captured with each trigger, overwriting a previously captured snapshot.
        enumeration DemFreezeFrameRecordTrigger [1..8]: {DEM_RECORD_TRIGGER_FDC, DEM_RECORD_TRIGGER_CONFIRMED, DEM_RECORD_TRIGGER_PENDING, DEM_RECORD_TRIGGER_TESTFAILED, DEM_RECORD_TRIGGER_TESTFAILED_FIRST_IN_CYCLE, DEM_RECORD_TRIGGER_FDC_FIRST_IN_CYCLE}, set at pre-compile, origin=Vector Informatik, requires-index=true  # FreezeFrameRecord Trigger | FDC: The snapshot data capture is triggered by a fault detection counter passing a storage threshold. CONFIRMED: The snapshot data capture is triggered by the ConfirmedDTC transition 0 -> 1. PENDING: The snapshot data capture is triggered by the PendingDTC transition 0 -> 1. TESTFAILED: The snapshot data capture is triggered by the TestFailed transition 0 -> 1. TESTFAILED_FIRST_IN_CYCLE: The snapshot data capture is triggered by the first TestFailed transition 0 -> 1 in an operation cycle. FDC_FIRST_IN_CYCLE: The snapshot data capture is triggered by the first DTC fault detection counter reaching the storage threshold in an operation cycle. Please note that snapshot trigger occuring before an event memory entry is allocated are discarded.
        reference DemFreezeFrameRecordClassRef [0..0]: set at pre-compile, destination=DemFreezeFrameRecordClass  # FreezeFrameRecord Class Ref | (Not supported yet, please use the AUTOSAR 4.0.3 compliant definitions via /Dem/DemGeneral/DemFreezeFrameRecNumClass/DemFreezeFrameRecordNumber, DemFreezeFrameRecordUpdate and DemFreezeFrameRecordTrigger.) This parameter references record number(s) for a freeze frame record.
      container DemFreezeFrameRecordClass [0..0]  # FreezeFrameRecord Class | (Not supported yet, please use the AUTOSAR 4.0.3 compliant definitions via /Dem/DemGeneral/DemFreezeFrameRecNumClass/DemFreezeFrameRecordNumber, DemFreezeFrameRecordUpdate and DemFreezeFrameRecordTrigger.) This container contains a list of dedicated, different freeze frame record numbers.
        integer DemFreezeFrameRecordNumber: 1..254, set at pre-compile  # FreezeFrameRecord Number | (Not supported yet, please use the AUTOSAR 4.0.3 compliant definitions via /Dem/DemGeneral/DemFreezeFrameRecNumClass/DemFreezeFrameRecordNumber.) This parameter defines a record number for a freeze frame record. This record number is unique per freeze frame record number class.
        enumeration DemFreezeFrameRecordTrigger: {DEM_FREEZE_FRAME_CAPTURE_ON_CONFIRMED, DEM_FREEZE_FRAME_CAPTURE_ON_FDC_THRESHOLD, DEM_FREEZE_FRAME_CAPTURE_ON_PENDING, DEM_FREEZE_FRAME_CAPTURE_ON_TEST_FAILED, DEM_RECORD_TRIGGER_TESTFAILED_FIRST_IN_CYCLE, DEM_RECORD_TRIGGER_FDC_FIRST_IN_CYCLE}, set at pre-compile  # FreezeFrameRecord Trigger | (Not supported yet, please use the AUTOSAR 4.0.3 compliant definitions via /Dem/DemGeneral/DemFreezeFrameRecNumClass/DemFreezeFrameRecordTrigger.) CAPTURE_ON_FDC_THRESHOLD: The snapshot data capture is triggered by a fault detection counter passing a failure threshold (not yet supported). CAPTURE_ON_CONFIRMED: The snapshot data capture is triggered by the ConfirmedDTC transition 0 -> 1. CAPTURE_ON_PENDING: The snapshot data capture is triggered by the PendingDTC transition 0 -> 1. CAPTURE_ON_TEST_FAILED: The snapshot data capture is triggered by the TestFailed transition 0 -> 1. TESTFAILED_FIRST_IN_CYCLE: The snapshot data capture is triggered by the first TestFailed transition 0 -> 1 in an operation cycle. FDC_FIRST_IN_CYCLE: The snapshot data capture is triggered by the first DTC fault detection counter reaching the unconfirmed threshold in an operation cycle.
        enumeration DemFreezeFrameRecordUpdate: {DEM_UPDATE_RECORD_NO, DEM_UPDATE_RECORD_YES}, scope=ECU, set at pre-compile  # FreezeFrameRecord Update | (Not supported yet, please use the AUTOSAR 4.0.3 compliant definitions via /Dem/DemGeneral/DemFreezeFrameRecNumClass/DemFreezeFrameRecordUpdate.) This parameter defines the case, when the freeze frame record is stored/updated. DEM_UPDATE_RECORD_NO - The snapshot record is captured only once. DEM_UPDATE_RECORD_YES - The snapshot is captured with each trigger, overwriting a previously captured snapshot.
      container DemGeneralJ1939 [0..1]  # This container contains the general J1939-specific configuration (parameters) of the Dem module.
        boolean DemJ1939ClearDtcSupport: set at pre-compile, default-value=false  # This configuration switch defines whether clearing J1939 DTCs (DM3 und DM11) is supported or not.
        boolean DemJ1939Dm31Support: set at pre-compile, default-value=false  # This configuration switch defines whether J1939 DM31 is supported or not.
        boolean DemJ1939ExpandedFreezeFrameSupport: set at pre-compile, default-value=false  # J1939 Expanded FreezeFrame Support | This configuration switch defines whether J1939 expanded freeze frames are supported or not.
        boolean DemJ1939FreezeFrameSupport: set at pre-compile, default-value=false  # J1939 FreezeFrame Support | This configuration switch defines whether J1939 freeze frames are supported or not.
        boolean DemJ1939RatioSupport: set at pre-compile, default-value=false  # This configuration switch defines whether J1939 performance ratios are supported or not. This parameter is not supported.
        boolean DemJ1939Readiness1Support: set at pre-compile, default-value=false  # This configuration switch defines whether J1939 diagnostic readiness 1 is supported or not.
        boolean DemJ1939Readiness2Support: set at pre-compile, default-value=false  # This configuration switch defines whether J1939 diagnostic readiness 2 is supported or not. This parameter is not supported.
        boolean DemJ1939Readiness3Support: set at pre-compile, default-value=false  # This configuration switch defines whether J1939 diagnostic readiness 3 is supported or not. This parameter is not supported.
        boolean DemJ1939ReadingDtcSupport: set at pre-compile, default-value=false  # This configuration switch defines whether J1939 DTC readout is supported or not.
        boolean DemTriggerJ1939DcmReports: set at pre-compile, origin=Vector Informatik, default-value=false  # If enabled, the J1939Dcm module is notified about DTC status changes in primary memory.
        integer DemJ1939ReadingDTCRuntimeLimit [0..1]: 1..65534, set at pre-compile, origin=Vector Informatik  # If this parameter exists, Dem_J1939DcmGetNextFilteredDTC will test at most this amount of DTCs for matching the filter before returning DEM_PENDING. This parameter can be used to reduce the run time of the J1939Dcm_MainFunction when filtering for DTCs.
        reference DemAmberWarningLampIndicatorRef [0..1]: set at pre-compile, destination=DemIndicator  # This parameter defines the indicator representing the AmberWarningLamp. This parameter is used for ECUs supporting J1939. For DemAmberWarningLampIndicatorRef, DemProtectLampIndicatorRef and DemRedStopLampIndicatorRef you must use different indicators. When OBD is supported, the MIL indicator must in addition differ from these indicators.
        reference DemProtectLampIndicatorRef [0..1]: set at pre-compile, destination=DemIndicator  # This parameter defines the indicator representing the ProtectLamp. This parameter is used for ECUs supporting J1939. For DemAmberWarningLampIndicatorRef, DemProtectLampIndicatorRef and DemRedStopLampIndicatorRef you must use different indicators. When OBD is supported, the MIL indicator must in addition differ from these indicators.
        reference DemRedStopLampIndicatorRef [0..1]: set at pre-compile, destination=DemIndicator  # This parameter defines the indicator representing the RedStopLamp. This parameter is used for ECUs supporting J1939. For DemAmberWarningLampIndicatorRef, DemProtectLampIndicatorRef and DemRedStopLampIndicatorRef you must use different indicators. When OBD is supported, the MIL indicator must in addition differ from these indicators.
        container DemCallbackJ1939DTCStatusChanged [0..*]  # The presence of this container indicates, that the Dem has access to a "DTCStatusChanged" callback, which the Dem will call to notify other components about the change in the status of a DTC.
          function name DemCallbackDTCStatusChangedFnc [0..1]: scope=ECU, set at pre-compile  # Function name of prototype "DTCStatusChanged".
        container DemJ1939FreezeFrameClass [0..2]  # J1939 FreezeFrame Class | This container contains the combinations of SPNs s for a J1939 relevant freeze frame. Your configuration must use one (1) common definition for all J1939 freeze frames and one (1) common definition for all J1939 expanded freeze frames (use the event parameters DemJ1939FreezeFrameClassRef and DemJ1939ExpandedFreezeFrameClassRef to use this definitions). Therefore the multiplicity of this parameter is limited to 2.
          reference DemSPNClassRef [1..255]: scope=ECU, set at pre-compile, requires-index=true, destination=DemSPNClass  # Reference to an SPN. This reference defines requiresIndex = true since it represents a ordered list of references where the order describes the order of single SPNs in the J1939 Freeze Frame.
        container DemSPNClass [0..*]  # This container contains the configuration (parameters) for a SPN.
          integer DemSPNId: 0..524287, set at pre-compile  # Suspect parameter number. The DEM doesn't use this value to generate its code.
          reference DemSPNDataClassRef: scope=ECU, set at pre-compile, origin=Vector Informatik, destination=DemDataClass  # This reference contains the link to a data element class.
      container DemGeneralOBD [0..1]  # This container will be used only, if the OBD support (for either OBD II or WWH-OBD) is activated (see DemGeneral/DemOBDSupport and DemGeneral/DemGeneralOBD/DemOBDLegislation).
        boolean DemOBDCentralizedPID21Handling: scope=ECU, set at pre-compile, default-value=false  # Switch to enable the centralized handling of PID $21. (not supported, please use DemGeneral/DemPidConfiguration/DemSupportPid21 instead)
        boolean DemOBDCentralizedPID31Handling: scope=ECU, set at pre-compile, default-value=false  # Switch to enable the centralized handling of PID $31. (Not supported, please use DemGeneral/DemPidConfiguration/DemSupportPid31 instead)
        integer DemOBDCompliancy: 0..255, scope=ECU, set at post-build in variant post-build-loadable+post-build-selectable / pre-compile in variant pre-compile, default-value=1  # Configuration value to define the appropriate value to PID$1C "OBD requirements to which vehicle or engine is certified." according to the respective standards, e.g. OBD I, OBD II, JOBD etc.
        enumeration DemOBDEngineType [0..1]: {DEM_IGNITION_COMPRESSION, DEM_IGNITION_SPARK}, scope=ECU, set at pre-compile, origin=Vector Informatik  # Switch to provide either Gasoline or Diesel parameters. Used for PID01 if Major Monitors are supported.
        enumeration DemOBDDestinationOfEvents: {DEM_DTC_ORIGIN_PRIMARY_MEMORY, DEM_DTC_ORIGIN_SECONDARY_MEMORY}, scope=ECU, set at pre-compile, default-value=DEM_DTC_ORIGIN_PRIMARY_MEMORY  # The destination of events assigns where the OBD events shall be stored. (not supported)
        boolean DemOBDEventDisplacement: set at pre-compile, default-value=true  # Activate/Deactivate a different displacement behavior for OBD events. (not supported)
        boolean DemDelayWarmUpCycleToDcyEnd: set at pre-compile, origin=Vector Informatik, default-value=false  # Delay WarmUp Cycle To DrivingCycle End | If enabled the DEM delays the Warm-Up cycle end to the end of a qualified driving cycle. Therefore the DTCs that have configured the Warm-Up cycle as aging cycle will age at the end of the driving cycle.
        float DemEngineRuntimePolling [0..1]: 0.001..2678400, scope=ECU, set at pre-compile, origin=Vector Informatik, default-value=60  # Engine Runtime Polling | Allow to configure the time for the periodic polling of the engine runtime. The value must be a multiple of the DemGeneral/DemTaskTime. Otherwise it is rounded down to the next multiple value of DemTaskTime. This value is mandatory, when parameter DemOBDTimeSinceEngineStart is required. If missing, it defaults to the DemTaskTime. The AUTOSAR configuration standard is to use SI units, so in the EcuC file this parameter is stored as float value in seconds - the DaVinci Configurator 5 GUI will convert the value when using a diffenent unit.
        enumeration DemOBDFreezeFrameBehavior [0..1]: {DEM_OBDII_FREEZE_FRAME_BEHAVIOR_TYPE1, DEM_OBDII_FREEZE_FRAME_BEHAVIOR_TYPE2, DEM_OBDII_FREEZE_FRAME_BEHAVIOR_TYPE3, DEM_OBDII_FREEZE_FRAME_BEHAVIOR_TYPE4, DEM_OBDII_FREEZE_FRAME_BEHAVIOR_TYPE5, DEM_WWHOBD_FREEZE_FRAME_BEHAVIOR_TYPE1, DEM_WWHOBD_FREEZE_FRAME_BEHAVIOR_TYPE2, DEM_COMBINED_FREEZE_FRAME_BEHAVIOR_TYPE1, DEM_COMBINED_FREEZE_FRAME_BEHAVIOR_TYPE2}, set at pre-compile, origin=Vector Informatik  # OBD FreezeFrame Behavior | This configuration value defines, when the OBD II resp. WWH-OBD Freeze Frame is taken, stored and updated and when/how it is visible for diagnostic requests. OBD II, TYPE 1: OBD II Freeze Frame data capture is triggered by the initial PendingDTC transition from 0 to 1. If PendingDTC is healed without being ConfirmedDTC, the Freeze Frame will be cleared. The Freeze Frame is immediately visible in Mode02. OBD II, TYPE 2: OBD II Freeze Frame data capture is triggered by the initial PendingDTC transition from 0 to 1. If PendingDTC is healed without being ConfirmedDTC, the Freeze Frame will be cleared. The Freeze Frame is visible after the DTC becomes confirmed and the OBD Driving Cycle becomes/is qualified. For DTCs which confirm with the first failed report (DemEventFailureCycleCounterThreshold = 0), the Freeze Frame and ConfirmedDTC status bit are visible immediately. This option allows multiple Freeze Frames (see parameter /DemGeneral/DemMaxNumberEventEntryOBDFreezeFrame). OBD II, TYPE 3: OBD II Freeze Frame data capture is triggered by the initial PendingDTC transition from 0 to 1. The Pending Freeze Frame will be displaced if another DTC becomes a ConfirmedDTC. If PendingDTC is healed without being ConfirmedDTC the Freeze Frame will be cleared. The Freeze Frame is immediately visible in Mode02. OBD II, TYPE 4: OBD II Freeze Frame data capture is triggered by the initial PendingDTC transition from 0 to 1. The Pending Freeze Frame will be updated if the DTC becomes a ConfirmedDTC. If PendingDTC is healed without being ConfirmedDTC the Freeze Frame will be cleared. The Freeze Frame is immediately visible in Mode02. OBD II, TYPE 5: OBD II Freeze Frame data capture is triggered when the trip condition is fulfilled. The Freeze Frame is visible after the OBD Driving Cycle becomes/is qualified. For DTCs which confirm with the first failed report (DemEventFailureCycleCounterThreshold = 0), the Freeze Frame and ConfirmedDTC status bit are visible immediately. For DTCs related to misfire or fuel system monitoring (DemEventOBDReadinessGroup = DEM_OBD_RDY_MISF or DEM_OBD_RDY_FLSYS or DEM_OBD_RDY_FLSYS_NONCONT) this is also true in some edge cases. A stored but not yet visible freeze frame will be displaced by the freeze frame of an event with DemEventFailureCycleCounterThreshold = 0, if the invisible freeze frame is not related to a misfire and fuel system monitor. For more information refer to chapter "Reporting of Freeze Frame with Mode $02" in the OBD Technical Reference. WWH-OBD, TYPE 1: WWH-OBD Freeze Frame data capture is triggered by the initial PendingDTC transition from 0 to 1. The Freeze Frame is immediately visible WWH-OBD, TYPE 2: WWH-OBD Freeze Frame data capture is triggered by the initial PendingDTC transition from 0 to 1. If DTC becomes a ConfirmedDTC the Freeze Frame data will be updated. The Freeze Frame is immediately visible. COMBINED, TYPE1: This behavior corresponds to 'Type 1' for OBDII and 'Type 1' for WWH-OBD. COMBINED, TYPE2: This behavior corresponds to 'Type 4' for OBDII and 'Type 2' for WWH-OBD. Use COMBINED values if and only if using OBDII and WWH-OBD in different PBS variants within one configuration.
        boolean DemOBDFreezeFrameInService19: set at pre-compile, origin=Vector Informatik, default-value=false  # OBD II FreezeFrame In Service 19 | Report the OBD II freeze frame in UDS Service $19 04 (with record number 0x00 or wildcard 0xFF). If enabled the OBD II Freeze Frame can be accessed in diagnostic service $19 04 and in Mode 02 otherwise only in Mode 02.
        boolean DemOBDHideOccurrences: set at pre-compile, origin=Vector Informatik, default-value=false  # OBD II Hide Occurrences | Dependent OBD II DTCs shall not appear in some UDS $19 sub-services. If enabled, the Dem hides dependent OBD II DTCs from reporting. Also, operation 'HideOccurrences' in service 'DemOBDServices' is provided to change this behavior at run-time. Dependent OBD II DTCs are identified via the parameter 'DemEventSignificance'. A setting of 'OCCURRENCE' marks a dependent DTC. Note: Non-OBD DTCs are not affected by this feature.
        enumeration DemOBDLegislation: {DEM_OBD_LEGISLATION_OBDII, DEM_OBD_LEGISLATION_WWHOBD}, set at pre-compile in variant post-build-loadable+pre-compile / post-build in variant post-build-selectable, origin=Vector Informatik, default-value=DEM_OBD_LEGISLATION_OBDII  # The OBD legislation that shall be supported. OBDII: Support of OBD II. WWHOBD: Support of WWH-OBD. If OBD support is disabled (Dem/DemGeneral/DemOBDSupport == DEM_OBD_NO_OBD_SUPPORT), this parameter is ignored.
        integer DemOBDPermanentDtcActivationDistance [0..1]: 0..4294967295, set at pre-compile, origin=Vector Informatik, default-value=1  # OBD II PermanentDtc Activation Distance | Only relevant for OBD II legislation. Distance after first valid Odometer value was provided after which permanent DTC storage is activated. The resolution is the same as for PID$21 and PID$31 (see parameter DemOBDInputDistanceInformation). Providing this parameter will also enable an API to activate permanent DTC storage before the configured distance is reached. If this parameter is missing, permanent DTC storage is always active and can't be suppressed.
        boolean DemOBDPermanentEraseConditionDcy: set at pre-compile, origin=Vector Informatik, default-value=false  # OBD II Permanent Erase Condition Dcy | Only relevant for OBD II legislation. This parameter controls the behavior of a permanent fault after a clear DTC command issued while the OBD II driving cycle (DCY) is not yet qualified. If enabled, the Dem checks the DCY qualification state during a Clear DTC request. - DCY not qualified: The permanent fault code can be removed from permanent memory in the same DCY as the clear DTC request was issued. - DCY qualified: The permanent fault code cannot be removed from permanent memory in the same DCY as the clear DTC request was issued. If disabled, the DCY qualification state has no effect. Note: To remove a DTC from permanent memory the PFC condition must be fulfilled and the DTC must be tested as passed and not failed.
        boolean DemOBDPermanentMandatoryPfcAfterClear: set at pre-compile, origin=Vector Informatik, default-value=false  # OBD II Permanent Mandatory Pfc After Clear | Only relevant for OBD II legislation. This configuration switch specifies, when a DTC will be removed from the permanent memory after the fault memory was cleared (e.g. Mode $04) and the DTC illuminates the MIL again. If this option is enabled, the DTC will be removed from permanent memory only if PFC cycle was active and MIL becomes inactive for this DTC. If this option is disabled, the DTC will be removed from permanent memory after the MIL becomes inactive for this event.
        boolean DemOBDRestartDcyOnClearDTC: set at pre-compile, origin=Vector Informatik, default-value=false  # OBD Restart Dcy On ClearDTC | With ClearDTC (Mode $04 or Service $14FFFFFF) the DEM may restart the OBD driving cycle independent of its current qualification state. If enabled, the DEM restarts the OBD driving cycle (configured as DemOperationCycleType==DEM_OPCYC_OBD_DCY) with Mode $04 or Service $14 FFFFFF requests. If disabled, no cycle is restarted with Mode $04 or Service $14 FFFFFF requests.
        enumeration DemClearPermanentDtcBehavior: {DEM_CLR_PERM_DTC_TYPE_1, DEM_CLR_PERM_DTC_TYPE_2}, set at pre-compile, origin=Vector Informatik, default-value=DEM_CLR_PERM_DTC_TYPE_1  # OBD II Clear Permanent Dtc Behavior | Only relevant for OBD II legislation. DEM_CLR_PERM_DTC_TYPE_1 (default): Permanent DTC is erased if only tested passed (and not tested failed) during the driving cycle and if permanent fault code condition is fulfilled. DEM_CLR_PERM_DTC_TYPE_2: Permanent DTC with IUMPR monitoring is erased if only tested passed (and not tested failed) during the driving cycle. Permanent DTC without IUMPR monitoring is erased if only tested passed (and not tested failed) during the driving cycle and if permanent fault code condition is fulfilled.
        boolean DemOBDSimilarConditionsSupport: set at pre-compile, origin=Vector Informatik, default-value=false  # This configuraton switch defines, whether support for similar conditions is enabled or not.
        boolean DemOBDPID41ComprehensiveComponentsAlwaysComplete: set at pre-compile, origin=Vector Informatik, default-value=false  # Switch to control if Comprehensive Components Monitoring is always reported as complete or calculated based on current DTC status.
        boolean DemOBDSupportMajorMonitors: set at pre-compile, origin=Vector Informatik, default-value=false  # Allows to configure the event readiness group to something different to Comprehensive Components Monitoring.
        boolean DemReportBlinkingMilAsActive: set at pre-compile, origin=Vector Informatik, default-value=true  # Report Blinking Mil As Active | If enabled, the DEM reports the MIL as 'activated' if its current state is BLINKING and/or CONTINUOUS. If disabled, the DEM reports the MIL as 'activated' only if its current state is CONTINUOUS (see parameter Dem/DemConfigSet/DemEventParameter/DemEventClass/DemIndicatorAttribute/DemIndicatorBehaviour). This influences the behavior of PID $01, PID$21 and PID$4D.
        integer DemOBDPermanentChronologyMaxNumberEvents: 1..65534, set at pre-compile, origin=Vector Informatik  # OBD Permanent Chronology Max Number Events | Maximum number of events which can be stored in the chronology of confirmed events. This chronology is used to identify the next DTC to be stored in the permanent memory, if the permanent memory was full and an entry gets freed. Each event in the chronology adds two more bytes to the Dem's status NvRAM block. It is recommended to configure a value that corresponds to the maximum number of DTCs fulfilling the criteria for permanent storage at the same time in a (realistic) worst case scenario. To ensure that always the oldest confirmed DTC is stored in the permanent memory or if NvRam consumption is not a critical restriction, set the value to the maximum number of DTCs having the MIL attached (OBDII) or the maximum number of class A and B1 DTCs (WWHOBD).
        boolean DemOBDFuelSystemAlwaysComplete: set at pre-compile, origin=Vector Informatik, default-value=false  # OBD PID Fuel System Always Complete | This switch describes whether the completeness status for fuel system monitors in PID $01 and PID $41 is calculated or always indicated as complete. True: Fuel system monitoring is always reported as complete. False: Completeness of fuel system monitoring is calculated based on non-continuous fuel system monitor status.
        boolean DemOBDCompressionMisfireAlwaysComplete: set at pre-compile, origin=Vector Informatik, default-value=false  # OBD PID Compression Misfire Always Complete | This switch describes whether the completeness status for misfire monitors in PID $01 and PID $41 is calculated or always indicated as complete for compression ignition engines (DemGeneralOBD/DemOBDEngineType == DEM_IGNITION_COMPRESSION). For spark ignition engines, misfire monitors will always indicate completed indepently of this parameter value. True: Misfire monitoring is always reported as complete. False: Completeness of misfire monitors is calculated.
        boolean DemOBDPermanentDtcImmediateReport [0..1]: set at pre-compile, origin=Vector Informatik, default-value=false  # OBD II PermanentDtc Immediate Report | Only relevant for OBD II legislation. TRUE: All Permanent Dtcs are available via OBD mode 0A immediately after WIR bit is visible FALSE: Only 0-trip DTCs are visible in mode 0A immediately, all other DTCs only after OBD driving cycle is restarted.
        boolean DemOBDPermanentForWWHOBD [0..1]: set at pre-compile in variant post-build-loadable+pre-compile / post-build in variant post-build-selectable, origin=Vector Informatik, default-value=false  # OBD Support Permanent DTC for WWHOBD | Only relevant for WWH-OBD legislation. If enabled, class A or B1 DTCs commanding the MIL can store a permanent DTC. See Technical Reference for OBD for more details.
        reference DemOBDInputAcceleratorPedalInformation [0..1]: scope=ECU, set at pre-compile, origin=Vector Informatik, destination=DemDataClass  # OBDInput Accelerator Pedal Information | Input variable for the accelerator pedal information, which is assigned to a specific data element used as interface for the Dem-internal PID calculations. (not supported)
        reference DemOBDInputAmbientPressure [0..1]: scope=ECU, set at pre-compile, origin=Vector Informatik, destination=DemDataClass  # OBDInput Ambient Pressure | Input variable for the ambient pressure, which is assigned to a specific data element used as interface for the Dem-internal PID calculations. (not supported)
        reference DemOBDInputAmbientTemperature [0..1]: scope=ECU, set at pre-compile, origin=Vector Informatik, destination=DemDataClass  # OBDInput Ambient Temperature | Input variable for the ambient temperature, which is assigned to a specific data element used as interface for the Dem-internal PID calculations. (not supported)
        reference DemOBDInputDistanceInformation [0..1]: scope=ECU, set at pre-compile, origin=Vector Informatik, destination=DemDataClass  # OBDInput Distance Information | This reference requests the current odometer for PID21, PID31 and permanent DTC storage activation distance calculation, therefore this reference is mandatory if one those features is supported. The returned odometer value (4 Byte) must have a resolution of 1 kilometer or 1 mile. If no valid odometer is available the return value must be E_NOT_OK. Furthermore the permanent DTC storage activation distance calculation is not performed until a valid odometer value is received.
        reference DemOBDInputEngineSpeed [0..1]: scope=ECU, set at pre-compile, origin=Vector Informatik, destination=DemDataClass  # OBDInput Engine Speed | Input variable for the engine speed, which is assigned to a specific data element used as interface for the Dem-internal PID calculations. (not supported)
        reference DemOBDInputEngineTemperature [0..1]: scope=ECU, set at pre-compile, origin=Vector Informatik, destination=DemDataClass  # OBDInput Engine Temperature | Input variable for the engine temperature, which is assigned to a specific data element used as interface for the Dem-internal PID calculations. (not supported)
        reference DemOBDInputProgrammingEvent [0..1]: scope=ECU, set at pre-compile, origin=Vector Informatik, destination=DemDataClass  # OBDInput Programming Event | Input variable for the programming event, which is assigned to a specific data element used as interface for the Dem-internal PID calculations. (not supported)
        reference DemOBDInputVehicleSpeed [0..1]: scope=ECU, set at pre-compile, origin=Vector Informatik, destination=DemDataClass  # OBDInput Vehicle Speed | Input variable for the vehicle speed, which is assigned to a specific data element used as interface for the Dem-internal PID calculations. (not supported)
        reference DemOBDTimeSinceEngineStart [0..1]: set at pre-compile, origin=Vector Informatik, destination=DemDataClass  # This reference requests the current engine runtime for PID4D, PID4E, WWH-OBD aging and B1 counter calculation, therefore this reference is mandatory if one those features is supported. The returned engine runtime value (4 Byte) must have a resolution of 1 minute. If no valid engine runtime is available the return value must be E_NOT_OK.
        container DemCallbackOBDDTCStatusChanged [0..0]  # The presence of this container indicates, that the Dem has access to a "DTCStatusChanged" callback, which the Dem will call to notify other components about the change in the status of a DTC. (not supported)
          function name DemCallbackDTCStatusChangedFnc [0..1]: scope=ECU, set at pre-compile  # Function name of prototype "DTCStatusChanged". (not supported)
      container DemGroupOfDTC [0..4]  # This container represents a DTC group. DTC groups can be cleared by service $14, if allowed by the OEM specification. In case only $14 FFFFFF shall be offered, it is recommended to not configure DTC groups. Defined groups are sorted according their 'DemGroupDTCs' value in increasing sequence and get assigned these semantics: (1) PowertrainGroup, (2) ChassisGroup, (3) BodyGroup, (4) NetworkGroup. For example when you define only 2 groups, the lower GroupDTC value represents the PowertrainGroup, the higher GroupDTC value represents the ChassisGroup. Undefined are Body- and NetworkGroup.
        integer DemGroupDTCs: 1..16777214, scope=ECU, set at pre-compile, symbolic-name-value=true  # Group DTCs | DTC value of the selected group of DTC. A clear DTC request for this number will clear all DTCs that belong to this group.
      container DemIndicator [0..255]  # This container represents a warning indicator (e.g. indicator lamp).
        integer DemIndicatorID: 0..255, scope=ECU, set at pre-compile, symbolic-name-value=true, default-value=255  # Internal identifier of the indicator. This number is calculated internally and shall not be configured manually. This parameter is only available to publish the result of this calculation. Applications using Dem APIs must not rely on the value of this parameter. Instead, they must use the symbolic constant (SymbolicNameValue) DemConf_DemIndicator_{SHORT-NAME}.
      container DemNvRamBlockId [0..*]  # NvRam BlockId | This container represent a non-volatile memory block used by the Dem. If no permanent storage of event memory entries is required, no block needs to be configured.
        integer DemNvRamBlockIdIndex [0..1]: 0..255, set at pre-compile, origin=Vector Informatik  # NvRam BlockId Index | For non-unique block types, this index identifies the exact block (see DemNvRamBlockIdType). This parameter must NOT exist with NvBlocks of following kind: ADMIN, STATUS, MIRROR, PERMANENT, FREEZEFRAME, OBDIUMPR, DEBOUNCE, AVAILABILITY, DTR, CYCLECOUNTER, AGING. This parameter must have a unique value for all NvBlocks of following kind: PRIMARY, SECONDARY, TIMESERIES. The index values must complete the range 0 - (DemMaxNumberEventEntryPrimary-1), resp. the range 0 - (DemMaxNumberEventEntrySecondary-1), resp. the range 0 - (DemMaxNumberTimeSeriesSnapshots-1). The value is necessary to store the correct memory entry in case it was changed.
        enumeration DemNvRamBlockIdType: {DEM_NVBLOCK_ADMIN, DEM_NVBLOCK_STATUS, DEM_NVBLOCK_PRIMARY, DEM_NVBLOCK_SECONDARY, DEM_NVBLOCK_PERMANENT, DEM_NVBLOCK_MIRROR, DEM_NVBLOCK_FREEZEFRAME, DEM_NVBLOCK_OBDIUMPR, DEM_NVBLOCK_DEBOUNCE, DEM_NVBLOCK_AVAILABILITY, DEM_NVBLOCK_TIMESERIES, DEM_NVBLOCK_DTR, DEM_NVBLOCK_AGING, DEM_NVBLOCK_CYCLECOUNTER}, set at pre-compile, origin=Vector Informatik  # NvRam BlockId Type | Usage kind of this NvBlock. This parameter is used to identify which block data needs to be stored when event data is modified. Following block types exist at most once: ADMIN: Always required. STATUS: Always required. MIRROR: Only required if DemGeneral/DemMaxNumberEventEntryMirror > 0. PERMANENT: Only required if DemGeneral/DemMaxNumberEventEntryPermanent > 0. FREEZEFRAME: Only required if DemGeneral/DemOBDSupport is enabled and DemGeneral/DemGeneralOBD/DemOBDLegislation == OBDII. OBDIUMPR: Only required if DemGeneral/DemOBDSupport is enabled and DemGeneral/DemRatioId containers are configured. DEBOUNCE: Only required if any event uses CounterBased Debouncing with DemDebounceCounterStorage==TRUE. AVAILABILITY: Only required if event availability status is persisted in non-volatile memory due DemAvailabilityStorage==TRUE. DTR: Only required if DemGeneral/DemOBDSupport is enabled and if DemConfigSet/DemDtrs/DemDtr container exist or DemGeneral/DemPostBuild/DemMaxNumberEventEntryPermanent > 0 AGING: Only required if aging data is persisted in non-volatile memory due to DemGeneral/DemSupportAgingForAllDTCs==TRUE or if DemGeneral/DemDataClass/DemDataElementInternalData == AGED_COUNTER is used. CYCLECOUNTER: Only required if cycle counter data is persisted in non-volatile memory due to DemGeneral/DemSupportStorageIndependentCycleCounters ==TRUE. Following block types can exist several times, depending on the configuration: PRIMARY: The number of containers of this type must match DemGeneral/DemMaxNumberEventEntryPrimary. SECONDARY: The number of containers of this type must match DemGeneral/DemMaxNumberEventEntrySecondary. TIMESERIES: The number of containers of this type must match DemGeneral/DemMaxNumberTimeSeriesSnapshots
        symbolic name reference DemNvRamBlockIdRef: set at pre-compile, origin=AUTOSAR_ECUC V1.0.0, destination=NvMBlockDescriptor  # NvRam BlockId Ref | This reference contains the link to a non-volatile memory block. For post build time configurations worst case scenario shall be used to store the largest appearing data.
      container DemOperationCycle [1..16]  # OperationCycle | This container represents a monitoring cycle. They are used to control event monitoring and aging. Although this container does not define a symbolic name value, one is generated nonetheless.
        boolean DemOperationCycleAutomaticEnd: scope=ECU, set at pre-compile, default-value=false  # OperationCycle Automatic End | If configured to true the DEM automatically ends the cycle during ECU restart (e.g. in Dem_Shutdown or Dem_Init). Otherwise the application has to end the cycle by calling Dem_SetOperationCycleState with state DEM_CYCLE_STATE_END. This option is only relevant when DemOperationCycleStatusStorage is TRUE.
        boolean DemOperationCycleAutostart: scope=ECU, set at pre-compile, default-value=false  # OperationCycle Automatic Start | The autostart property defines if the operation cycles is automatically (re-)started during Dem_PreInit. (Not supported, please use DemGeneral/DemRestartCycleOnInitRef instead)
        enumeration DemOperationCycleType: {DEM_OPCYC_IGNITION, DEM_OPCYC_OBD_DCY, DEM_OPCYC_OTHER, DEM_OPCYC_POWER, DEM_OPCYC_TIME, DEM_OPCYC_WARMUP, DEM_OPCYC_IGNITION_HYBRID}, scope=ECU, set at pre-compile, default-value=DEM_OPCYC_OTHER  # OperationCycle Type | Select the operation cycle type. This value only has an effect in case of OBD ECUs, as certain actions are triggered by legislated cycle types. Note: As there is no way to read the value of the parameter at run time, the short name of the DemOperationCycle container should have a meaningful name.
      container DemRatioId [0..65534]  # RatioId | This container contains the OBD specific ratio Id configuration. It is related to a specific event, a FID, and an IUMPR group.
        enumeration DemIUMPRDenGroup: {DEM_IUMPR_DEN_NONE, DEM_IUMPR_DEN_PHYS_API, DEM_IUMPR_DEN_COLDSTART, DEM_IUMPR_DEN_EVAP, DEM_IUMPR_DEN_500MI, DEM_IUMPR_DEN_INDEPENDENT}, scope=ECU, set at post-build in variant post-build-loadable+post-build-selectable / pre-compile in variant pre-compile, origin=Vector Informatik  # Dem IUMPR Denominator Group | This parameter specifies the assigned denominator type which is applied in addition to the General Denominator conditions. NONE: The denominator is calculated based on the general individual denominator conditions. PHYS_API: The denominator is calculated based on the general individual denominator conditions. The denominator can be locked via dedicated APIs. COLDSTART, EVAP, 500MI: The denominator is calculated based on the general individual denominator conditions and additional conditions that must be fulfilled before the denominator is incremented. INDEPENDENT: Denominator may be incremented independently of the general individual denominator. The denominator may be locked via dedicated APIs.
        enumeration DemIUMPRGroup: {DEM_IUMPR_BOOSTPRS, DEM_IUMPR_CAT1, DEM_IUMPR_CAT2, DEM_IUMPR_EGR, DEM_IUMPR_EGSENSOR, DEM_IUMPR_EVAP, DEM_IUMPR_NMHCCAT, DEM_IUMPR_NOXADSORB, DEM_IUMPR_NOXCAT, DEM_IUMPR_OXS1, DEM_IUMPR_OXS2, DEM_IUMPR_PMFILTER, DEM_IUMPR_PRIVATE, DEM_IUMPR_SAIR, DEM_IUMPR_SECOXS1, DEM_IUMPR_SECOXS2, DEM_IUMPR_FLSYS, DEM_IUMPR_AFRI1, DEM_IUMPR_AFRI2, DEM_IUMPR_PF1, DEM_IUMPR_PF2}, scope=ECU, set at post-build in variant post-build-loadable+post-build-selectable / pre-compile in variant pre-compile, origin=Vector Informatik  # This parameter specifies the assigned IUMPR group of the ratio Id.
        enumeration DemRatioIdType: {DEM_RATIO_API, DEM_RATIO_OBSERVER}, set at pre-compile, origin=Vector Informatik  # RatioId Type | This parameter specifies how the numerator of the ratio is calculated: OBSERVER: The numerator is incremented whenever a test result is reported. This setting is used for symmetrical monitors. API: The numerator is incremented if the related monitoring function is able to detect a fault (reported by dedicated API). This setting is used for asymmetrical monitors.
        reference DemDiagnosticEventRef: set at pre-compile, origin=Vector Informatik, destination=DemEventParameter  # This reference contains the link to a diagnostic event.
        symbolic name reference DemFunctionIdRef: set at pre-compile, origin=Vector Informatik, destination=FiMFID  # FunctionId Ref | This reference contains the link to a function identifier within the FiM which is used as a primary FID. The FID is used to disable IUMPR calculation in case of an input fault.
        symbolic name reference DemSecondaryFunctionIdRef [0..*]: set at pre-compile, origin=Vector Informatik, destination=FiMFID  # Secondary FunctionId Ref | This reference contains the link to a function identifier within the FiM which is used as a secondary FID. The FID is used to disable IUMPR calculation in case of an input fault.
      container DemRatio [0..0]  # Ratio | (Not supported yet, please use the AUTOSAR 4.0.3 compliant definition in /Dem/DemGeneral/DemRatioId) This container contains the OBD specific ratio Id configuration. It is related to a specific event, a FID, and an IUMPR group.
        enumeration DemIUMPRDenGroup: {DEM_IUMPR_DEN_500MILL, DEM_IUMPR_DEN_COLDSTART, DEM_IUMPR_DEN_EVAP, DEM_IUMPR_DEN_NONE, DEM_IUMPR_DEN_PHYS_API}, set at pre-compile  # Dem IUMPR Denominator Group | (Not supported yet, please use the AUTOSAR 4.0.3 compliant definition in /Dem/DemGeneral/DemRatioId) This parameter specifies the assigned denominator type which is applied in addition to the General Denominator conditions. NONE: The denominator is calculated based on the general denominator conditions. PHYS_API: The denominator can be locked via dedicated APIs. COLDSTART, EVAP, 500MILL: Additional conditions must be fulfilled before the denominator is incremented.
        enumeration DemIUMPRGroup: {DEM_IUMPR_BOOSTPRS, DEM_IUMPR_CAT1, DEM_IUMPR_CAT2, DEM_IUMPR_EGR, DEM_IUMPR_EGSENSOR, DEM_IUMPR_EVAP, DEM_IUMPR_FLSYS, DEM_IUMPR_NMHCCAT, DEM_IUMPR_NOXADSORB, DEM_IUMPR_NOXCAT, DEM_IUMPR_OXS1, DEM_IUMPR_OXS2, DEM_IUMPR_PMFILTER, DEM_IUMPR_PRIVATE, DEM_IUMPR_SAIR, DEM_IUMPR_SECOXS1, DEM_IUMPR_SECOXS2}, set at pre-compile  # (Not supported yet, please use the AUTOSAR 4.0.3 compliant definition in /Dem/DemGeneral/DemRatioId) This parameter specifies the assigned IUMPR group of the ratio Id. Currently it is not used by the DEM and has no effect.
        integer DemRatioId: 0..65535, set at pre-compile, symbolic-name-value=true  # (Not supported yet, please use the AUTOSAR 4.0.3 compliant definition in /Dem/DemGeneral/DemRatioId) Defines a unique ratio Id.
        enumeration DemRatioKind: {DEM_RATIO_API, DEM_RATIO_OBSERVER}, set at pre-compile  # RatioId Kind | (Not supported yet, please use the AUTOSAR 4.0.3 compliant definition in /Dem/DemGeneral/DemRatioId) This parameter specifies how the numerator of the ratio is calculated: OBSERVER: The numerator is incremented whenever a test result is reported. This setting is used for symmetrical monitors. API: The numerator is incremented if the related monitoring function is able to detect a fault (reported by dedicated API). This setting is used for asymmetrical monitors.
        reference DemDiagnosticEventRef: set at pre-compile, destination=DemEventParameter  # (Not supported yet, please use the AUTOSAR 4.0.3 compliant definition in /Dem/DemGeneral/DemRatioId) This reference contains the link to a diagnostic event.
        symbolic name reference DemFunctionIdRef: set at pre-compile, destination=FiMFID  # FunctionId Ref | (Not supported yet, please use the AUTOSAR 4.0.3 compliant definition in /Dem/DemGeneral/DemRatioId) This reference contains the link to a function identifier within the FiM which is used as a primary FID. The FID is used to disable IUMPR calculation in case of an input fault.
        symbolic name reference DemSecondaryFunctionIdRef [0..*]: set at pre-compile, destination=FiMFID  # Secondary FunctionId Ref | (Not supported yet, please use the AUTOSAR 4.0.3 compliant definition in /Dem/DemGeneral/DemRatioId) This reference contains the link to a function identifier within the FiM which is used as a secondary FID. The FID is used to disable IUMPR calculation in case of an input fault.
      container DemStorageCondition [0..255]  # StorageCondition | This container represents a single storage condition. Please note: storage conditions can not be used directly but must be grouped (see DemStorageConditionGroup).
        integer DemStorageConditionId: 0..255, scope=ECU, set at pre-compile, symbolic-name-value=true, default-value=255  # StorageCondition Id | Internal identifier of the storage condition. This number is calculated internally and shall not be configured manually. This parameter is only available to publish the result of this calculation. Applications using Dem APIs must not rely on the value of this parameter. Instead, they must use the symbolic constant (SymbolicNameValue) DemConf_DemStorageCondition_{SHORT-NAME}.
        boolean DemStorageConditionStatus: set at pre-compile, default-value=true  # StorageCondition Status | Defines the initial status of this enable condition. The initial value will be set during pre-initialization in Dem_PreInit() and is never stored persistently.
      container DemStorageConditionGroup [0..255]: post-build-changeable=true  # StorageCondition Group | This container groups several storage conditions. EventParameters only reference one of these groups, not individual storage conditions.
        reference DemStorageConditionRef [1..255]: scope=ECU, set at post-build in variant post-build-loadable+post-build-selectable / pre-compile in variant pre-compile, origin=AUTOSAR_ECUC V1.0.0, destination=DemStorageCondition  # StorageCondition Ref | References an storage condition.
      container DemPidConfiguration [0..1]  # PID Configuration | This container contains options controlling the support of OBD PIDs by the Dem module.
        boolean DemSupportPid01 [0..1]: set at pre-compile, origin=Vector Informatik, default-value=true  # Support PID 01 | Monitor status since DTCs were last cleared.
        boolean DemSupportPid1C [0..1]: set at pre-compile, origin=Vector Informatik, default-value=true  # Support PID 1C | OBD requirements to which the vehicle is designed.
        boolean DemSupportPid21 [0..1]: set at pre-compile, origin=Vector Informatik, default-value=false  # Support PID 21 | Distance travelled while MIL is active.
        boolean DemSupportPid30 [0..1]: set at pre-compile, origin=Vector Informatik, default-value=true  # Support PID 30 | Number of WarmUp cycles since DTCs were last cleared.
        boolean DemSupportPid31 [0..1]: set at pre-compile, origin=Vector Informatik, default-value=false  # Support PID 31 | Distance since DTCs were last cleared.
        boolean DemSupportPid41 [0..1]: set at pre-compile, origin=Vector Informatik, default-value=true  # Support PID 41 | Monitor status of this driving cycle.
        boolean DemSupportPid4D [0..1]: set at pre-compile, origin=Vector Informatik, default-value=false  # Support PID 4D | Engine run time while MIL is active.
        boolean DemSupportPid4E [0..1]: set at pre-compile, origin=Vector Informatik, default-value=false  # Support PID 4E | Engine run time since DTCs were last cleared
        boolean DemSupportPid91 [0..1]: set at pre-compile, origin=Vector Informatik, default-value=false  # Support PID 91 | WWH-OBD ECU OBD System Information
        boolean DemSupportVid08 [0..1]: set at pre-compile, origin=Vector Informatik, default-value=false  # Support VID 08 | In-use performance tracking - spark ignition vehicle. This parameter is not supported.
        boolean DemSupportVid0B [0..1]: set at pre-compile, origin=Vector Informatik, default-value=false  # Support VID 0B | In-use performance tracking - compression ignition vehicle. This parameter is not supported.
      container DemMILGroup [0..65534]  # This container represents a group of events that use a common trip counter to determine their MIL status. Incrementing the common trip counter is triggered by any event of the MIL group. Healing is performed individually for each event of the MIL group, but the common trip counter is only reset after all events of the group have been healed. The reference to a MIL group is configured at the DTCClass container.
      container DemPostbuild  # The content of this container is only relevant for the implementation variant PostBuild (POST-BUILD-LOADABLE). For implementation variant PreCompile (and therfore PostBuild-Selectable without -Loadable) all contained parameters are ignored.
        boolean DemEventAvailableDefaultSupport: set at pre-compile, origin=Vector Informatik, default-value=true  # Select whether the default availability value should be initialized with Dem_Init() TRUE: Use the default values from configuration parameter DemConfigSet/DemEventParameter/DemEventAvailable to set the initial value during Dem_Init() FALSE: The availability information is not changed during Dem_Init() If this setting is enabled, API Dem_SetEventAvailable cannot be used before Dem_Init() due to Dem_Init() overwriting the active setting.
        integer DemMaxSizeFreezeFrame: 0..65535, category=POST_BUILD_SPECIFIC, set at pre-compile, origin=Vector Informatik, default-value=0  # Max Size FreezeFrame | Enlarge the (RAM/NvRAM) size of the largest FreezeFrame record. This parameter is mandatory for implementation variant PostBuild-Loadable, it will be ignored for other implementation variants. It represents the size of largest defined FreezeFrame record. The minimum value is auto-calculated when you start "Validate" or "Generate" - set value 0 to force the recalculation of the min value. For PostBuild-Loadable variants, during the pre-compile configuration phase you can enlarge the value to reserve additional space in the NvRAM blocks. Later in the post-build phase you can choose different DIDs (or a different number of DIDs) for a defined FreezeFrame - as long as the size of the new selected DIDs still fit into the reserved space. Take care: for PostBuild-Loadable implementation variants the auto-calculation will only increase the value (when it is smaller than the configured, largest FreezeFrame's size. Changing the FreezeFrame's DIDs afterwards may shorten the largest FreezeFrame's size - but this will NOT decrease this value again! Set the value to '0' and start "Validate" or "Generate" for the DEM to calculate again the minimum size. "Size of a freeze frame" is calculated as: Summarize the size of all referred DemDidClasses in a DemGeneral/DemFreezeFrameClass. The size of a DidClass is calculated as: Summarize the size of all referred DemNNDataElementClass elements by adding their DemDataElementDataSize values.
        integer DemMaxNumberDtr: 0..65535, category=POST_BUILD_SPECIFIC, set at pre-compile, origin=Vector Informatik, default-value=0  # Max Number Dtr | Enlarge the (RAM/NvRAM) to store an upper limit of Dtr elements. This parameter is mandatory for implementation variant PostBuild-Loadable, it will be ignored for other implementation variants. It represents an upper limit to the maximum value (+1) of the DemDtrId, calculated over all variants. This maximum value is auto-calculated when you start "Validate" or "Generate" - set value 0 to force the recalculation of the min value. For PostBuild-Loadable variants, during the pre-compile configuration phase you can enlarge the value to reserve additional number of Dtr elements. Later in the post-build phase you can change Dtr configuration (also create and delete Dtrs) - as long as the maximum value (+1) of the DemDtrId calculated over all variants is smaller than this value. Take care: for PostBuild-Loadable implementation variants the auto-calculation will only increase the value (when it is smaller than the configured). Deleting Dtrs afterwards may decrease the lowest possible value - but this will NOT decrease this configured value again! Set the value to '0' and start "Validate" or "Generate" for the DEM to calculate again the minimum size.
        integer DemMaxSizeGlobalFreezeFrame: 0..65535, set at pre-compile, origin=Vector Informatik, default-value=0  # Enlarge the (RAM/NvRAM) size of the global freeze frame record. This parameter is mandatory for implementation variant PostBuild-Loadable, it will be ignored for other implementation variants. It represents the size of the global freeze frame record. The minimum value is auto-calculated when you start "Validate" or "Generate" - set value 0 to force the recalculation of the min value. For PostBuild-Loadable variants, during the pre-compile configuration phase you can enlarge the value to reserve additional space in the NvRAM blocks. Later in the post-build phase you can choose different DIDs (or a different number of DIDs) for the global freeze frame - as long as the size of the new selected DIDs still fits into the reserved space. Take care: for PostBuild-Loadable implementation variants the auto-calculation will only increase the value (when it is smaller than the configured global freeze frame size. Changing the freeze frame's DIDs afterwards may shorten the global freeze frame size - but this will NOT decrease this value again! Set the value to '0' and start "Validate" or "Generate" for the DEM to calculate again the minimum size. "Size of the global freeze frame" is calculated as: Summarize the size of all referred DemDidClasses in the DemGeneral/DemGlobalFreezeFrame/DemGlobalFreezeFrameClassRef. The size of a DidClass is calculated as: Summarize the size of all referred DemDataClass elements by adding their DemDataElementDataSize values.
      container DemTimeSeriesSnapshot [0..1]  # (not supported)
        integer DemTimeSeriesNormalRatePastSamples: 0..32, set at pre-compile, origin=Vector Informatik, default-value=2  # (not supported)
        integer DemTimeSeriesNormalRateFutureSamples: 0..32, set at pre-compile, origin=Vector Informatik, default-value=1  # (not supported)
        integer DemTimeSeriesFastRatePastSamples: 0..32, set at pre-compile, origin=Vector Informatik, default-value=0  # (not supported)
        integer DemTimeSeriesFastRateFutureSamples: 0..32, set at pre-compile, origin=Vector Informatik, default-value=0  # (not supported)
        float DemTimeSeriesNormalRateTime: 0.001..2678400, set at pre-compile, origin=Vector Informatik, default-value=1  # (not supported)
        float DemTimeSeriesFastRateTime: 0.001..2678400, set at pre-compile, origin=Vector Informatik, default-value=0.01  # (not supported)
        integer DemTimeSeriesNormalSampleBufferSize: 1..65535, set at pre-compile, origin=Vector Informatik  # (not supported)
        integer DemTimeSeriesFastSampleBufferSize: 1..65535, set at pre-compile, origin=Vector Informatik  # (not supported)
      container DemGlobalFreezeFrame [0..1]  # In this container the attributes and content of the global freeze frame can be configured. If this container is configured, global freeze frame data is stored for each event (In addition to Dem/DemConfigSet/DemEventParameter/DemFreezeFrameClassRef).
        integer DemGlobalFreezeFrameRecordNumber: 1..254, set at pre-compile, origin=Vector Informatik  # This parameter defines the record number of the global freeze frame.
        enumeration DemGlobalFreezeFrameRecordUpdate: {DEM_UPDATE_RECORD_NO}, set at pre-compile, origin=Vector Informatik  # This parameter defines, whether the global freeze frame is updated with each trigger. DEM_UPDATE_RECORD_NO: The global freeze frame is captured only once. DEM_UPDATE_RECORD_YES: The global freeze frame is captured with each trigger, overwriting the previously captured data (currently not supported).
        enumeration DemGlobalFreezeFrameRecordTrigger: {DEM_RECORD_TRIGGER_CONFIRMED}, set at pre-compile, origin=Vector Informatik  # This parameter defines the trigger to store the global freeze frame. Currently only trigger CONFIRMED is supported. FDC: The global freeze frame capture is triggered by a fault detection counter passing a storage threshold. CONFIRMED: The global freeze frame capture is triggered by the ConfirmedDTC transition from 0 to 1. PENDING: The global freeze frame capture is triggered by the PendingDTC transition from 0 to 1. TESTFAILED: The global freeze frame capture is triggered by the TestFailed transition from 0 to 1. TESTFAILED_FIRST_IN_CYCLE: The global freeze frame capture is triggered by the first TestFailed transition from 0 to 1 in an operation cycle. FDC_FIRST_IN_CYCLE: The global freeze frame capture is triggered by the first DTC fault detection counter reaching the storage threshold in an operation cycle. Please note that triggers occuring before an event memory entry is allocated are discarded.
        reference DemGlobalFreezeFrameClassRef: set at pre-compile, origin=Vector Informatik, destination=DemFreezeFrameClass  # This parameter references the list of DIDs to be stored in the global freeze frame.
  module config Dem_Pre: definition=Dem
  module config Dem_Rec: definition=Dem
