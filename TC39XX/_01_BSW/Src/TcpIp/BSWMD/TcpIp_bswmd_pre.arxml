AUTOSAR XML (schema 4-2-1)
package /MICROSAR
  module config TcpIp_Pre: definition=TcpIp
    TcpIpGeneral
      TcpIpGeneration: TcpIpBoolDataInArrayOfStructStrategy=BOOLEAN
