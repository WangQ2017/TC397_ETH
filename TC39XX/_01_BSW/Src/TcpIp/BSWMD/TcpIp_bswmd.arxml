AUTOSAR XML (schema 4-2-1)
package /MICROSAR
  module definition TcpIp [0..1]: category=VENDOR_SPECIFIC_MODULE_DEFINITION, post-build-variant-support=true, refined-module-def=TcpIp, variants pre-compile  # Configuration of the TcpIp (TCP/IP stack) module.
    container TcpIpConfig: multiplicity set at pre-compile  # This container contains the configuration parameters and sub containers of the AUTOSAR TcpIp module.
      container TcpIpCtrl [1..*]: multiplicity set at pre-compile  # Specifies the EthIf controller used for IP communication and TcpIp errors that shall be reported to DEM.
        integer TcpIpIpFramePrioDefault [0..1]: 0..7, multiplicity set at pre-compile, post-build-variant-multiplicity=true, post-build-variant-value=true, set at pre-compile, default-value=0  # IP Frame Prio Default | Specifies the default value for the frame priority used by all sockets. | Note: the value can be changed for each socket individually via TcpIp_ChangeParameter() service. If this optional parameter is not available, 0 is used as default priority.
        reference TcpIpDhcpServerConfigRef [0..1]: multiplicity set at pre-compile, post-build-variant-value=true, set at pre-compile, destination=TcpIpDhcpServerConfig  # DHCP Server Config Ref | Reference to a TcpIpDhcpServerConfig which shall be used for this controller setting (VLAN).
        symbolic name reference TcpIpEthIfCtrlRef: multiplicity set at pre-compile, post-build-variant-value=true, set at pre-compile, destination=EthIfController  # EthIf Ctrl Ref | Reference to EthIf controller where the IP address shall be assigned.
        reference TcpIpIpSecConfigSetRef [0..1]: multiplicity set at pre-compile, origin=Vector Informatik, set at pre-compile, destination=TcpIpIpSecConfigSet  # Reference to set of SDP entries which shall be used for IPsec.
        container TcpIpCtrlDemEventParameterRefs [0..1]: multiplicity set at pre-compile  # This container is a subcontainer of TcpIpCtrl and specifies the references to DemEventParameter elements which shall be invoked using the API Dem_ReportErrorStatus API in case the corresponding TcpIp error occurs for communication on the EthIf Controller. The EventId is taken from the referenced DemEventParameter's DemEventId value. The standardized errors are provided in the container and can be extended by vendor specific error references.
          symbolic name reference TCPIP_E_CONNREFUSED [0..1]: multiplicity set at pre-compile, post-build-variant-multiplicity=true, post-build-variant-value=true, set at pre-compile, destination=DemEventParameter  # CONNREFUSED Error | Reference to the DemEventParameter which shall be issued when the error "Connection refused" has occurred.
          symbolic name reference TCPIP_E_HOSTUNREACH [0..1]: multiplicity set at pre-compile, post-build-variant-multiplicity=true, post-build-variant-value=true, set at pre-compile, destination=DemEventParameter  # HOSTUNREACH Error | Reference to the DemEventParameter which shall be issued when the error "No route to host" has occurred.
          symbolic name reference TCPIP_E_PACKETTOBIG [0..1]: multiplicity set at pre-compile, post-build-variant-multiplicity=true, post-build-variant-value=true, set at pre-compile, destination=DemEventParameter  # PACKETTOBIG Error | Reference to the DemEventParameter which shall be issued when the error "Path does not support frame size" has occurred.
          symbolic name reference TCPIP_E_TIMEDOUT [0..1]: multiplicity set at pre-compile, post-build-variant-multiplicity=true, post-build-variant-value=true, set at pre-compile, destination=DemEventParameter  # TIMEDOUT Error | Reference to the DemEventParameter which shall be issued when the error "Operation timed out" has occurred.
          symbolic name reference TCPIP_E_DUPLICATE_DHCP_ADDR [0..1]: multiplicity set at pre-compile, origin=Vector Informatik, post-build-variant-multiplicity=true, post-build-variant-value=true, set at pre-compile, destination=DemEventParameter  # Reference to the DemEventParameter which shall be issued when the Ecu received a frame which uses the same source IP address but a different MAC source address.
          symbolic name reference TCPIP_E_DISCARDED_AR_CACHE_ENTRY [0..1]: multiplicity set at pre-compile, origin=Vector Informatik, post-build-variant-multiplicity=true, post-build-variant-value=true, set at pre-compile, destination=DemEventParameter  # Reference to the DemEventParameter which shall be issued when an existing ARP entry was replaced by a new entry or a new entry could not be added to the ARP table because the max. number of entries has been reached.
        choice container TcpIpIpVXCtrl: multiplicity set at pre-compile  # Specifies whether this controller is an Internet Protocol version 4 (IPv4) or Internet Protocol version 6 (IPv4) instance.
          container TcpIpIpV4Ctrl [0..1]: multiplicity set at pre-compile  # Specifies an Internet Protocol version 4 (IPv4) instance.
            integer TcpIpIpTypeOfServiceDefault: 0..255, multiplicity set at pre-compile, origin=Vector Informatik, post-build-variant-value=true, set at pre-compile, default-value=0  # IP Type Of Service Default | This value specifies the default for the "Type of Service" field of the IPv4 header in outgoing packets on this IP controller.
            integer TcpIpIpCtrlIdx: 0..255, multiplicity set at pre-compile, origin=Vector Informatik, set at pre-compile, symbolic-name-value=true, default-value=0  # IPv4 Controller Index | IPv4 controller index (calculated automatically)
            integer TcpIpIpDefaultTtl: 0..255, multiplicity set at pre-compile, origin=Vector Informatik, post-build-variant-value=true, set at pre-compile, default-value=64  # Default Time To Live | This value specifies the default for the "Time to Live" field of the IPv4 header in outgoing packets on this IP controller. "The current recommended default time to live (TTL) for the Internet Protocol (IP) is 64 [RFC791], [RFC1122]." (see http://www.iana.org/assignments/ip-parameters/ip-parameters.xhtml#ip-parameters-2)
            reference TcpIpArpConfigRef [0..1]: multiplicity set at pre-compile, set at pre-compile, destination=TcpIpArpConfig  # ARP Config Ref | Reference to ARP configuration for this IPv4 instance. | (Multiple IPv4 instances may use the same configuration container but will operate independently)
            reference TcpIpAutoIpConfigRef [0..1]: multiplicity set at pre-compile, set at pre-compile, destination=TcpIpAutoIpConfig  # AutoIp Config Ref | Reference to AutoIp configuration for this IPv4 instance. | (Multiple IPv4 instances may use the same configuration container but will operate independently)
            reference TcpIpDhcpConfigRef [0..1]: multiplicity set at pre-compile, set at pre-compile, destination=TcpIpDhcpConfig  # DHCP Config Ref | Reference to DHCP configuration for this IPv4 instance. | (Multiple IPv4 instances may use the same configuration container but will operate independently)
            reference TcpIpFragmentationConfigRef [0..1]: multiplicity set at pre-compile, set at pre-compile, destination=TcpIpIpFragmentationConfig  # Reference to Fragmentation configuration for this IPv4 instance. | (Multiple IPv4 instances may use the same configuration container but will operate independently)
            reference TcpIpStaticArpTableRef [0..1]: multiplicity set at pre-compile, origin=Vector Informatik, set at pre-compile, destination=TcpIpStaticArpTable  # Static ARP Table Ref | Reference to a static ARP table that shall be used for this controller.
          container TcpIpIpV6Ctrl [0..1]: multiplicity set at pre-compile  # Specifies an Internet Protocol version 6 (IPv6) instance.
            integer TcpIpIpV6DefaultHopLimit: 0..255, multiplicity set at pre-compile, origin=Vector Informatik, post-build-variant-value=true, set at pre-compile, default-value=64  # Default Hop Limit | This value specifies the default Hop Limit for outgoing IPv6 packets. If "Allow Hop Limit Reconfiguration" is checked, the value may be reconfigured based on received Router Advertisements according to [RFC4861 6.3.4. Processing Received Router Advertisements].
            integer TcpIpIpV6DefaultTrafficClass: 0..255, multiplicity set at pre-compile, origin=Vector Informatik, post-build-variant-value=true, set at pre-compile, default-value=0  # Default Traffic Class | This value specifies the default 'Traffic Class' set in the IPv6 header of outgoing packets of this controller. This value may be changed to a socket specific value during runtime.
            integer TcpIpIpV6DefaultFlowLabel: 0..1048575, multiplicity set at pre-compile, origin=Vector Informatik, post-build-variant-value=true, set at pre-compile, default-value=0  # Default Flow Label | This value specifies the default 'FlowLabel' set in the IPv6 header of outgoing packets of this controller. This value may be changed to a socket specific value during runtime.
            integer TcpIpIpV6CtrlIdx: 0..255, multiplicity set at pre-compile, origin=Vector Informatik, set at pre-compile, symbolic-name-value=true, default-value=0  # Controller Index | IPv6 controller index (calculated automatically)
            reference TcpIpIpV6DhcpConfigRef [0..1]: multiplicity set at pre-compile, set at pre-compile, destination=TcpIpDhcpV6Config  # DHCP Config Ref | Reference to DHCPv6 configuration. | (Multiple IPv6 instances may use the same configuration container but will operate independently)
            reference TcpIpIpV6FragmentationConfigRef [0..1]: multiplicity set at pre-compile, set at pre-compile, destination=TcpIpIpV6FragmentationConfig  # Fragmentation Config Ref | Reference to IPv6 Fragmentation Configuration. | (Multiple IPv6 instances may use the same configuration container but will operate independently)
            reference TcpIpIpV6NdpConfigRef: multiplicity set at pre-compile, set at pre-compile, destination=TcpIpNdpConfig  # NDP Config Ref | Reference to Neighbor Discovery Protocol Configuration. | (Multiple IPv6 instances may use the same configuration container but will operate independently)
            reference TcpIpIpV6MldConfigRef [0..1]: multiplicity set at pre-compile, origin=Vector Informatik, set at pre-compile, destination=TcpIpIpV6MldConfig  # MLDv2 Configuration | Reference to Multicast Listener Discovery version 2 Configuration. If no reference is set, MLDv2 [RFC3810] is disabled on this IPv6 instance. (Multiple IPv6 instances may use the same configuration container but will operate independently)
            reference TcpIpIpV6PrivExtConfigRef [0..1]: multiplicity set at pre-compile, origin=Vector Informatik, set at pre-compile, destination=TcpIpIpV6PrivExtConfig  # Privacy Extensions Configuration | Reference to Privacy Extensions Configuration. If no reference is set, Privacy Extensions [RFC4941] are disabled on this IPv6 instance, (Multiple IPv6 instances may use the same configuration container but will operate independently)
            container TcpIpIpV6MtuConfig: multiplicity set at pre-compile  # This container specifies the Maximum Transmission Unit parameters for this IPv6 instance.
              integer TcpIpIpV6DefaultMtuSize: 1280..65535, multiplicity set at pre-compile, set at pre-compile, default-value=1500  # Default Mtu Size | Maximum Transmission Unit (MTU) of the link. | [RFC2460 5. Packet Size Issues] "IPv6 requires that every link in the internet have an MTU of 1280 octets or greater. On any link that cannot convey a 1280-octet packet in one piece, link-specific fragmentation and reassembly must be provided at a layer below IPv6. Links that have a configurable MTU (for example, PPP links [RFC-1661]) must be configured to have an MTU of at least 1280 octets; it is recommended that they be configured with an MTU of 1500 octets or greater, to accommodate possible encapsulations (i.e., tunneling) without incurring IPv6-layer fragmentation. From each link to which a node is directly attached, the node must be able to accept packets as large as that link's MTU."
              boolean TcpIpIpV6PathMtuEnabled: multiplicity set at pre-compile, set at pre-compile, default-value=false  # Path Mtu Enabled | If enabled the IPv6 processes incoming ICMPv6 "Packet Too Big" messages and stores a MTU value for each destination address. | See RFC1981 "Path MTU Discovery for IP version 6" for details about PathMTU.
              float TcpIpIpV6PathMtuTimeout: 0..86400, multiplicity set at pre-compile, set at pre-compile, default-value=600  # Path Mtu Timeout | If this value is >0 the IPv6 will reset the MTU value stored for each destination after n seconds. | see [RFC1981 5.3. Purging stale PMTU information] Default: 600 seconds (10 minutes)
      container TcpIpDhcpServerConfig [0..*]: multiplicity set at pre-compile  # Specifies the configuration parameters of the DHCP Server sub-module.
        string TcpIpDhcpDefaultRouter [0..1]: multiplicity set at pre-compile, post-build-variant-multiplicity=true, post-build-variant-value=true, set at pre-compile  # Default Router | IP address of default router (gateway).
        integer TcpIpDhcpNetmask [0..1]: 0..128, multiplicity set at pre-compile, post-build-variant-multiplicity=true, post-build-variant-value=true, set at pre-compile, default-value=24  # Netmask | Network mask of IPv4 address or address prefix of IPv6 address in CIDR Notation, i.e. decimal value between 0 and 32 (IPv4) or 0 and 128 (IPv6) that describes the number of significant bits defining the network number or prefix of an IP address.
        float TcpIpDhcpOfferValidTime: 0..4294967295, multiplicity set at pre-compile, origin=Vector Informatik, post-build-variant-value=true, set at pre-compile, default-value=5  # Offer Valid Time
        float TcpIpDhcpLeaseTimeMax [0..1]: 1..4294967295, multiplicity set at pre-compile, origin=Vector Informatik, post-build-variant-value=true, set at pre-compile, default-value=60  # Lease Time Max | This value specifies the maximum lease time. If a client requests a longer lease time the server will use this maximum value instead. If this parameter does not exists the maximum lease time is infinite.
        float TcpIpDhcpLeaseTimeMin: 1..4294967295, multiplicity set at pre-compile, origin=Vector Informatik, post-build-variant-value=true, set at pre-compile, default-value=60  # Lease Time Min | This value specifies the minimum lease time. If a client requests a shorter lease time the server will use this minimum value instead.
        float TcpIpDhcpLeaseTimeDefault [0..1]: 1..4294967295, multiplicity set at pre-compile, origin=Vector Informatik, post-build-variant-value=true, set at pre-compile, default-value=4294967295  # Lease Time Default | This value specifies the default lease time that is used if a client does not has requested a specific lease time. If this parameter does not exist the maximum lease time will be used as default.
        integer TcpIpDhcpMaxClientIdLen: 6..255, multiplicity set at pre-compile, origin=Vector Informatik, post-build-variant-value=true, set at pre-compile, default-value=7  # Max ClientId Len | This value specifies the maxumin length of a DHCP client identifier. A client identifier may be either the value of the 'chaddr' filed in the DHCP message header or the content of the client identifier option [RFC2132 9.14. Client-identifier]. A client identifer may be up to 255 bytes long but usually the client MAC address is used as client identifer. This value should be at least set to 7 in order to store the type (1 byte) and the address value (6 bytes).
        string TcpIpDhcpHostname [0..1]: multiplicity set at pre-compile, origin=Vector Informatik, post-build-variant-value=true, set at pre-compile, max-length=64, min-length=1  # Hostname | This parameter defines the value of the DHCP server name that will be sent in the 'sname' field of outgoing DHCPOFFER, DHCPACK and DHCPNAK messages.
        symbolic name reference TcpIpDhcpEthIfSwitchRef [0..1]: scope=ECU, multiplicity set at pre-compile, post-build-variant-multiplicity=true, post-build-variant-value=true, set at pre-compile, destination=EthIfSwitch  # EthIf Switch Ref | Reference to EthIfSwitch representation. | Optional in case the Dhcp server is operating without an Ethernet switch.
        container TcpIpDhcpAddressAssignment [0..*]: multiplicity set at pre-compile  # Defines a Ethernet Switch port based IP address assignment.
          string TcpIpDhcpAddressLowerBound: multiplicity set at pre-compile, post-build-variant-value=true, set at pre-compile  # Address Lower Bound | The lower bound IP address which shall be assigned. | If lower bound and upper bound are identical exactly this IP address shall be assigned.
          string TcpIpDhcpAddressUpperBound: multiplicity set at pre-compile, post-build-variant-value=true, set at pre-compile  # Address Upper Bound | The upper bound IP address which shall be assigned. | If lower bound and upper bound are identical exactly this IP address shall be assigned.
          symbolic name reference TcpIpDhcpSwitchPortRef [0..1]: scope=ECU, multiplicity set at pre-compile, post-build-variant-multiplicity=true, post-build-variant-value=true, set at pre-compile, destination=EthSwtPort  # Switch Port Ref | Reference to Ethernet Switch port. | Optional in case the Dhcp server is operating without an Ethernet switch.
      container TcpIpIpConfig [0..1]: multiplicity set at pre-compile  # Specifies the configuration parameters of the IP (Internet Protocol) sub-module
        container TcpIpIpV4Config [0..1]: multiplicity set at pre-compile  # Specifies the configuration parameters of the IPv4 (Internet Protocol version 4) sub-module.
          container TcpIpArpConfig [0..*]: multiplicity set at pre-compile  # Specifies the configuration parameters of the ARP (Address Resolution Protocol) sub-module.
            integer TcpIpArpNumGratuitousARPonStartup: 0..255, multiplicity set at pre-compile, post-build-variant-value=true, set at pre-compile, default-value=0  # Num Gratuitous ARP On Startup | Specifies the number of gratuitous ARP replies which shall be sent on assignment of a new IP address.
            boolean TcpIpArpPacketQueueEnabled: multiplicity set at pre-compile, set at pre-compile, default-value=true  # Packet Queue Enabled | Enables (TRUE) or disables (FALSE) support of the ARP Packet Queue according to IETF RFC 1122, section 2.3.2.2.
            float TcpIpArpTableEntryTimeout: 0..65535, multiplicity set at pre-compile, post-build-variant-value=true, set at pre-compile, default-value=30  # Table Entry Timeout | Timeout in seconds after which an unused ARP entry is removed. A value of 0 means that en entry will never be removed from the ARP table due to a timeout. If an entry in the ARP cache is used and has not been updated for the specified time, the ARP will revalidate the ARP entry by sending one or more ARP requests for the corresponding IP address. If the remote host does not send an ARP reply within the period specified by TcpIpArpRetryTime, the entry will be removed from the ARP table. If the ARP cache is full and TcpIpArpDiscardedEntryHandling is set to FALSE, an entry may be replaced by a new ARP entry based on a least recently used strategy before the timeout has expired.
            integer TcpIpArpTableSizeMax: 1..65535, multiplicity set at pre-compile, set at pre-compile, default-value=10  # Table Size Max | Maximum number of entries in the ARP table.
            float TcpIpArpRetryTime: 0.001..65535, multiplicity set at pre-compile, origin=Vector Informatik, post-build-variant-value=true, set at pre-compile, default-value=5  # Retry Timeout | This value specifies the maximum time for an ARP resolution. If no answer has been received before this time has expired, ARP resolution is canceled.
            float TcpIpArpRetryInterval: 0..65535, multiplicity set at pre-compile, origin=Vector Informatik, post-build-variant-value=true, set at pre-compile, default-value=2  # Retry Interval | This value specifies the ARP retry interval.
            float TcpIpArpRequestTimeout: 0..65535, multiplicity set at pre-compile, post-build-variant-value=true, set at pre-compile, default-value=1  # Specifies a timeout in seconds for the validity of ARP requests. After the transmission of an ARP request the TcpIp shall skip the transmission of any further ARP requests to the same destination within a duration of TcpIpArpRequestTimeout seconds. (IETF RFC 1122, section 2.3.2.1) The value of this parameter shall be an integral multiple of TcpIpMainFunctionPeriod or 0. If this Parameter set to 0 this feature is disabled and no delay between ARP requests is enforced. Specifies Timeout for outgoing ARP request, triggered by upperlayer. TcpIp will send only one ARP request during ArpRequestTimeout period,even if multiple Tx of ARP request is triggered by upperlayer. i.e. One ARP request transmission(Triggered by upperlayer) per one ArpRequestTimeout period.
          container TcpIpAutoIpConfig [0..*]: multiplicity set at pre-compile  # Specifies the configuration parameters of the Auto-IP (automatic private IP addressing) sub-module.
            float TcpIpAutoIpInitTimeout: 0..65.535, multiplicity set at pre-compile, post-build-variant-value=true, set at pre-compile, default-value=1  # Init Timeout | The time Auto-IP waits at startup, before beginning with ARP probing. This delay is used to give DHCP time to acquire a lease in case a DHCP server is present.
            integer TcpIpAutoIpProbeNum: 1..255, multiplicity set at pre-compile, origin=Vector Informatik, post-build-variant-value=true, set at pre-compile, default-value=1  # Probe Number | This value specifies the number of probe packets (RFC standard: 3)
            float TcpIpAutoIpProbeMin: 0..65.535, multiplicity set at pre-compile, origin=Vector Informatik, post-build-variant-value=true, set at pre-compile, default-value=0.4  # Probe Min Delay | This value specifies the minimum interval between probe messages (RFC standard: 1s)
            float TcpIpAutoIpProbeMax: 0..65.535, multiplicity set at pre-compile, origin=Vector Informatik, post-build-variant-value=true, set at pre-compile, default-value=0.6  # Probe Max Delay | This value specifies the maximum delay between probe messages (RFC standard: 2s)
            float TcpIpAutoIpAnnounceWait: 0..65.535, multiplicity set at pre-compile, origin=Vector Informatik, post-build-variant-value=true, set at pre-compile, default-value=0.5  # Announce Wait | This value specifies the delay before the first announcement message (RFC standard: 2s)
            integer TcpIpAutoIpAnnounceNum: 1..255, multiplicity set at pre-compile, origin=Vector Informatik, post-build-variant-value=true, set at pre-compile, default-value=1  # Announce Number | This value specifies the number of announcement packets (RFC standard: 2)
            float TcpIpAutoIpAnnounceInterval: 0..65.535, multiplicity set at pre-compile, origin=Vector Informatik, post-build-variant-value=true, set at pre-compile, default-value=0.4  # Announce Interval | This value specifies the interval between announcement packets (RFC standard: 2s)
            integer TcpIpAutoIpMaxConflicts: 1..255, multiplicity set at pre-compile, origin=Vector Informatik, post-build-variant-value=true, set at pre-compile, default-value=10  # Max Number Of Conflicts | This value specifies the maximum number of conflicts before rate limiting (RFC standard: 10) If the specified number of conflicts has been reached new address configurations attempts are rate limited by "Rate Limit Interval".
            float TcpIpAutoIpRateLimitInterval: 0..65.535, multiplicity set at pre-compile, origin=Vector Informatik, post-build-variant-value=true, set at pre-compile, default-value=5  # Rate Limit Interval | This value specifies the delay between successive address configuration attempts when rate limiting is active (RFC standard: 60s) see "Max Number Of Conflicts"
            float TcpIpAutoIpDefendInterval: 0..65.535, multiplicity set at pre-compile, origin=Vector Informatik, post-build-variant-value=true, set at pre-compile, default-value=5  # Defend Interval | This value specifies the minimum interval between defensive ARPs (RFC standard: 10s)
            float TcpIpAutoIpProbeWaitMax: 0..65.535, multiplicity set at pre-compile, origin=Vector Informatik, post-build-variant-value=true, set at pre-compile, default-value=7  # Probe Wait Max | This value specifies the maximum initial random delay before the first probe message is sent. (RFC standard: 1s)
            function name TcpIpAutoIpAddrCandidateCalloutFunction [0..1]: multiplicity set at pre-compile, origin=Vector Informatik, set at pre-compile  # IP Address Candidate Callout Function | This parameter specifies the name of a callout function that shall be called if an address candidate for link-local address assignment is required. Note: The callout should only return valid values from the range 169.254.1.0 to 169.254.254.255 (inclusive) according to [IETF RFC3927 2.1. Link-Local Address Selection]. If no callout is configured or the callout does not return an address candidate, the TcpIp will select a random address according to [IETF RFC3927].
            string TcpIpAutoIpAddrCandidateCalloutHeaderFile [0..1]: multiplicity set at pre-compile, origin=Vector Informatik, set at pre-compile  # IP Address Candidate Callout Function Header File | This parameter specifies the name of the header file containing the declaration for the function specified in TcpIpAutoIpAddrCandidateCalloutFunction.
          container TcpIpDhcpConfig [0..*]: multiplicity set at pre-compile  # Specifies the configuration parameters of the DHCPv4. The SocketOwner is informed via the TcpIpSocketOwnerDhcpEventName callback about the reception and transmission of options. | This container may be referenced by multiple IPv4 instances if they shall use the same configuration. This container may have multiple instances if different configurations are required for different IPv4 instances.
            float TcpIpDhcpV4InitWaitMin: 0..65535, multiplicity set at pre-compile, origin=Vector Informatik, post-build-variant-value=true, set at pre-compile, default-value=0.1  # Init Wait Min | Minimum initial delay for DISCOVER (RFC standard: 1s) RESTRICTIONS: 'DhcpV4InitWaitMin' is only available, if 'TcpIpEnableDhcpV4' is set to 'true'.
            float TcpIpDhcpV4InitWaitMax: 0..65535, multiplicity set at pre-compile, origin=Vector Informatik, post-build-variant-value=true, set at pre-compile, default-value=0.8  # Init Wait Max | Maximum initial delay for DISCOVER (RFC standard: 10s) RESTRICTIONS: 'DhcpV4InitWaitMax' is only available, if 'TcpIpEnableDhcpV4' is set to 'true'.
            integer TcpIpDhcpV4DiscoverMaxNum: 0..255, multiplicity set at pre-compile, origin=Vector Informatik, post-build-variant-value=true, set at pre-compile, default-value=5  # Discover Max Num | Maximum number of DISCOVER messages RESTRICTIONS: 'DhcpV4DiscoverMaxNum' is only available, if 'TcpIpEnableDhcpV4' is set to 'true'.
            float TcpIpDhcpV4DiscoverIntervalMin: 0..255, multiplicity set at pre-compile, origin=Vector Informatik, post-build-variant-value=true, set at pre-compile, default-value=2  # Discover Interval Min | Minimum DISCOVER interval RESTRICTIONS: 'DhcpV4DiscoverIntervalMin' is only available, if 'TcpIpEnableDhcpV4' is set to 'true'.
            float TcpIpDhcpV4DiscoverIntervalMax: 0..255, multiplicity set at pre-compile, origin=Vector Informatik, post-build-variant-value=true, set at pre-compile, default-value=30  # Discover Interval Max | Maximum DISCOVER interval RESTRICTIONS: 'DhcpV4DiscoverIntervalMax' is only available, if 'TcpIpEnableDhcpV4' is set to 'true'.
            integer TcpIpDhcpV4RequestMaxNum: 0..255, multiplicity set at pre-compile, origin=Vector Informatik, post-build-variant-value=true, set at pre-compile, default-value=6  # Request Max Num | Maximum number of REQUEST messages RESTRICTIONS: 'DhcpV4RequestMaxNum' is only available, if 'TcpIpEnableDhcpV4' is set to 'true'.
            float TcpIpDhcpV4RequestInterval: 0..255, multiplicity set at pre-compile, origin=Vector Informatik, post-build-variant-value=true, set at pre-compile, default-value=2  # Request Interval | REQUEST interval RESTRICTIONS: 'DhcpV4RequestInterval' is only available, if 'TcpIpEnableDhcpV4' is set to 'true'.
            float TcpIpDhcpV4RenewIntervalMin: 0..255, multiplicity set at pre-compile, origin=Vector Informatik, post-build-variant-value=true, set at pre-compile, default-value=5  # Renew Interval Min | Minimum Renew interval RESTRICTIONS: 'DhcpV4RenewIntervalMin' is only available, if 'TcpIpEnableDhcpV4' is set to 'true'.
            float TcpIpDhcpV4RebindIntervalMin: 0..255, multiplicity set at pre-compile, origin=Vector Informatik, post-build-variant-value=true, set at pre-compile, default-value=5  # Rebind Interval Min | Minimum Rebind interval RESTRICTIONS: 'DhcpV4RebindIntervalMin' is only available, if 'TcpIpEnableDhcpV4' is set to 'true'.
            integer TcpIpDhcpV4HostNameLenMax: 0..255, multiplicity set at pre-compile, origin=Vector Informatik, post-build-variant-value=true, set at pre-compile, default-value=30  # Host Name Length Max | Maximum support Host name length RESTRICTIONS: 'DhcpV4HostNameLenMax' is only available, if 'TcpIpEnableDhcpV4' is set to 'true'.
            boolean TcpIpDhcpV4RestartOnFail: multiplicity set at pre-compile, origin=Vector Informatik, set at pre-compile, default-value=false  # Restart On Failure | Restart the DHCP address assignment process if a used address lease times out and no lease update could be obtained. After the lease expires either the DHCP process is restarted or the process will be stopped completely (no new address assignment). RESTRICTIONS: 'TcpIpDhcpV4RestartOnFail' is only available, if 'TcpIpEnableDhcpV4' is set to 'true'.
            function name TcpIpDhcpV4RequestedAddrCalloutFunction [0..1]: multiplicity set at pre-compile, origin=Vector Informatik, set at pre-compile  # Requested IP Address Callout Function | This parameter specifies the name of a callout function that shall be called if an address candidate for DHCP address assignment is required. The returned IP address will be included via the 'Requested IP Address' option in the DHCPDISCOVER message. If no callout is configured or the callout does not return an address candidate, the 'Requested IP Address' is not contained in the DHCPDISCOVER message.
            string TcpIpDhcpV4RequestedAddrCalloutHeaderFile [0..1]: multiplicity set at pre-compile, origin=Vector Informatik, set at pre-compile  # Requested IP Address Callout Function Header File | This parameter specifies the name of the header file containing the declaration for the function specified in TcpIpDhcpV4RequestedAddrCalloutFunction.
            container TcpIpDhcpUserOption [0..*]: multiplicity set at pre-compile  # Configures DHCP user options which shall be transmitted/received by the DHCP client. RESTRICTION: User options are only available, if 'TcpIpEnableDhcpV4' is set to 'true'.
              integer TcpIpDhcpUserOptionCode: 1..254, multiplicity set at pre-compile, origin=Vector Informatik, post-build-variant-value=true, set at pre-compile  # Code of user option.
              integer TcpIpDhcpUserOptionLength: 1..255, multiplicity set at pre-compile, origin=Vector Informatik, post-build-variant-value=true, set at pre-compile  # Maximum support length of configured user option.
              enumeration TcpIpDhcpUserOptionDirection: {TCPIP_DHCP_USER_OPTION_RX, TCPIP_DHCP_USER_OPTION_TX, TCPIP_DHCP_USER_OPTION_RX_REQUESTED}, multiplicity set at pre-compile, origin=Vector Informatik, post-build-variant-value=true, set at pre-compile  # Direction of configured user option. Options with direction TX can be read and written via the AUTOSAR APIs TcpIp_DhcpReadOption/TcpIp_DhcpWriteOption. Options with direction RX or RX_REQUESTED can only be read or cleared (DataLength == 0). If the direction is set to RX_REQUESTED, the DHCP client will request the option via the Parameter Request List (option code 55).
          container TcpIpIcmpConfig [0..1]: multiplicity set at pre-compile  # Specifies the configuration parameters of the ICMP (Internet Control Message Protocol) sub-module.
            integer TcpIpIcmpTtl: 0..255, multiplicity set at pre-compile, post-build-variant-value=true, set at pre-compile, default-value=64  # Time-To-Live (TTL) | Default Time-to-live value of outgoing ICMP packets.
            integer TcpIpIcmpEchoReplyMaxLen: 0..32767, multiplicity set at pre-compile, origin=Vector Informatik, post-build-variant-value=true, set at pre-compile, default-value=32  # Echo Reply Max Buffer Len | This value specifies the maximum payload length of an Echo Reply. If an Echo Request contains more data the payload of the response will be truncated.
            boolean TcpIpIcmpDestinationUnreachableEnabled: multiplicity set at pre-compile, origin=Vector Informatik, set at pre-compile, default-value=false  # This parameter defines whether the ICMPv4 shall send ICMP Destination Unreachable messages according to IETF RFC 792. If enabled, the ICMPv4 responds with a Destination Unreachable Message if a unicast packet with one of the following properties is received. - The upper layer protocol is unknown. - The UDP destination port is not open.
            container TcpIpIcmpMsgHandler [0..1]: multiplicity set at pre-compile  # This container is a subcontainer of TcpIpIcmpConfig and specifies the configuration parameters for the ICMP message handler.
              string TcpIpIcmpMsgHandlerHeaderFileName: multiplicity set at pre-compile, set at pre-compile, max-length=32, min-length=1  # Msg Handler Header File Name | This parameter specifies the name of the header file containing the definition of the ICMP message handler function.
              function name TcpIpIcmpMsgHandlerName: multiplicity set at pre-compile, set at pre-compile  # Msg Handler Name | This parameter defines the name of the ICMP message handler function <User_IcmpMsgHandler>.
          container TcpIpIpFragmentationConfig [0..*]: multiplicity set at pre-compile  # Specifies the configuration parameters of IPv4 packet fragmentation/reassembly. | This container may be referenced by multiple IPv4 instances if they shall use the same configuration. This container may have multiple instances if different configurations are required for different IPv4 instances.
            boolean TcpIpIpFragmentationRxEnabled: multiplicity set at pre-compile, set at pre-compile, default-value=false  # Enable Packet Reassembly | Enables (TRUE) or disables (FALSE) support for reassembling of incoming datagrams that are fragmented according to IETF RFC 815 (IP Datagram Reassembly Algorithms).
            integer TcpIpIpNumFragments [0..1]: 0..255, multiplicity set at pre-compile, post-build-variant-multiplicity=true, post-build-variant-value=true, set at pre-compile, default-value=0  # Maximum Number of Fragments | This value specifies the maximum number of IP fragments per datagram. This value depends on the maximum TX datagram size and the Maximum Transmission Unit (MTU) of the ethernet link. Note: For reassembly (RX) there is no explicit limit to the number of fragments. Instead the number of fragments during reassembly is indirectly limited by the reassembly buffer size.
            integer TcpIpIpNumReassDgrams [0..1]: 0..65535, multiplicity set at pre-compile, post-build-variant-multiplicity=true, post-build-variant-value=true, set at pre-compile, default-value=3  # Number of Reassembly Buffers | This value specifies the maximum number of fragmented IP datagrams that can be reassembled in parallel. Note: This parameter defines the number of reassembly buffers.
            float TcpIpIpReassTimeout [0..1]: 0..65.535, multiplicity set at pre-compile, post-build-variant-multiplicity=true, post-build-variant-value=true, set at pre-compile, default-value=60  # Reassembly Timeout | This value specifies the timeout after which an incomplete datagram gets discarded. | Note: this parameter is only relevant if TcpIpIpFragmentationRxEnabled is TRUE.
            integer TcpIpIpMaxReassDgramSize: 4..65535, multiplicity set at pre-compile, origin=Vector Informatik, post-build-variant-value=true, set at pre-compile, default-value=1500  # Reassembly Buffer Size | This value specifies the maximum size of IP datagrams that can be reassembled. One or more reassembly buffers of this size will be created.
            boolean TcpIpIpReassInOrderEnabled: multiplicity set at pre-compile, origin=Vector Informatik, set at pre-compile, default-value=false  # Optimize for In-Order Reassembly | This parameter defines whether all fragments of an IP datagram are expected to arrive in order. If enabled, reassembly of an IP datagram is aborted if a fragment arrives out of order so the buffer is available for reassembly of other datagrams immediately. This is an optimization for local networks where all fragments of a fragmented IP datagram should arrive in order. This option should be turned of if fragments may arrive out of order.
            integer TcpIpIpMaxTxDgramSize: 64..65535, multiplicity set at pre-compile, origin=Vector Informatik, post-build-variant-value=true, set at pre-compile, default-value=1500  # Maximum TX Datagram Size | This value specifies the maximum size of outgoing IP datagrams (including all headers). If a datagram does not fit into the ethernet MTU it will be split up into multiple IP fragments. Note: No additional buffer is required for transmission of fragmented IP datagrams but there must be sufficient ethernet TX buffers to hold all fragments.
          container TcpIpStaticArpTable [0..*]: multiplicity set at pre-compile  # This container includes one or more static ARP table entries. It may be referenced by multiple IpV4CtrlConfig containers if they shall use the same static ARP table. The static ARP table is stored into the ROM and cannot be overwritten during runtime. IP instances using this static ARP table will never send ARP requests for the configured addresses.
            container TcpIpStaticArpEntry [1..*]: multiplicity set at pre-compile  # This container includes a static IP address to physical address mapping.
              string TcpIpStaticArpEntryIpAddr: multiplicity set at pre-compile, origin=Vector Informatik, post-build-variant-value=true, set at pre-compile, max-length=15, min-length=7  # IPv4 Address | This parameter defines the IP address that shall be statically mapped to the physical address defined in IpV4StaticArpEntryPhysAddr
              string TcpIpStaticArpEntryPhysAddr: multiplicity set at pre-compile, origin=Vector Informatik, post-build-variant-value=true, set at pre-compile, max-length=17, min-length=17  # Physical Address | This parameter defines the physical address that shall be used for outgoing packets to the IP address specified in IpV4StaticArpEntryIpAddr
        container TcpIpIpV6Config [0..1]: multiplicity set at pre-compile  # Specifies the configuration parameters of the IPv6 (Internet Protocol version 6) sub-module.
          container TcpIpDhcpV6Config [0..*]: multiplicity set at pre-compile  # Specifies the configuration parameters of the DHCPv6. | This container may be referenced by multiple IPv6 instances if they shall use the same configuration. This container may have multiple instances if different configurations are required for different IPv6 instances.
            float TcpIpDhcpV6CnfDelayMax: 0..100, multiplicity set at pre-compile, set at pre-compile, default-value=1  # Cnf Delay Max | Maximum delay before sending the first Confirm message. If this value is bigger than the previous minimum delay value a random delay will be chosen from the interval.
            float TcpIpDhcpV6CnfDelayMin: 0..100, multiplicity set at pre-compile, set at pre-compile, default-value=0  # Cnf Delay Min | Minimum delay before the first Confirm message will be sent.
            float TcpIpDhcpV6InfDelayMax: 0..100, multiplicity set at pre-compile, set at pre-compile, default-value=1  # Inf Delay Max | Maximum delay before sending the first Information Request message. If this value is bigger than the previous minimum delay value a random delay will be chosen from the interval.
            float TcpIpDhcpV6InfDelayMin: 0..100, multiplicity set at pre-compile, set at pre-compile, default-value=0  # Inf Delay Min | Minimum delay before the first Information Request message will be sent.
            float TcpIpDhcpV6SolDelayMax: 0..100, multiplicity set at pre-compile, set at pre-compile, default-value=1  # Sol Delay Max | Maximum delay before sending the first Solicit message. If this value is bigger than the previous minimum delay value a random delay will be chosen from the interval.
            float TcpIpDhcpV6SolDelayMin: 0..100, multiplicity set at pre-compile, set at pre-compile, default-value=0  # Sol Delay Min | Minimum delay before the first Solicit message will be sent.
            float TcpIpDhcpV6ClientIdTime: 0..100, multiplicity set at pre-compile, origin=Vector Informatik, set at pre-compile, default-value=0  # Client DUID Time | Time value used to build the DHCP Unique Identifier (DUID) of the client. The Identifier of the client will be built from this time value and the link-layer address of this node. "The time value is the time that the DUID is generated represented in seconds since midnight (UTC), January 1, 2000, modulo 2^32." [RFC3315 9.2. DUID Based on Link-layer Address Plus Time [DUID-LLT]]
            boolean TcpIpDhcpV6RandomizeTimeouts: multiplicity set at pre-compile, origin=Vector Informatik, set at pre-compile, default-value=true  # Randomize Timeouts | Use randomization factor for computing retransmission timeouts. "Each of the computations of a new RT include a randomization factor (RAND), which is a random number chosen with a uniform distribution between -0.1 and +0.1. The randomization factor is included to minimize synchronization of messages transmitted by DHCP clients." [RFC3315 14. Reliability of Client Initiated Message Exchanges]
            integer TcpIpDhcpV6TxMsgBufferLen: 64..1280, multiplicity set at pre-compile, origin=Vector Informatik, set at pre-compile, default-value=128  # Tx Message Buffer Size | Size of the buffer for outgoing DHCPv6 messages. The size of a DHCPv6 message depends on the number and length of options included in it.
            boolean TcpIpDhcpV6UseFirstValidAdv: multiplicity set at pre-compile, origin=Vector Informatik, post-build-variant-value=true, set at pre-compile, default-value=false  # Use first valid advertisment | If enabled the Dhcp will not wait for other advertise messages if a valid one has been received but the preference is less than 255. "A client MUST collect Advertise messages for the first RT seconds, unless it receives an Advertise message with a preference value of 255" [RFC3315 17.1.2. Transmission of Solicit Messages]
            boolean TcpIpDhcpV6Rfc3646DomainListOptEnabled: multiplicity set at pre-compile, origin=Vector Informatik, set at pre-compile, default-value=false  # Enable Domain List Option | If enabled the DhcpV6 will notify the Dns of dns search lists contained in DOMAIN_LIST options of received DHCPv6 Reply messages. [RFC3646 4. Domain Search List option] Requires Dns Component.
            boolean TcpIpDhcpV6Rfc3646DnsServersOptEnabled: multiplicity set at pre-compile, origin=Vector Informatik, set at pre-compile, default-value=false  # Enable DNS Server Option | If enabled the DhcpV6 will notify the Dns of dns server addresses contained in DNS_SERVERS options of received DHCPv6 Reply messages. [RFC3646 3. DNS Recursive Name Server option] Requires Dns Component.
            integer TcpIpDhcpV6FqdnLenMax: 0..255, multiplicity set at pre-compile, origin=Vector Informatik, post-build-variant-value=true, set at pre-compile, default-value=30  # Fully Qualified Domain Name Length Max | Maximum support Fully Qualified Domain Name (Host name) length RESTRICTIONS: 'TcpIpDhcpV6FqdnLenMax' is only available, if 'TcpIpEnableDhcpV6' is set to 'true'.
            container TcpIpDhcpV6UserOption [0..*]: multiplicity set at pre-compile  # Configures DHCP user options which shall be transmitted/received by the DHCP client. RESTRICTION: User options are only available, if 'TcpIpEnableDhcpV6' is set to 'true'.
              integer TcpIpDhcpV6UserOptionCode: 1..65535, multiplicity set at pre-compile, origin=Vector Informatik, post-build-variant-value=true, set at pre-compile  # Code of user option.
              integer TcpIpDhcpV6UserOptionLength: 1..65535, multiplicity set at pre-compile, origin=Vector Informatik, post-build-variant-value=true, set at pre-compile  # Maximum support length of configured user option.
              enumeration TcpIpDhcpV6UserOptionDirection: {TCPIP_DHCP_USER_OPTION_RX, TCPIP_DHCP_USER_OPTION_TX, TCPIP_DHCP_USER_OPTION_RX_REQUESTED}, multiplicity set at pre-compile, origin=Vector Informatik, post-build-variant-value=true, set at pre-compile  # Direction of configured user option. Options with direction TX can be read and written via the AUTOSAR APIs TcpIp_DhcpV6ReadOption/TcpIp_DhcpV6WriteOption. Options with direction RX or RX_REQUESTED can only be read or cleared (DataLength == 0). If the direction is set to RX_REQUESTED, the DHCP client will request the option via the Option Request Option (OPTION_ORO 6).
          container TcpIpIcmpV6Config: multiplicity set at pre-compile  # Specifies the configuration parameters of the ICMPv6 (Internet Control Message Protocol for IPv6) sub-module.
            integer TcpIpIcmpV6EchoDataBufferSize: 0..1452, multiplicity set at pre-compile, set at pre-compile, default-value=64  # Echo Data Buffer Size | Configure the maximum amount of arbitrary data that will be sent back to the sender of an echo request. If the arbitrary data of an incoming echo request is bigger than configured here, the response payload will be truncated.
            boolean TcpIpIcmpV6EchoReplyEnabled: multiplicity set at pre-compile, set at pre-compile, default-value=false  # Echo Reply Enabled | If enabled, the stack will respond to incoming ICMPv6 Echo Requests (Pings).
            integer TcpIpIcmpV6HopLimit: 0..255, multiplicity set at pre-compile, post-build-variant-value=true, set at pre-compile, default-value=64  # Hop Limit | Default Hop-Limit value of outgoing ICMPv6 packets.
            boolean TcpIpIcmpV6MsgDestinationUnreachableEnabled: multiplicity set at pre-compile, set at pre-compile, default-value=false  # Msg Destination Unreachable Enabled | Dis/Enables transmission of Destination Unreachable Messages
            boolean TcpIpIcmpV6MsgParameterProblemEnabled: multiplicity set at pre-compile, set at pre-compile, default-value=true  # Msg Parameter Problem Enabled | If enabled an ICMPv6 parameter problem message will be sent if a received packet has been dropped due to unknown options or headers that are found in the packet. | [RFC2460 4. IPv6 Extension Headers]
            boolean TcpIpIcmpV6EchoRequestApiEnabled: multiplicity set at pre-compile, origin=Vector Informatik, set at pre-compile, default-value=false  # Enable Echo Request API | This parameter defines whether the API function IpV6_Icmp_TxEchoRequest() is available. This function can be used to send outgoing Echo Requests (Pings) to other Hosts. Note: This function is for debugging purposes only. Incoming Echo Replies are currently not handled by the ICMPv6.
            boolean TcpIpIcmpV6ErrorMessagesEnabled: multiplicity set at pre-compile, origin=Vector Informatik, set at pre-compile, default-value=true  # Send ICMP Error Messages | This parameter defines whether ICMPv6 Error Messages will be sent as specified in [RFC4443]. [RFC4443 3.2. Packet Too Big Message] [RFC4443 3.3. Time Exceeded Message] [RFC4443 3.4. Parameter Problem Message] If disabled, no ICMPv6 Error Messages will be sent
            integer TcpIpIcmpV6TxMessageBufferSize: 48..1280, multiplicity set at pre-compile, origin=Vector Informatik, set at pre-compile, default-value=1280  # Tx Message Buffer Size | This value specifies the maximum size of outgoing ICMPv6 messages. This value should be 1280 if IpV6EnableIcmpErrMsgs is enabled. If the value is smaller the Original Packet payload in ICMPv6 Error messages will be truncated.
            container TcpIpIcmpV6MsgHandler [0..1]: multiplicity set at pre-compile  # This container is a subcontainer of TcpIpIcmpConfig and specifies the configuration parameters for the ICMPv6 message handler.
              string TcpIpIcmpV6MsgHandlerHeaderFileName [1..*]: multiplicity set at pre-compile, set at pre-compile, max-length=32, min-length=1  # Msg Handler Header File Name | This parameter specifies the name of the header file containing the definition of the ICMPv6 message handler function.
              function name TcpIpIcmpV6MsgHandlerName: multiplicity set at pre-compile, set at pre-compile  # Msg Handler Name | This parameter defines the name of the ICMP message handler function <User_IcmpMsgHandler>.
              function name TcpIpIcmpV6MaxPayloadLenChgHandlerName [0..*]: multiplicity set at pre-compile, origin=Vector Informatik, set at pre-compile  # Maximum Payload Length Change Callback Function | This parameter defines a function that will be called when the maximum payload length, that fits into one IPv6 packet, changes due to MTU limitations on the path to a specific destination. see [RFC1981 Path MTU Discovery for IP version 6] Callback function signature: void Cbk_Name(uint8 CtrlIdx, const IpBase_SockAddrType DstAddrPtr, uint16 Mtu) For reasons of efficiency at least the callback "TcpIp_Cbk_VPathMtuChg" of "TcpIp_Cbk.h" should be configured here in order to avoid that TCP transmits packets that need to be fragmented by the IP layer.
              function name TcpIpIcmpV6IndAddrListReceivedHandlerName [0..*]: multiplicity set at pre-compile, origin=Vector Informatik, set at pre-compile  # Inverse ND Address List Received Callback Function | This parameter defines a function that will be called when an Inverse Neighbor Discovery Solicitation or Advertisement with an Address List Option [RFC3122] is received. Callback function signature: void Cbk_Name(uint8 CtrlIdx, IPV6_P2C(Eth_PhysAddrType) RemoteLLAddrPtr, IPV6_P2C(IpV6_AddrType) AddrListPtr, uint8 AddrCount);
          container TcpIpIpV6FragmentationConfig [0..*]: multiplicity set at pre-compile  # Specifies the configuration parameters of IPv6 packet fragmentation/reassembly. | This container may be referenced by multiple IPv6 instances if they shall use the same configuration. This container may have multiple instances if different configurations are required for different IPv6 instances.
            integer TcpIpIpV6ReassemblyBufferCount: 0..255, multiplicity set at pre-compile, set at pre-compile, default-value=2  # Reassembly Buffer Count | Number of buffers that can be used for fragment reassembly. In case of a reassembly error or if not all fragments are received in time this buffer will be blocked until the specified "Fragment Reassembly Timeout" has been exceeded. | A value of 0 disables fragment reassembly. [RFC2460 5. Packet Size Issues] "In order to send a packet larger than a path's MTU, a node may use the IPv6 Fragment header to fragment the packet at the source and have it reassembled at the destination(s). However, the use of such fragmentation is discouraged in any application that is able to adjust its packets to fit the measured path MTU (i.e., down to 1280 octets)."
            integer TcpIpIpV6ReassemblyBufferSize [0..1]: 1500..65535, multiplicity set at pre-compile, set at pre-compile, default-value=1500  # Reassembly Buffer Size | [RFC2460 5. Packet Size Issues] | "A node must be able to accept a fragmented packet that, after reassembly, is as large as 1500 octets. A node is permitted to accept fragmented packets that reassemble to more than 1500 octets."the measured path MTU (i.e., down to 1280 octets)."
            integer TcpIpIpV6ReassemblySegmentCount [0..1]: 1..255, multiplicity set at pre-compile, set at pre-compile, default-value=5  # Reassembly Segment Count | Specifies the maximum number of consecutive data segments that can be managed in each reassembly buffer. If all fragments are received in order, only one segment will be needed. | To deal with fragments received out of order this value should be configured bigger than 1.
            float TcpIpIpV6ReassemblyTimeout [0..1]: 0.001..100, multiplicity set at pre-compile, set at pre-compile, default-value=60  # Reassembly Timeout | [RFC2460 4.5 Fragment Header] | Default: 60 seconds
            integer TcpIpIpV6TxFragmentBufferCount: 0..255, multiplicity set at pre-compile, set at pre-compile, default-value=2  # Fragment Buffer Count | These buffers will be used if the IPv6 receives packets from the upper layer that do not fit into the MTU and thus must be fragmented. | A value of 0 disables tx fragmentation. If the upper layer transmits packets that do not fit into the link or path MTU, the IPv6 will split-up the packet into fragments. see "Enable Fragment Reassembly"
            integer TcpIpIpV6TxFragmentBufferSize [0..1]: 1500..65535, multiplicity set at pre-compile, set at pre-compile, default-value=1500  # Tx Fragment Buffer Size | Size of each fragment tx buffer in bytes
          container TcpIpNdpConfig [1..*]: multiplicity set at pre-compile  # Specifies the configuration parameters of the Neighbor Discovery Protocol for IPv6 | This container may be referenced by multiple IPv6 instances if they shall use the same configuration. This container may have multiple instances if different configurations are required for different IPv6 instances.
            boolean TcpIpNdpRfc6106DnsslOptEnabled: multiplicity set at pre-compile, origin=Vector Informatik, set at pre-compile, default-value=false  # Enable DNS Search List Option | This parameter defines whether the IPv6 will notify the DNS of domain names of DNS suffixes contained in DNSSL options of received Router Advertisements. [RFC6106 5.2. DNS Search List Option]
            boolean TcpIpNdpRfc6106RdnssOptEnabled: multiplicity set at pre-compile, origin=Vector Informatik, set at pre-compile, default-value=false  # Enable Recursive DNS Server Option | This parameter defines whether the IPv6 will notify the DNS of dns server adresses contained in RDNS options of received Router Advertisements. [RFC6106 5.1. Recursive DNS Server Option]
            container TcpIpNdpArNudConfig [0..1]: multiplicity set at pre-compile  # Specifies the configuration parameters for NDP Address Resolution and Neighbor Unreachability Detection.
              float TcpIpNdpDefaultReachableTime: 0..120, multiplicity set at pre-compile, set at pre-compile, default-value=30  # Default Reachable Time | Configuration of the ReachableTime specified in [RFC4861 6.3.2. Host Variables]. | "The time a neighbor is considered reachable after receiving a reachability confirmation." If "TcpIpNdpDynamicReachableTimeEnabled" is checked, this value may be reconfigured based on received Router Advertisements. Default: REACHABLE_TIME = 30 seconds
              float TcpIpNdpDefaultRetransTimer: 0..60, multiplicity set at pre-compile, set at pre-compile, default-value=1  # Default Retrans Timer | Configures the default value for the RetransTimer variable specified in [RFC4861 6.3.2. Host Variables]. | "The time between retransmissions of Neighbor Solicitation messages to a neighbor when resolving the address or when probing the reachability of a neighbor." If "TcpIpNdpDynamicRetransTimeEnabled" is checked, this value may be reconfigured based on received Router Advertisements. Default: RETRANS_TIMER = 1 second
              float TcpIpNdpDelayFirstProbeTime: 0..60, multiplicity set at pre-compile, set at pre-compile, default-value=5  # Delay First Probe Time | Delay before sending the first NUD probe. | [RFC4861 7.3.3. Node Behavior] Default: DELAY_FIRST_PROBE_TIME = 5 seconds
              integer TcpIpNdpMaxNeighborCacheSize: 1..254, multiplicity set at pre-compile, set at pre-compile, default-value=5  # Max Neighbor Cache Size | Maximum number of entries in the neighbor cache. | [RFC4861 5.1. Conceptual Data Structures]
              integer TcpIpNdpMaxRandomFactor: 0..100, multiplicity set at pre-compile, set at pre-compile, default-value=15  # Max Random Factor | Maximum random factor used for randomization | [RFC4861 10. Protocol Constants] Default: 15 (MAX_RANDOM_FACTOR = 1.5)
              integer TcpIpNdpMinRandomFactor: 0..100, multiplicity set at pre-compile, set at pre-compile, default-value=5  # Min Random Factor | Minimum random factor used for randomization | [RFC4861 10. Protocol Constants] Default: 5 (MIN_RANDOM_FACTOR = 0.5)
              boolean TcpIpNdpNeighborUnreachabilityDetectionEnabled: multiplicity set at pre-compile, set at pre-compile, default-value=true  # Neighbor Unreachability Detection Enabled | Neighbor Unreachability Detection is used to remove unused entries from the neighbor cache. This feature is a basic feature of NDP and should be turned on.
              integer TcpIpNdpNumMulticastSolicitations: 0..255, multiplicity set at pre-compile, set at pre-compile, default-value=3  # Num Multicast Solicitations | Maximum number of multicast solicitations that will be sent when performing address resolution. | [RFC4861 7.2.2. Sending Neighbor Solicitations] Default: MAX_MULTICAST_SOLICIT = 3
              integer TcpIpNdpNumUnicastSolicitations: 0..255, multiplicity set at pre-compile, set at pre-compile, default-value=3  # Num Unicast Solicitations | Maximum number of unicast solicitations that will be sent when performig Neighbor Unreachability Detection. | [RFC4861 7.3.3. Node Behavior] Default: MAX_UNICAST_SOLICIT = 3
              boolean TcpIpNdpPacketQueueEnabled: multiplicity set at pre-compile, set at pre-compile, default-value=true  # Packet Queue Enabled | Enables (TRUE) or disables (FALSE) support of a NDP Packet Queue according to IETF RFC 4861, section 7.2.2.
              boolean TcpIpNdpRandomReachableTimeEnabled: multiplicity set at pre-compile, set at pre-compile, default-value=true  # Random Reachable Time Enabled | If enabled the value of ReachableTime will be multiplied with a random value between MIN_RANDOM_FACTOR and MAX_RANDOM_FACTOR in order to prevent multiple nodes from transmitting at exactly the same time | [RFC4861 6.3.2. Host Variables / ReachableTime]
              boolean TcpIpNdpInverseNaEnabled: multiplicity set at pre-compile, origin=Vector Informatik, set at pre-compile, default-value=false  # Inverse Advertisements Enabled | This parameter defines whether Inverse Neighbor Advertisements are processed or silently discarded. This also enables the API IpV6_Ndp_SendInverseSolicitation(). Use "User Callback Configuration" to configure a callback function that handles received Address Lists. If disabled no Inverse Neighbor Solicitations can be sent and received Inverse Neighbor Advertisements will be silently ignored. [RFC3122 4.2.2 Processing Inverse Neighbor Advertisement Messages]
              boolean TcpIpNdpInverseNsEnabled: multiplicity set at pre-compile, origin=Vector Informatik, set at pre-compile, default-value=false  # Inverse Solicitations Enabled | This parameter defines whether Inverse Neighbor Advertisements are sent in response to received Inverse Neighbor Solicitations. Use "User Callback Configuration" to configure a callback function that handles received Address Lists. If disabled received Inverse Neighbor Solicitations will be silently ignored. [RFC3122 4.2.2 Processing Inverse Neighbor Advertisement Messages]
              boolean TcpIpNdpNeighborCacheUpdateByInverseNaEnabled: multiplicity set at pre-compile, origin=Vector Informatik, set at pre-compile, default-value=true  # Inverse Advertisement Neighbor Cache Updates Enabled | This parameter defines whether the Neighbor Cache will be updated with information from received Inverse Neighbor Advertisements. [RFC3122 4.2.2 Processing Inverse Neighbor Advertisement Messages]
            container TcpIpNdpPrefixRouterDiscoveryConfig [0..1]: multiplicity set at pre-compile  # Specifies the configuration parameters for NDP Prefix and Router Discovery.
              integer TcpIpNdpDefaultRouterListSize: 2..254, multiplicity set at pre-compile, set at pre-compile, default-value=2  # Default Router List Size | Maximum number of default router entries. | [RFC4861 5.1. Conceptual Data Structures]
              integer TcpIpNdpDestinationCacheSize: 1..254, multiplicity set at pre-compile, set at pre-compile, default-value=5  # Destination Cache Size | Maximum number of entries in the destination cache. | [RFC4861 5.1. Conceptual Data Structures]
              boolean TcpIpNdpDynamicHopLimitEnabled: multiplicity set at pre-compile, set at pre-compile, default-value=true  # Dynamic Hop Limit Enabled | If enabled the default hop limit may be reconfigured based on received Router Advertisements. | [RFC4861 6.3.4. Processing Received Router Advertisements]
              boolean TcpIpNdpDynamicMtuEnabled: multiplicity set at pre-compile, set at pre-compile, default-value=false  # Dynamic MTU Enabled | Allow dynamic reconfiguration of link MTU via Router Advertisements. | [RFC4861 4.6.4. MTU]
              boolean TcpIpNdpDynamicReachableTimeEnabled: multiplicity set at pre-compile, set at pre-compile, default-value=true  # Dynamic Reachable Time Enabled | If enabled the default Reachable Time value may be reconfigured based on received Router Advertisements. | [RFC4861 6.3.4. Processing Received Router Advertisements] Default: Enabled
              boolean TcpIpNdpDynamicRetransTimeEnabled: multiplicity set at pre-compile, set at pre-compile, default-value=true  # Dynamic Retrans Time Enabled | If enabled the default Retransmit Timer value may be reconfigured based on received Router Advertisements. | [RFC4861 6.3.4. Processing Received Router Advertisements] Default: Enabled
              float TcpIpNdpMaxRtrSolicitationDelay: 0.001..60, multiplicity set at pre-compile, set at pre-compile, default-value=1  # Max Rtr Solicitation Delay | Maximum delay before the first Router Solicitation will be sent after interface initialization. | [RFC4861 6.3.7. Sending Router Solicitations] Default: MAX_RTR_SOLICITATION_DELAY = 1 second
              integer TcpIpNdpMaxRtrSolicitations: 0..255, multiplicity set at pre-compile, set at pre-compile, default-value=3  # Max Rtr Solicitations | Maximum number of Router Solicitations that will be sent before the first Router Advertisement has been received. | 0 = No Router Solicitations will be sent. This has no impact on handling Router Advertisements. [RFC4861 6.3.7. Sending Router Solicitations] Default: MAX_RTR_SOLICITATIONS = 3 transmissions
              integer TcpIpNdpPrefixListSize: 1..254, multiplicity set at pre-compile, set at pre-compile, default-value=5  # Prefix List Size | Maximum number of entries in the on-link prefix list. | [RFC4861 5.1. Conceptual Data Structures]
              boolean TcpIpNdpRndRtrSolicitationDelayEnabled: multiplicity set at pre-compile, set at pre-compile, default-value=true  # Rnd Rtr Solicitation Delay Enabled | If enabled the first router solicitation will be delayed randomly from [0...MAX_RTR_SOLICITATION_DELAY]. Otherwise the first router solicitation will be sent after exactly MAX_RTR_SOLICITATION_DELAY milliseconds. | [RFC4861 6.3.7. Sending Router Solicitations] Default: Enabled
              float TcpIpNdpRtrSolicitationInterval: 0.001..60, multiplicity set at pre-compile, set at pre-compile, default-value=4  # Rtr Solicitation Interval | Interval between consecutive Router Solicitations. | [RFC4861 6.3.7. Sending Router Solicitations] Default: RTR_SOLICITATION_INTERVAL = 4 seconds
              string TcpIpNdpOnLinkPrefix [0..*]: multiplicity set at pre-compile, origin=Vector Informatik, post-build-variant-value=true, set at pre-compile  # On Link Prefix | This parameter defines one or more IPv6 address prefixes that shall always be considered as on-link. This means, link layer address resolution will be performed for all addresses starting with this prefix instead of forwading packets to the defautl router.
            container TcpIpNdpSlaacConfig [0..1]: multiplicity set at pre-compile  # Specifies the configuration parameters for StateLess Address AutoConfiguration.
              integer TcpIpNdpSlaacDadNumberOfTransmissions: 0..254, multiplicity set at pre-compile, set at pre-compile, default-value=1  # DAD Number Of Transmissions | Number of Neighbor Solicitations that have to be unanswered in order to set an autoconfigurated address to PREFERRED (usable) state. | [RFC4861 5.1. Node Configuration Variables] Default: DupAddrDetectTransmits = 1 Setting this value to 0 turns off DAD.
              float TcpIpNdpSlaacDadRetransmissionDelay: 0..10, multiplicity set at pre-compile, set at pre-compile, default-value=1  # DAD Retransmission Delay | Sets the maximum value for the address configuration delay. (This parameter is currently not used and does not affect the functionality of the module.) | According to [RFC4861 5.4.2. Sending Neighbor Solicitation Messages] this value should be the same as MAX_RTR_SOLICITATION_DELAY. Default: MAX_RTR_SOLICITATION_DELAY = 1 second
              boolean TcpIpNdpSlaacDelayEnabled: multiplicity set at pre-compile, set at pre-compile, default-value=false  # Slaac Delay Enabled | If enabled transmission of the first DAD Neighbor Solicitation will be delayed by a random value from [0...MAX_DAD_DELAY]. | "This serves to alleviate congestion when many nodes start up on the link at the same time, such as after a power failure, and may help to avoid race conditions when more than one node is trying to solicit for the same address at the same time." "The delay will avoid similar congestion when multiple nodes are going to configure addresses by receiving the same single multicast router advertisement." [RFC4861 5.4.2. Sending Neighbor Solicitation Messages] Default: True
              boolean TcpIpNdpSlaacOptimisticDadEnabled: multiplicity set at pre-compile, set at pre-compile, default-value=false  # Optimistic DAD Enabled | Enable Optimistic Duplicate Address Detection (DAD) according to RFC4429.
              float TcpIpNdpSlaacMinLifetime: 10..120000, multiplicity set at pre-compile, origin=Vector Informatik, post-build-variant-value=true, set at pre-compile, default-value=7200  # Minimum Address Lifetime | This value specifies the minimum valid Lifetime for addresses configured via Stateless Address Autoconfiguration. [RFC4862 5.5.3. e] RFC Default: 7200sec (2hrs)
              float TcpIpNdpSlaacMaxDelay: 0..65.535, multiplicity set at pre-compile, origin=Vector Informatik, post-build-variant-value=true, set at pre-compile, default-value=1  # Max address configuration delay | This value specifies the maximum value for the address configuration delay. According to [RFC4861 5.4.2. Sending Neighbor Solicitation Messages] this value should be the same as MAX_RTR_SOLICITATION_DELAY. RFC Default: "MAX_RTR_SOLICITATION_DELAY" = 1000 milliseconds
            container TcpIpIpV6MldConfig [0..*]: multiplicity set at pre-compile  # This container includes configuration parameters for the Multicast Listener Discovery Version 2 (MLDv2) for IPv6. See [RFC3810 Multicast Listener Discovery Version 2 (MLDv2) for IPv6]
              float TcpIpMldV1QuerierPresentTimeout: 1..600000, multiplicity set at pre-compile, origin=Vector Informatik, post-build-variant-value=true, set at pre-compile, default-value=5000  # Older Version Querier Present Timeout | This value specifies the value of the "Older Version Querier Present Timeout" Variable. See [RFC3810 9.12. Older Version Querier Present Timeout] "This value MUST be ([Robustness Variable] times ([Query Interval]) plus (one half of [Query Response Interval])."
              integer TcpIpMldIfStatePoolSize: 1..254, multiplicity set at pre-compile, origin=Vector Informatik, set at pre-compile, default-value=8  # If State Pool Size | This value specifies the maximum number of multicast addresses the IPv6 instance can listen to.
              integer TcpIpMldSrcAddrPoolSize: 0..254, multiplicity set at pre-compile, origin=Vector Informatik, set at pre-compile, default-value=32  # Src Addr Pool Size | This value specifies the maximum number of source addresses that can be stored for all socket-based multicast memberships. If multicast packets shall only be received if they have been sent from specific source addresses each of these addresses requires an entry in this pool.
              integer TcpIpMldSocketMembershipPoolSize: 1..254, multiplicity set at pre-compile, origin=Vector Informatik, set at pre-compile, default-value=8  # Socket Membership Pool Size | This value specifies the maximum number of multicast memberships that can be managed via the IpV6_MulticastListen() API. All sockets share the same membership pool. Each multicast address can apper at most once for each socket. Maximum: IpV6MldIfStatePoolSize * number of sockets (all socket are member of all multicast groups) Minimum: IpV6MldIfStatePoolSize * 1 (exactly one socket is member of each multicast address group)
              integer TcpIpMldIfStateSrcAddrPoolSize: 1..254, multiplicity set at pre-compile, origin=Vector Informatik, set at pre-compile, default-value=16  # If State Src Addr Pool Size | This value specifies the total number of all source addresses for all multicast addresses. This value may be less than IpV6MldSrcAddrPoolSize if multiple sockets only need multicast packets from the same source addresses.
              integer TcpIpMldRobustness: 1..255, multiplicity set at pre-compile, origin=Vector Informatik, set at pre-compile, default-value=2  # Robustness | This value specifies the value of the [Robustness Variable] which is defined in [RFC3810 9.1. Robustness Variable]. "MLD is robust to [Robustness Variable] - 1 packet losses. The value of the Robustness Variable MUST NOT be zero, and SHOULD NOT be one. Default value: 2."
              integer TcpIpMldMaxReportMsgSize: 76..1500, multiplicity set at pre-compile, origin=Vector Informatik, set at pre-compile, default-value=1280  # Max Report Msg Size | This value specifies the maximum size of a MLDv2 Report message inclusive the IPv6 header (40 bytes) and the Hop-by-Hop header (8 bytes). This value directly depends on the Ethernet Tx buffer size. (No extra buffer will be allocated.)
              float TcpIpMldMinUnsolicitedReportInt: 0..100000, multiplicity set at pre-compile, origin=Vector Informatik, set at pre-compile, default-value=0  # Min Unsolicited Report Int | This value specifies the lower bound for the randomized Unsolicited Report Interval. If this value equals IpV6MldMaxUnsolicitedReportInt the interval will be fixed. RFC Default: 0 See: IpV6MldMaxUnsolicitedReportInt
              float TcpIpMldMaxUnsolicitedReportInt: 0..100000, multiplicity set at pre-compile, origin=Vector Informatik, set at pre-compile, default-value=1000  # Max Unsolicited Report Int | This value specifies the upper bound for the randomized Unsolicited Report Interval. "The Unsolicited Report Interval is the time between repetitions of a node's initial report of interest in a multicast address." [RFC3810 9.11. Unsolicited Report Interval] RFC Default: 1 second. "To cover the possibility of the State Change Report being missed by one or more multicast routers, [Robustness Variable] - 1 retransmissions are scheduled, through a Retransmission Timer, at intervals chosen at random from the range (0, [Unsolicited Report Interval])." [RFC3810 6.1. Action on Change of Per-Interface State]
            container TcpIpIpV6PrivExtConfig [0..*]: multiplicity set at pre-compile  # This container includes configuration parameters for the Privacy Extensions for Stateless Address Autoconfiguration in IPv6. See [RFC4941 Privacy Extensions for Stateless Address Autoconfiguration in IPv6]
              float TcpIpPrivExtTempValidLifetime: 0..4294967, multiplicity set at pre-compile, origin=Vector Informatik, post-build-variant-value=true, set at pre-compile, default-value=604800  # Lifetime of temp. Address | This value specifies the maximum time a temporary address is valid. RFC Default: 604800s (1 week) [RFC4941 5. Defined Constants] [RFC4941 3.3. Generating Temporary Addresses / 1.]
              float TcpIpPrivExtTempPreferredLifetime: 0..4294967, multiplicity set at pre-compile, origin=Vector Informatik, post-build-variant-value=true, set at pre-compile, default-value=86400  # Time temp. Address is preferred | This value specifies the maximum time a temporary address is preferred. RFC Default: 86400s (1 day) [RFC4941 5. Defined Constants] [RFC4941 3.3. Generating Temporary Addresses / 1.]
              float TcpIpPrivExtRegenAdvance: 0..100, multiplicity set at pre-compile, origin=Vector Informatik, set at pre-compile, default-value=5  # Time in advance for temp. Address Regeneration | A new temporary addresses is generated RegenAdvance time units before its predecessor gets deprecated. RFC Default: 5s [RFC4941 5. Defined Constants] "To ensure that a preferred temporary address is always available, a new temporary address SHOULD be regenerated slightly before its predecessor is deprecated. This is to allow sufficient time to avoid race conditions in the case where generating a new temporary address is not instantaneous, such as when duplicate address detection must be run. The node SHOULD start the address regeneration process REGEN_ADVANCE time units before a temporary address would actually be deprecated." [RFC4941 3.4. Expiration of Temporary Addresses]
              float TcpIpPrivExtMaxDesyncFactor: 0..10000, multiplicity set at pre-compile, origin=Vector Informatik, set at pre-compile, default-value=600  # DeSync-Factor upper bound | This value specifies the upper bound for the random value DESYNC_FACTOR. RFC Default: 600s (10 minutes) [RFC4941 5. Defined Constants] "The value DESYNC_FACTOR is a random value (different for each client) that ensures that clients don't synchronize with each other and generate new addresses at exactly thesame time." [RFC4941 3.5. Regeneration of Randomized Interface Identifiers]
              integer TcpIpPrivExtTempIdGenRetries: 0..10, multiplicity set at pre-compile, origin=Vector Informatik, set at pre-compile, default-value=3  # Interface UID generation retries | This parameter defines the number of times the node shall retry to generate an unique interface identifier for a temporary address. If an unique identifier could not be generated after the specified number of retries, there will be no temporary address available. RFC Default: 3 [RFC4941 5. Defined Constants] [RFC4941 3.3. Generating Temporary Addresses / 7.]
              integer TcpIpPrivExtMaxTempAddrs: 1..254, multiplicity set at pre-compile, origin=Vector Informatik, set at pre-compile, default-value=4  # Temp. Address count | This value specifies the maximum number of temporary addresses that can be configured at the same time. This should be at least 2 times the number of golbal prefixes advertised by routers.
              boolean TcpIpPrivExtUseOnLinkPrefixes: multiplicity set at pre-compile, origin=Vector Informatik, set at pre-compile, default-value=false  # Use On Link Prefixes | This parameter defines whether the IPv6 will generate temporary addresses for prefixes marked as on-link in received Router Advertisements. Normally temporary addresses are only created for prefixes that are not marked as on-link.
      container TcpIpLocalAddr [1..*]: multiplicity set at pre-compile  # Specifies the local IP (Internet Protocol) addresses used for IP communication.
        integer TcpIpAddrId: 0..65535, scope=ECU, multiplicity set at pre-compile, set at pre-compile, symbolic-name-value=true, default-value=0  # Addr ID | IP address table identifier assigned by TCP/IP stack.
        enumeration TcpIpAddressType: multiplicity set at pre-compile, post-build-variant-value=true, set at pre-compile  # Address type.
          TCPIP_MULTICAST  # Multicast
          TCPIP_UNICAST  # Unicast
          TCPIP_IPV4_BROADCAST  # Broadcast
        enumeration TcpIpDomainType: {TCPIP_AF_INET, TCPIP_AF_INET6}, multiplicity set at pre-compile, post-build-variant-value=true, set at pre-compile  # Address family.
        boolean TcpIpIpAddrReceiveAllNotConfiguredMulticasts: multiplicity set at pre-compile, origin=Vector Informatik, post-build-variant-value=true, set at pre-compile, default-value=false  # IP Addr Receive All Not Configured Multicasts | This parameter defines whether an address of type TCPIP_IPV4_BROADCAST shall also be used to receive multicasts that have not been configured individually by addresses of type TCPIP_MULTICAST. Note: If this parameter is set, the IPv4 will configure the EthIf to accept all multicast packets on the corresponsing controller. This parameter is only valid for a TCPIP_IPV4_BROADCAST address.
        reference TcpIpCtrlRef: multiplicity set at pre-compile, post-build-variant-value=true, set at pre-compile, destination=TcpIpCtrl  # Reference to a TcpIpCtrl specifying the EthIf Controller where the IP address shall be assigned and DEM errors that shall be reported in case of an error on this controller.
        container TcpIpAddrAssignment [1..*]: multiplicity set at pre-compile  # This container is a subcontainer of TcpIpLocalAddr and specifies the assignment policy for the IP address.
          enumeration TcpIpAssignmentLifetime [0..1]: {TCPIP_FORGET, TCPIP_STORE}, multiplicity set at pre-compile, post-build-variant-value=true, set at pre-compile, default-value=TCPIP_FORGET  # Defines the lifetime of a dynamically fetched IP address. TCPIP_FORGET: After IP address has been assigned just use it for this link-up time. (default) TCPIP_STORE: After IP address has been assigned store the address persistently into NvM. If this parameter exists and "AssignmentMethod" is set to TCPIP_STATIC, the address can be assigned/changed during runtime via the TcpIp_RequestIpAddrAssignment() API. | If TcpIpAssignmentMethod = TCPIP_STATIC then TcpIpAssignmentLifetime shall be omitted.
          enumeration TcpIpAssignmentMethod: {TCPIP_DHCP, TCPIP_IPV6_ROUTER, TCPIP_LINKLOCAL, TCPIP_LINKLOCAL_DOIP, TCPIP_STATIC}, multiplicity set at pre-compile, post-build-variant-value=true, set at pre-compile  # Method of address assignment
          integer TcpIpAssignmentPriority: 1..3, multiplicity set at pre-compile, post-build-variant-value=true, set at pre-compile, default-value=1  # Priority of assignment (1 is highest). If a new address from an assignment method with a higher priority is available, it overwrites the IP address previously assigned by an assignment method with a lower priority.
          enumeration TcpIpAssignmentTrigger: {TCPIP_AUTOMATIC, TCPIP_MANUAL}, multiplicity set at pre-compile, post-build-variant-value=true, set at pre-compile, default-value=TCPIP_AUTOMATIC  # AUTOMATIC: The address assignment method is triggerred automatically after the pysical link is established. A statically configured IP address (see TcpIpStaticIpAddressConfig) will be assigned immediately but may be changed during runtime by calling TcpIp_RequestIpAddrAssignment() MANUAL: The address assignment method is triggered manually by the user by calling TcpIp_RequestIpAddrAssignment().
        container TcpIpStaticIpAddressConfig [0..1]: multiplicity set at pre-compile  # This container is a subcontainer of TcpIpLocalAddr and specifies a static IP address including directly related parameters. If this container is not present and the "Assignment Method" of this address is TCPIP_STATIC the address will be unassigned after startup and can be assigned/changed via the TcpIp_RequestIpAddrAssignment() API.
          string TcpIpDefaultRouter [0..1]: multiplicity set at pre-compile, post-build-variant-multiplicity=true, post-build-variant-value=true, set at pre-compile  # IP address of default router (gateway)
          integer TcpIpNetmask [0..1]: 1..128, multiplicity set at pre-compile, post-build-variant-multiplicity=true, post-build-variant-value=true, set at pre-compile  # Network mask of IPv4 address or address prefix of IPv6 address in CIDR Notation, i.e. decimal value between 0 and 32 (IPv4) or 0 and 128 (IPv6) that describes the number of significant bits defining the network number or prefix of an IP address.
          string TcpIpStaticIpAddress: multiplicity set at pre-compile, post-build-variant-value=true, set at pre-compile  # Static IP Address. | To specify any IP address for a certain EthIfCtrl, "ANY" has to be set as wildcard. See TcpIp_Bind() for more details.
          boolean TcpIpIpV6AddrPrefixIsOnLink [0..1]: multiplicity set at pre-compile, origin=Vector Informatik, post-build-variant-value=true, set at pre-compile, default-value=false  # This parameter defines whether the prefix of this static IPv6 address shall be considered as "on link" by the IPv6. This means the IPv6 will perform link layer address resolution for addresses with this prefix. Usually the IPv6 will only do link layer address resolution for link local addresses using the prefix fe80::/10 or for addresses with prefixes that have been marked to be on link by received router advertisements.
      container TcpIpNvmBlock [0..1]: multiplicity set at pre-compile  # Configuration of optional usage of Nvm in case the TcpIp module requires non volatile memory in the Ecu to store information (e.g. IP Address received via DHCP and shall be stored).
        symbolic name reference TcpIpNvmBlockDescriptorRef: scope=ECU, multiplicity set at pre-compile, set at pre-compile, destination=NvMBlockDescriptor  # Block Descriptor Ref | Reference to the Nvm block description in the Nvm module configuration.
      container TcpIpPhysAddrConfig [0..1]: multiplicity set at pre-compile  # Specifies the physical address configuration.
        container TcpIpPhysAddrChgHandler [0..1]: multiplicity set at pre-compile  # This container is a subcontainer of TcpIpPhysAddrConfig and configures the optional callback function to notify a physical address change. | specifies the configuration parameters for physical address change handler.
          string TcpIpPhysAddrChgHandlerHeaderFileName: multiplicity set at pre-compile, set at pre-compile, max-length=32, min-length=1  # Header File Name | This parameter specifies the name of the header file containing the definition of the physical address change handler function.
          function name TcpIpPhysAddrChgHandlerName: scope=ECU, multiplicity set at pre-compile, set at pre-compile  # Handler Name | This parameter defines the name of the physical address change function <Up>_PhysAddrTableChg.
        container TcpIpPhysAddrChgDiscardedHandler [0..1]: multiplicity set at pre-compile  # This container is a subcontainer of TcpIpPhysAddrConfig and configures the optional callback function to notify the discarding of a physical address entry. | specifies the configuration parameters for physical address change handler.
          string TcpIpPhysAddrChgDiscardedHandlerHeaderFileName: multiplicity set at pre-compile, origin=Vector Informatik, set at pre-compile, max-length=32, min-length=1  # Header File Name | This parameter specifies the name of the header file containing the definition of the physical address entry discarded handler function.
          function name TcpIpPhysAddrChgDiscardedHandlerName: multiplicity set at pre-compile, origin=Vector Informatik, set at pre-compile  # This parameter defines the name of the physical address entry discarded function &amp;amp;amp;amp;lt;Up&amp;amp;amp;amp;gt;_PhysAddrTableChgDiscarded.
      container TcpIpSocketOwnerConfig: multiplicity set at pre-compile  # Specifies the upper layer modules of TcpIp using the socket API.
        container TcpIpSocketOwner [1..*]: multiplicity set at pre-compile  # This container is a subcontainer of TcpIpSocketOwnerConfig and specifies an upper layer of TcpIp that uses the socket API.
          string TcpIpSocketOwnerCopyTxDataName [0..1]: multiplicity set at pre-compile, set at pre-compile  # CopyTxData Name | This parameter defines the name of the <Up_CopyTxData> function of the TcpIpSocketOwner module. The function name is only configurable if TcpIpSocketOwnerUpperLayerType is set to CDD.
          string TcpIpSocketOwnerHeaderFileName [0..1]: multiplicity set at pre-compile, set at pre-compile  # Header File Name | This parameter specifies the name of the header file containing the definition of the TcpIpSocketOwner module functions. The header file is only configurable if TcpIpSocketOwnerUpperLayerType is set to CDD.
          string TcpIpSocketOwnerLocalIpAddrAssignmentChgName [0..1]: multiplicity set at pre-compile, set at pre-compile  # Local IP Addr Assignment Chg Name | This parameter defines the name of the <Up_LocalIpAddrAssignmentChg> function of the TcpIpSocketOwner module. The function name is only configurable if TcpIpSocketOwnerUpperLayerType is set to CDD.
          string TcpIpSocketOwnerRxIndicationName [0..1]: multiplicity set at pre-compile, set at pre-compile  # RX Indication Name | This parameter defines the name of the <Up_RxIndication> function of the TcpIpSocketOwner module. The function name is only configurable if TcpIpSocketOwnerUpperLayerType is set to CDD.
          string TcpIpSocketOwnerTcpAcceptedName [0..1]: multiplicity set at pre-compile, set at pre-compile  # TCP Accepted Name | This parameter defines the name of the <Up_TcpAccepted> function of the TcpIpSocketOwner module. The function name is only configurable if TcpIpSocketOwnerUpperLayerType is set to CDD.
          string TcpIpSocketOwnerTcpConnectedName [0..1]: multiplicity set at pre-compile, set at pre-compile  # TCP Connected Name | This parameter defines the name of the <Up_TcpConnected> function of the TcpIpSocketOwner module. The function name is only configurable if TcpIpSocketOwnerUpperLayerType is set to CDD.
          string TcpIpSocketOwnerTxConfirmationName [0..1]: multiplicity set at pre-compile, set at pre-compile  # TX Confirmation Name | This parameter defines the name of the <Up_TxConfirmation> function of the TcpIpSocketOwner module. The function name is only configurable if TcpIpSocketOwnerUpperLayerType is set to CDD.
          enumeration TcpIpSocketOwnerUpperLayerType: {CDD, SOAD, DHCPV4_SERVER, SCC}, multiplicity set at pre-compile, post-build-variant-value=true, set at pre-compile  # Upper Layer Type | This parameter specifies the type of the upper layer module.
          integer TcpIpSocketOwnerId: 0..65535, multiplicity set at pre-compile, origin=Vector Informatik, set at pre-compile, symbolic-name-value=true, default-value=0  # Socket User Index | This value specifies the ID of the socket user. (auto calculated)
          string TcpIpSocketOwnerTcpIpEventName: multiplicity set at pre-compile, origin=Vector Informatik, set at pre-compile  # TcpIp Event Name | This parameter defines the name of the <Up_TcpIpEvent> function of the TcpIpSocketOwner module. The function name is only configurable if TcpIpSocketOwnerUpperLayerType is set to CDD.
          integer TcpIpSocketOwnerTcpListenSocketMax: 0..255, multiplicity set at pre-compile, origin=Vector Informatik, post-build-variant-value=true, set at pre-compile, default-value=0  # TCP Listen Socket Max | This value specifies the number of TCP listen sockets this socket owner will use simultaneously
          boolean TcpIpSocketOwnerCopyTxDataDynamicLengthEnabled: multiplicity set at pre-compile, origin=Vector Informatik, set at pre-compile, default-value=false  # CopyTxData Dynamic Length Enabled | This parameter specifies that the 'BufLength' parameter of CopyTxData is an IN/OUT parameter that allows the user to provide less data than specified in the Trasmit call. If CopyTxData decreases the parameter value, the TcpIp will not call CopyTxData again and send only the data that has been provided so far.
          string TcpIpSocketOwnerTlsValidationResultName [0..1]: multiplicity set at pre-compile, origin=Vector Informatik, set at pre-compile  # Tls Validation Result Name | This parameter specifies the name of the function to indicate the TLS validation result for a server certificate chain. The function is only used for TCP sockets where TLS is enabled.
          function name TcpIpSocketOwnerDhcpEventName [0..1]: multiplicity set at pre-compile, origin=Vector Informatik, set at pre-compile  # DHCP Event Name | This parameter defines the name of the <Up_DhcpEvent> function of the TcpIpSocketOwner module. Via this callout the upper layer will be informed about received and transmitted DHCP options.
      container TcpIpTcpConfig [0..1]: multiplicity set at pre-compile  # Specifies the configuration parameters of the TCP (Transmission Control Protocol) sub-module.
        boolean TcpIpTcpCongestionAvoidanceEnabled: multiplicity set at pre-compile, set at pre-compile, default-value=false  # Congestion Avoidance Enabled | Enables (TRUE) or disables (FALSE) support of TCP congestion avoidance algorithm according to IETF RFC 5681.
        boolean TcpIpTcpFastRecoveryEnabled: multiplicity set at pre-compile, set at pre-compile, default-value=false  # Fast Recovery Enabled | Enables (TRUE) or disables (FALSE) support of TCP Fast Recovery according to IETF RFC 5681.
        boolean TcpIpTcpFastRetransmitEnabled: multiplicity set at pre-compile, set at pre-compile, default-value=false  # Fast Retransmit Enabled | Enables (TRUE) or disables (FALSE) support of TCP Fast Retransmission according to IETF RFC 5681.
        float TcpIpTcpFinWait2Timeout: 0..65535, multiplicity set at pre-compile, post-build-variant-value=true, set at pre-compile, default-value=120  # FIN Wait 2 Timeout | Timeout to receive a FIN from the remote node (after this node has initiated connection termination), i.e. maximum time waiting in FINWAIT-2 for a connection termination request from the remote TCP. Value of Timeout must be atleast 1 MSL. Default value is 120s
        boolean TcpIpTcpKeepAliveEnabled: multiplicity set at pre-compile, set at pre-compile, default-value=false  # Keep Alive Enabled | Enables (TRUE) or disables (FALSE) TCP Keep Alive Probes according to IETF RFC 1122 chapter 4.2.3.6 Note: This parameter only enables general support of the Keep Alive Mechanism. Keep Alive must be enabled explicitly for each socket during runtime. (see SoAdSocketTcpKeepAlive* parameters)
        float TcpIpTcpKeepAliveInterval: 0..4294967, multiplicity set at pre-compile, post-build-variant-value=true, set at pre-compile, default-value=0  # Keep Alive Interval | Specifies the default interval between subsequent Keep Alive Probes. If TcpIpTcpKeepAliveProbesMax is set to 0, this parameter has no effect by default but may have an effect if the number of Keep Alive Probes is changed during runtime.
        integer TcpIpTcpKeepAliveProbesMax: 0..65535, multiplicity set at pre-compile, post-build-variant-value=true, set at pre-compile, default-value=0  # Keep Alive Probes Max | Default number of times that a TCP Keep Alive Probe is retransmitted before the connection is closed.
        float TcpIpTcpKeepAliveTime: 0..4294967, multiplicity set at pre-compile, post-build-variant-value=true, set at pre-compile, default-value=7200  # Keep Alive Time | Specifies the time between the last data packet sent (simple ACKs are not considered data) and the first Keep Alive Probe. Note: Setting this configuration parameter to a value smaller or equal to the value of TcpIpMainFunctionPeriod results in the transmission of Keep Alive Probes within every MainFunction cycle.
        integer TcpIpTcpMaxRtx [0..1]: 0..255, multiplicity set at pre-compile, post-build-variant-value=true, set at pre-compile, default-value=0  # Max Rtx | Maximum number of times that a TCP segment is retransmitted before the TCP connection is closed. This parameter is only valid if TcpIpTcpRetransmissionTimeout is configured. | Note: This parameter also applies for FIN retransmissions.
        float TcpIpTcpMsl: 0..31536000, multiplicity set at pre-compile, post-build-variant-value=true, set at pre-compile, default-value=120  # Maximum Segment Lifetime (MSL) | Maximum segment lifetime. | (Note: TIME-WAIT = 2 x TcpIpTcpMsl - to ensure that the remote node received the acknowledgment to its connection termination request.)
        boolean TcpIpTcpNagleEnabled: multiplicity set at pre-compile, set at pre-compile, default-value=true  # Nagle Enabled | Enables (TRUE) or disables (FALSE) support of Nagle's algorithm according to IETF RFC 896. If enabled the Nagle's algorithm is activated per default for all TCP sockets, but can be deactivated via TcpIp_ChangeParameter() API.
        integer TcpIpTcpReceiveWindowMax: 0..65535, multiplicity set at pre-compile, post-build-variant-value=true, set at pre-compile, default-value=512  # Receive Window Max | Default value of maximum receive window in bytes. (This parameter is currently not used and does not affect the functionality of the module.)
        float TcpIpTcpRetransmissionTimeout [0..1]: 0.001..31536000, multiplicity set at pre-compile, post-build-variant-value=true, set at pre-compile, default-value=1  # Retransmission Timeout | Timeout before an unacknowledged TCP segment is sent again.
        boolean TcpIpTcpSlowStartEnabled: multiplicity set at pre-compile, set at pre-compile, default-value=false  # Slow Start Enabled | Enables (TRUE) or disables (FALSE) support of TCP slow start algorithm according to IETF RFC 5681.
        integer TcpIpTcpSynMaxRtx: 0..255, multiplicity set at pre-compile, post-build-variant-value=true, set at pre-compile, default-value=255  # SYN Max Rtx | Maximum number of times that a TCP SYN is retransmitted. (This parameter is currently not used and does not affect the functionality of the module.) | Note: SYN will be retried after TcpIpTcpRetransmissionTimeout. The connection will be dropped if no matching connection request has been received after the last TCP SYN has been sent and TcpIpTcpRetransmissionTimeout has been expired.
        float TcpIpTcpSynReceivedTimeout: 0..31536000, multiplicity set at pre-compile, post-build-variant-value=true, set at pre-compile, default-value=0  # SYN Received Timeout | Timeout to complete a remotely initiated TCP connection establishment, i.e. maximum time waiting in SYN-RECEIVED for a confirming connection request acknowledgment after having both received and sent a connection request. (This parameter is currently not used and does not affect the functionality of the module.)
        integer TcpIpTcpTtl: 0..255, multiplicity set at pre-compile, post-build-variant-value=true, set at pre-compile, default-value=64  # Time-To-Live (TTL) | Default Time-to-live value of outgoing TCP packets.
        boolean TcpIpTcpEnableDiagReadAckSeqNum [0..1]: multiplicity set at pre-compile, origin=Vector Informatik, set at pre-compile, default-value=false  # Enable Diag Read Ack Seq Num | Enable reading of current TCP sequence number and acknowledgement number for a specified socket.
        boolean TcpIpTcpSackOptionSupport [0..1]: multiplicity set at pre-compile, origin=Vector Informatik, set at pre-compile, default-value=false  # Enable Selective Acknowledgement Support | This parameter defines if the TCP option 'selective acknowlagement' is enabled. [RFC 2018] RESTRICTIONS: 'TcpSackOptionSupport' is only available, if 'TcpOutOfOrderRxSupport' is set to 'true'.
        integer TcpIpTcpMaxNumOooSegsPerSocket [0..1]: 1..65535, multiplicity set at pre-compile, origin=Vector Informatik, post-build-variant-value=true, set at pre-compile, default-value=5  # Max Num Out Of Order Segments per Socket | This value specifes the maximum number of out of order control elements that can be allocated for one TCP socket during runtime. RESTRICTIONS: 'TcpAvgNumOooSegsPerSocket' is only available, if 'TcpOutOfOrderRxSupport' is set to 'true'.
        integer TcpIpTcpAvgNumOooSegsPerSocket [0..1]: 1..254, multiplicity set at pre-compile, origin=Vector Informatik, post-build-variant-value=true, set at pre-compile, default-value=5  # Avg Num Out Of Order Segments per Socket | This value specifes the number of out of order control elements per TCP socket. The elements are grouped into a pool shared by all TCP sockets. A TCP socket is allowed to allocate as much elements as specified by 'TcpIpTcpMaxNumOooSegsPerSocket'. RESTRICTIONS: 'TcpAvgNumOooSegsPerSocket' is only available, if 'TcpOutOfOrderRxSupport' is set to 'true'.
        float TcpIpTcpUserTimeoutDef: 0..10000, multiplicity set at pre-compile, origin=Vector Informatik, post-build-variant-value=true, set at pre-compile, default-value=20  # User Timeout Def | This value specifies the default value for User Timeout. (default: 20s) (time transmitted data may stay un-acknowlaged) RESTRICTION: Value of 'TcpUserTimeoutDef' has to be in the range defined by 'TcpUserTimeoutMin' and 'TcpUserTimeoutMax'.
        float TcpIpTcpUserTimeoutMax [0..1]: 0..10000, multiplicity set at pre-compile, origin=Vector Informatik, post-build-variant-value=true, set at pre-compile, default-value=300  # User Timeout Max | This value specifes the maximum value for User Timeout. (default: 300s) RESTRICTION: Value of 'TcpUserTimeoutMax' has to be greater than 'TcpUserTimeoutMin' and greater than or equal to 'TcpUserTimeoutDef'.
        float TcpIpTcpUserTimeoutMin [0..1]: 0..5000, multiplicity set at pre-compile, origin=Vector Informatik, post-build-variant-value=true, set at pre-compile, default-value=5  # User Timeout Min | This value specifies the minimum value for User Timeout. (default: 5s) RFC 1122 defines it to 100 seconds (3 minutes for SYN segments). RESTRICTION: Value of 'TcpUserTimeoutMin' has to be smaller than 'TcpUserTimeoutMax' and smaller than or equal to 'TcpUserTimeoutDef'.
        boolean TcpIpTcpUserTimeoutOptionSupport: multiplicity set at pre-compile, origin=Vector Informatik, set at pre-compile, default-value=false  # User Timeout Option Support | This parameter defines if the User Timeout Option of TCP is enabled.
        boolean TcpIpTcpTimeStampOptionSupport: multiplicity set at pre-compile, origin=Vector Informatik, set at pre-compile, default-value=false  # Time Stamp Option | This parameter defines if the Timestamp Option of TCP is enabled.
        float TcpIpTcpNagleTimeout [0..1]: 0..0.255, multiplicity set at pre-compile, origin=Vector Informatik, post-build-variant-value=true, set at pre-compile, default-value=0  # Nagle Timeout | This value specifies the timeout for Nagle algorithm, The timeout defines the time after which a small TCP segment is sent even though a previous segment is not yet acked. Setting the timeout value to '0' turns the timeout function off and TCP will wait forever to send a small segment if previously sent data is still not acked by the peer. This setting may cause a huge delay if the peer uses 'delayed acknowledgement'. Note: Value must be a multiple of Main Function Period RESTRICTIONS: 'TcpNagleTimeoutMsec' is only available, if 'TcpEnableNagle' is enabled.
        integer TcpIpTcpTxResetQueueSize: 0..127, multiplicity set at pre-compile, origin=Vector Informatik, set at pre-compile, default-value=8  # Tx Reset Queue Size | This value specifies the amount of entries reserved for the Tx Reset Queue. Note: The Reset Queue is shared by all TCP Sockets.
        integer TcpIpTcpTxRetryQueueSize: 0..127, multiplicity set at pre-compile, origin=Vector Informatik, set at pre-compile, default-value=10  # Average Tx Retry Queue Size | This value specifies the average amount of entries allocated for the Tx Retry Queue of one TCP Socket. Note: The Retry Queues are grouped in a pool shared by all TCP Sockets. Therefore a Socket may have less entries available as specified.
        boolean TcpIpTcpOutOfOrderRxSupport: multiplicity set at pre-compile, origin=Vector Informatik, set at pre-compile, default-value=true  # Out Of Order Rx Support | This parameter defines if the reception of out of order TCP segments is supported.
        float TcpIpTcpRetransmissionTimeoutMax [0..1]: 1..300, multiplicity set at , origin=Vector Informatik, post-build-variant-value=true, set at pre-compile, default-value=60  # Retransmission Timeout Max | Maximum Timeout before an unacknowledged TCP segment is sent again. This value is an upper limit for the exponential backoff of the retransmission timer and the computation according to [RFC 6298 Computing TCP's Retransmission Timer] if the Timestamp Option defined in [RFC1323] is enabled.
        container TcpIpTcpSocketBuffer [1..*]: multiplicity set at pre-compile  # This container includes the rx and tx buffer configuration of a TCP socket. The number of available socket handles will be the sum of all TCP rx and tx buffer configurations and the number of all TCP listen sockets. Note: rx and tx buffers are not bound to a specific socket handle. The buffers are shared between all users and must be allocated to a socket during runtime via the TcpIp_ChangeParameter() API.
          integer TcpIpTcpSocketRxBufferSize: 1..65535, multiplicity set at pre-compile, origin=Vector Informatik, set at pre-compile, default-value=512  # Socket Rx Buffer Size | This value specifies the size of a RX buffer segment that can be allocated to a TCP socket handle via the TcpIp_ChangeParameter() API during runtime. Note: A buffer segment is shared between all TCP sockets but can only be used for one socket at a time. If multiple sockets with the same buffer size shall be used simultaneously, multiple buffer segments of the same size have to be configured.
          integer TcpIpTcpSocketTxBufferSize: 1..65535, multiplicity set at pre-compile, origin=Vector Informatik, set at pre-compile, default-value=512  # Socket Tx Buffer Size | This value specifies the size of a TX buffer segment that can be allocated to a TCP socket handle via the TcpIp_ChangeParameter() API during runtime. Note: A buffer segment is shared between all TCP sockets but can only be used for one socket at a time. If multiple sockets with the same buffer size shall be used simultaneously, multiple buffer segments of the same size have to be configured.
      container TcpIpUdpConfig [0..1]: multiplicity set at pre-compile  # Specifies the configuration parameters of the UDP (User Datagram Protocol) sub-module
        integer TcpIpUdpTtl: 0..255, multiplicity set at pre-compile, post-build-variant-value=true, set at pre-compile, default-value=64  # TTL | Default Time-to-live value of outgoing UDP packets.
        integer TcpIpUdpTxRetryQueueSize [0..1]: 1..255, multiplicity set at pre-compile, origin=Vector Informatik, set at pre-compile, default-value=1  # Tx Retry Queue Size | Total number of UDP Tx Retry Queue elements, the number has to be smaller as or equal to the number of EthTxBufTotal. This value specifies the number of UDP transmit messages that can be stored in case there is no valid resolution of the remote physical address (using ARP or NDP) available. A configured value requires an enabled ARP/NDP packet queue.
        container TcpIpUdpTxReqList [0..*]: multiplicity set at pre-compile  # This container includes configuration parameters of a UDP TX request list that can be attached to a UDP socket handle via TcpIp_ChangeParameter() during runtime. A UDP socket only needs a TX request list if a TxConfirmation is required by the upper layer. Note: A UDP tx request list is shared between all UDP sockets but can only be used for one socket at a time. If multiple sockets with the same request list size shall be used simultaneously, multiple request lists of the same size have to be configured.
          integer TcpIpUdpTxReqListSize: 1..255, multiplicity set at pre-compile, origin=Vector Informatik, set at pre-compile, default-value=1  # Tx Req List Size | This value specifies the maximum number of entries in the UDP TX request list.
      container TcpIpDuplicateAddressDetectionConfig [0..1]: multiplicity set at pre-compile  # This container is a subcontainer of TcpIpConfig and configures the DAD callout function.
        string TcpIpDuplicateAddressDetectionHeaderFileName: multiplicity set at pre-compile, set at pre-compile, max-length=32, min-length=1  # Header File Name | This parameter specifies the name of the header file containing the definition of the duplicate address detection handler function.
        function name TcpIpDuplicateAddressDetectionCalloutName: scope=ECU, multiplicity set at pre-compile, set at pre-compile  # Handler Name | This parameter defines the name of the duplicate address detection function <Up_DADAddressConflict>.
      container TcpIpIpSecConfigSet [0..*]: multiplicity set at pre-compile  # Security Policy Database Configuration | Specifies the IPsec configuration.
        integer TcpIpRemoteDeviceNum: 1.., multiplicity set at pre-compile, origin=Vector Informatik, post-build-variant-value=true, set at pre-compile  # Amount of remote clients which will negotiate a Security Association (SA).
        function name TcpIpIpSecSpdCalloutFunction [0..1]: multiplicity set at pre-compile, origin=Vector Informatik, set at pre-compile  # IPsec Security Policy Database Callout Function | This parameter specifies the name of a callout function that shall be called for each Rx/Tx messag, after the IPsec has processed all corresponding SPD entries and has determined the policy. The callout function allows it to override the applied policy.
        string TcpIpIpSecCalloutHeaderFile [0..1]: multiplicity set at pre-compile, origin=Vector Informatik, set at pre-compile  # IPsec Callout Function Header File | This parameter specifies the name of the header file containing the definition for the functions specified in TcpIpIpSecSpdCalloutFunction and TcpIpIpSecAuditEventCalloutFunction.
        function name TcpIpIpSecAuditEventCalloutFunction [0..1]: multiplicity set at pre-compile, origin=Vector Informatik, set at pre-compile  # IPsec Auditable Event Callout Function | This parameter specifies the name of a callout function that will be called for each auditable event.
        container TcpIpSpdEntry [1..*]: multiplicity set at pre-compile  # Entry of the Security Policy Database (SPD).
          enumeration TcpIpIpSecPolicy: {TCPIP_IPSEC_POLICY_PROTECT, TCPIP_IPSEC_POLICY_OPTIONAL, TCPIP_IPSEC_POLICY_BYPASS, TCPIP_IPSEC_POLICY_DISCARD}, multiplicity set at pre-compile, origin=Vector Informatik, post-build-variant-value=true, set at pre-compile  # Policy for usage of IPsec.
          integer TcpIpIpSecPriority: 0.., multiplicity set at pre-compile, origin=Vector Informatik, post-build-variant-value=true, set at pre-compile, default-value=0  # Priority of the SPD entry. The processing of entries is based on priority, starting with the highest priority "0". The first matching SPD entry defines the policy.
          enumeration TcpIpIpSecHeaderType: {TCPIP_IPSEC_HDR_AH, TCPIP_IPSEC_HDR_ESP, TCPIP_IPSEC_HDR_NONE}, multiplicity set at pre-compile, origin=Vector Informatik, post-build-variant-value=true, set at pre-compile, default-value=TCPIP_IPSEC_HDR_AH  # Header type speifying the IPsec secutiry mechanism.
          integer TcpIpLocalPortRangeStart [0..1]: 1..65535, multiplicity set at pre-compile, origin=Vector Informatik, post-build-variant-value=true, set at pre-compile  # Start value of the local port range.
          integer TcpIpLocalPortRangeEnd [0..1]: 1..65535, multiplicity set at pre-compile, origin=Vector Informatik, post-build-variant-value=true, set at pre-compile  # End value of the local port range.
          string TcpIpLocalIpAddrStart [0..1]: multiplicity set at pre-compile, origin=Vector Informatik, post-build-variant-value=true, set at pre-compile  # Start value of the local IP address range.
          string TcpIpLocalIpAddrEnd [0..1]: multiplicity set at pre-compile, origin=Vector Informatik, post-build-variant-value=true, set at pre-compile  # End value of the remote IP address range.
          string TcpIpRemIpAddrStart [0..1]: multiplicity set at pre-compile, origin=Vector Informatik, post-build-variant-value=true, set at pre-compile  # Start value of the remote IP address range.
          string TcpIpRemIpAddrEnd [0..1]: multiplicity set at pre-compile, origin=Vector Informatik, post-build-variant-value=true, set at pre-compile  # End value of the remote IP address range.
          integer TcpIpRemPortRangeStart [0..1]: 1..65535, multiplicity set at pre-compile, origin=Vector Informatik, post-build-variant-value=true, set at pre-compile  # Start value of the remote port range.
          integer TcpIpRemPortRangeEnd [0..1]: 1..65535, multiplicity set at pre-compile, origin=Vector Informatik, post-build-variant-value=true, set at pre-compile  # End value of the remote port range.
          enumeration TcpIpProtocol: {TCPIP_PROTOCOL_TCP, TCPIP_PROTOCOL_UDP, TCPIP_PROTOCOL_ANY, TCPIP_PROTOCOL_ICMP}, multiplicity set at pre-compile, origin=Vector Informatik, post-build-variant-value=true, set at pre-compile  # Relevant IP protocol. Note: As specified in IETF Rfc 4301 section 6, ICMP error messages will always be BYPASSed. The policy for TCPIP_PROTOCOL_ICMP only applies to ICMP non-error messages. (Echo reply/response).
        container TcpIpIntegrityAlgorithm [1..*]: multiplicity set at pre-compile  # Container for configuration of supported integrity algorithm transforms. This container is used to configure supported algorithms for AH. The transform algorithm must be configured in the Crypto module.
          enumeration TcpIpIntegrityTransformIdentifier: {TCPIP_IPSEC_TRANSFORM_AUTH_HMAC_SHA2_256_128, TCPIP_IPSEC_TRANSFORM_AUTH_HMAC_SHA2_384_192, TCPIP_IPSEC_TRANSFORM_AUTH_HMAC_SHA2_512_256, TCPIP_IPSEC_TRANSFORM_AUTH_HMAC_MD5_96, TCPIP_IPSEC_TRANSFORM_AUTH_AES_128_GMAC, TCPIP_IPSEC_TRANSFORM_AUTH_AES_192_GMAC, TCPIP_IPSEC_TRANSFORM_AUTH_AES_256_GMAC, TCPIP_IPSEC_TRANSFORM_AUTH_HMAC_SHA1_96, TCPIP_IPSEC_TRANSFORM_AUTH_DES_MAC, TCPIP_IPSEC_TRANSFORM_AUTH_KPDK_MD5, TCPIP_IPSEC_TRANSFORM_AUTH_AES_XCBC_96, TCPIP_IPSEC_TRANSFORM_AUTH_HMAC_MD5_128, TCPIP_IPSEC_TRANSFORM_AUTH_HMAC_SHA1_160, TCPIP_IPSEC_TRANSFORM_AUTH_AES_CMAC_96}, multiplicity set at pre-compile, origin=Vector Informatik, set at pre-compile, default-value=TCPIP_IPSEC_TRANSFORM_AUTH_HMAC_SHA2_256_128  # Integrity algorithm transform identifier. Parameter values are defined as per IETF RFC 7296 3.3.2
          container TcpIpIntegrityTransformJobPair [1..*]: multiplicity set at pre-compile  # Container for storing the CSM integrity transform job references for performing authentication. Valid for ESP and AH. Atleast one Integrity transform job pair needs to be configured for each Integrity Algorithm.
            symbolic name reference TcpIpCsmGenerateJobRef: multiplicity set at pre-compile, origin=Vector Informatik, set at pre-compile, destination=CsmJob  # The referenced Csm job is used for the execution of the CsmMacGenerate primitive needed for this transform. Must be a valid MAC generate job of the parent type.
            symbolic name reference TcpIpCsmVerifyJobRef: multiplicity set at pre-compile, origin=Vector Informatik, set at pre-compile, destination=CsmJob  # The referenced Csm job is used for the execution of the CsmMacVerify primitive needed for this transform. Must be a valid MAC verify job of the parent type.
        container TcpIpEncryptionAlgorithm [0..*]: multiplicity set at pre-compile  # Container for configuration of supported encryption algorithm transforms. This container is used to configure supported algorithms for ESP. The transform algorithm must be configured in the Crypto module.
          enumeration TcpIpEncryptionTransformIdentifier: {TCPIP_IPSEC_TRANSFORM_ENCR_DES_IV64, TCPIP_IPSEC_TRANSFORM_ENCR_DES, TCPIP_IPSEC_TRANSFORM_ENCR_3DES, TCPIP_IPSEC_TRANSFORM_ENCR_RC5, TCPIP_IPSEC_TRANSFORM_ENCR_IDEA, TCPIP_IPSEC_TRANSFORM_ENCR_CAST, TCPIP_IPSEC_TRANSFORM_ENCR_BLOWFISH, TCPIP_IPSEC_TRANSFORM_ENCR_3IDEA, TCPIP_IPSEC_TRANSFORM_ENCR_DES_IV32, TCPIP_IPSEC_TRANSFORM_ENCR_NULL, TCPIP_IPSEC_TRANSFORM_ENCR_AES_CBC, TCPIP_IPSEC_TRANSFORM_ENCR_AES_CTR, TCPIP_IPSEC_TRANSFORM_ENCR_AES_CCM_8, TCPIP_IPSEC_TRANSFORM_ENCR_AES_CCM_12, TCPIP_IPSEC_TRANSFORM_ENCR_AES_CCM_16, TCPIP_IPSEC_TRANSFORM_ENCR_AES_GCM_8, TCPIP_IPSEC_TRANSFORM_ENCR_AES_GCM_12, TCPIP_IPSEC_TRANSFORM_ENCR_AES_GCM_16, TCPIP_IPSEC_TRANSFORM_ENCR_CAMELLIA_CBC, TCPIP_IPSEC_TRANSFORM_ENCR_CAMELLIA_CTR, TCPIP_IPSEC_TRANSFORM_ENCR_CAMELLIA_CCM_8, TCPIP_IPSEC_TRANSFORM_ENCR_CAMELLIA_CCM_12, TCPIP_IPSEC_TRANSFORM_ENCR_CAMELLIA_CCM_16, TCPIP_IPSEC_TRANSFORM_ENCR_CHACHA20_POLY1305, TCPIP_IPSEC_TRANSFORM_ENCR_AES_CCM_8_IIV, TCPIP_IPSEC_TRANSFORM_ENCR_AES_GCM_16_IIV, TCPIP_IPSEC_TRANSFORM_ENCR_CHACHA20_POLY1305_IIV}, multiplicity set at pre-compile, origin=Vector Informatik, set at pre-compile, default-value=TCPIP_IPSEC_TRANSFORM_ENCR_DES  # Encryption algorithm transform identifier. Parameter values are defined as per IETF RFC 7296 3.3.2
          container TcpIpEncryptionTransformJobPair [1..*]: multiplicity set at pre-compile  # Container for storing the CSM encryption transform job references for performing encryption. Only valid for ESP. Atleast one Integrity encryption job pair needs to be configured for each Integrity encrypytion algorithm.
            symbolic name reference TcpIpCsmEncryptJobRef: multiplicity set at pre-compile, origin=Vector Informatik, set at pre-compile, destination=CsmJob  # The referenced Csm job is used for the execution of the CsmMacGenerate primitive needed for this transform. Must be a valid encryption job of the parent type.
            symbolic name reference TcpIpCsmDecryptJobRef: multiplicity set at pre-compile, origin=Vector Informatik, set at pre-compile, destination=CsmJob  # The referenced Csm job is used for the execution of the CsmMacVerify primitive needed for this transform. Must be a valid decryption job of the parent type.
    container TcpIpGeneral: multiplicity set at pre-compile  # This container is a subcontainer of TcpIp and specifies the general configuration parameters of the TCP/IP stack.
      integer TcpIpBufferMemory: 0..4294967295, multiplicity set at pre-compile, set at pre-compile, default-value=0  # Memory size in bytes reserved for TCP/IP buffers.
      boolean TcpIpDevErrorDetect: multiplicity set at pre-compile, set at pre-compile, default-value=true  # If true then TCP/IP will enable the error-reporting to the Development Error Tracer (DET).
      boolean TcpIpDhcpServerEnabled: multiplicity set at pre-compile, set at pre-compile, default-value=false  # DHCP Server Enabled | Enables (TRUE) or disables (FALSE) the DHCPv4 (Dynamic Host Configuration Protocol) Server.
      float TcpIpMainFunctionPeriod: 0.001..1000, multiplicity set at pre-compile, set at pre-compile, default-value=0.005  # MainFunction Period | Period of TcpIp_MainFunction.
      boolean TcpIpResetIpAssignmentApi: multiplicity set at pre-compile, set at pre-compile, default-value=true  # Reset IP Assignment Api | Enables/disables the API TcpIp_ResetIpAssignment of a DHCP-client. (This parameter is currently not used and does not affect the functionality of the module.)
      enumeration TcpIpScalabilityClass: {SC1, SC2, SC3}, multiplicity set at pre-compile, set at pre-compile, default-value=SC1  # In order to customize the TcpIp Stack to the specific needs of the user it can be scaled according to the scalability classes.
      boolean TcpIpTcpEnabled: multiplicity set at pre-compile, set at pre-compile, default-value=false  # TCP Enabled | Enables (TRUE) or disabled (FALSE) support of TCP (Transmission Control Protocol).
      integer TcpIpTcpSocketMax: 0..65535, multiplicity set at pre-compile, set at pre-compile, default-value=0  # TCP Socket Max | Maximum number of TCP sockets
      boolean TcpIpUdpEnabled: multiplicity set at pre-compile, set at pre-compile, default-value=false  # UDP Enabled | Enables (TRUE) or disabled (FALSE) support of UDP (User Datagram Protocol)
      integer TcpIpUdpSocketMax: 0..65535, multiplicity set at pre-compile, set at pre-compile, default-value=0  # UDP Socket Max | Maximum number of UDP sockets.
      boolean TcpIpVersionInfoApi: multiplicity set at pre-compile, set at pre-compile, default-value=false  # If true the TcpIp_GetVersionInfo API is available.
      string TcpIpUserConfigFile [0..1]: multiplicity set at pre-compile, origin=Vector Informatik, set at pre-compile  # User Config File | Reference to an external user configuration file that will be included during generation. The content of the user configuration file will be added at the end of the generated module configuration file and allows altering or extending the generated code. Caution: User configuration files can cause the software module to malfunction and must only be used with great care!
      function name TcpIpRandNoFct: multiplicity set at pre-compile, origin=Vector Informatik, set at pre-compile, default-value=Appl_Crypto_GetRandNo  # Random Number Function | This parameter defines the function called for the random number generation.
      string TcpIpRandNoFctIncludeFile: multiplicity set at pre-compile, origin=Vector Informatik, set at pre-compile, default-value=Appl_Rand.h  # Random Function Include File | This parameter defines the header file holding the declaration of the random number generation function defined in 'TcpIpRandNoFct'.
      boolean TcpIpDiagExtensionsEnabled: multiplicity set at pre-compile, origin=Vector Informatik, set at pre-compile, default-value=false  # Enable diagnostic read access to several parameters. For some parameters read access has to be enabled separately. Read features can be located at TcpIp_General or at the different sub-components.
      string TcpIpLowerLayerName: multiplicity set at pre-compile, origin=Vector Informatik, set at pre-compile, default-value=EthIf, min-length=1  # Lower Layer Name | This parameter defines the name of TcpIp's lower layer. According to AUTOSAR this is the EthIf module. This parameter should only be changed if there is a special CDD between EthIf and the TcpIp module.
      boolean TcpIpMainFunctionSplitEnabled: multiplicity set at pre-compile, origin=Vector Informatik, set at pre-compile, default-value=false  # MainFunction Splitting Enabled | This parameter specifies whether the TcpIp_MainFunction shall be split-up into three functions. This allows optimizing the reception and transmission path of upper layer data for a specific use case. TcpIp_MainFunctionRx - Handles reception of data and forwards it to upper-layer. TcpIp_MainFunctionState - Handles module state changes and transmits data of internal protocols (e.g DHCP and ARP/NDP messages). TcpIp_MainFunctionTx - Handles transmission requests of upper-layer and transmits data. Note: All TcpIp MainFunctions must be called from the same task or at least from tasks that do not interrupt each other.
      boolean TcpIpSafeBswChecks: multiplicity set at pre-compile, origin=Vector Informatik, set at pre-compile, default-value=false  # Selects if safety checks are used. These checks improve robustness as e.g. invalid parameters are checked before function is executed. This attribute has to be enabled for safety projects where this component is mapped to an ASIL partition.
      boolean TcpIpGetDhcpStatusApi: multiplicity set at pre-compile, origin=Vector Informatik, set at pre-compile, default-value=false  # Enables/disables the APIs TcpIp_DhcpV4_GetStatus (in case IPv4 is enabled) and TcpIp_DhcpV6_GetStatus (in case IPv6 is enabled) of a DHCP-client.
      boolean TcpIpIpSecEnabled: multiplicity set at pre-compile, origin=Vector Informatik, set at pre-compile, default-value=false  # IPsec Enabled | Enables (TRUE) or disables (FALSE) support of IPsec (Internet Protocol Security).
      boolean TcpIpGetAndResetMeasurementDataApi: multiplicity set at pre-compile, origin=Vector Informatik, set at pre-compile, default-value=false  # Enables / Disables the Get and Reset Measurement Data API
      container TcpIpIpV4General: multiplicity set at pre-compile  # This container is a subcontainer of TcpIp and specifies the general configuration parameters of the TCP/IP stack for IPv4
        boolean TcpIpArpEnabled: multiplicity set at pre-compile, set at pre-compile, default-value=true  # ARP Enabled | Enables (TRUE) or disables (FALSE) support of ARP (Address Resolution Protocol).
        boolean TcpIpAutoIpEnabled: multiplicity set at pre-compile, set at pre-compile, default-value=false  # AutoIp Enabled | Enables (TRUE) or disables (FALSE) the Auto-IP (automatic private IP addressing) sub-module.
        boolean TcpIpDhcpClientEnabled: multiplicity set at pre-compile, set at pre-compile, default-value=false  # DHCP Client Enabled | Enables (TRUE) or disables (FALSE) the DHCP (Dynamic Host Configuration Protocol) Client.
        boolean TcpIpIcmpEnabled: multiplicity set at pre-compile, set at pre-compile, default-value=true  # ICMP Enabled | Enables (TRUE) or disabled (FALSE) support of ICMP (Internet Control Message Protocol).
        boolean TcpIpIpV4Enabled: multiplicity set at pre-compile, set at pre-compile, default-value=false  # IPv4 Enabled | Enables (TRUE) or disables (FALSE) support of IPv4 (Internet Protocol version 4).
        integer TcpIpLocalAddrIpv4EntriesMax: 0..255, multiplicity set at pre-compile, set at pre-compile, default-value=0  # Local Addr IPv4 Entries Max | Maximum number of LocalAddr table entries for IPv4.
        boolean TcpIpPathMtuDiscoveryEnabled: multiplicity set at pre-compile, set at pre-compile, default-value=false  # Path MTU Discovery Enabled | Enables (TRUE) or disables (FALSE) the discovery of the maximum transmission unit on a path according to IETF RfC 1191. (This parameter is currently not used and does not affect the functionality of the module.)
        boolean TcpIpIpV4EthIfUpdatePhysAddrFilterApiEnabled: multiplicity set at pre-compile, origin=Vector Informatik, set at pre-compile, default-value=true  # IPv4 EthIf Update Phys Addr Filter Api Enabled | This parameter defines whether the IPv4 will call EthIf_SetPhysAddrFilter() in order to configure the ethernet group address Rx filter. If the controller is in promiscuous mode or statically configured to accept all neccessary multicasts, this parameter can be disabled in order to avoid superfluous calls to the EthIf API.
        boolean TcpIpArpDiscardedEntryHandling: multiplicity set at pre-compile, origin=Vector Informatik, set at pre-compile, default-value=false  # Enables (TRUE) or disables (FALSE) the treatment of the ARP cache as table that can be "full". In case the table is full, new entries are discarded and this fact is indicated by the callback function configured in TcpIpPhysAddrChgDiscardedEntryHandlerName.
        reference TcpIpIpV4DefaultCtrl [0..1]: multiplicity set at pre-compile, origin=Vector Informatik, set at pre-compile, destination=TcpIpIpV4Ctrl  # Default IPv4 Controller | Reference to a default controller that shall be used for outgoing messages if a socket is bound to TCPIP_LOCALADDRID_ANY and the controller cannot be determined by the subnet of the destination address.
      container TcpIpIpV6General: multiplicity set at pre-compile  # This container is a subcontainer of TcpIp and specifies the general configuration parameters of the TCP/IP stack for IPv6.
        boolean TcpIpDhcpV6ClientEnabled: multiplicity set at pre-compile, set at pre-compile, default-value=false  # DHCPv6 Client Enabled | Enables (TRUE) or disables (FALSE) the DHCPv6 (Dynamic Host Configuration Protocol for IPv6) Client.
        boolean TcpIpIpV6Enabled: multiplicity set at pre-compile, set at pre-compile, default-value=false  # IPv6 Enabled | Enables (TRUE) or disables (FALSE) support of IPv6 (Internet Protocol version 6).
        boolean TcpIpIpV6PathMtuDiscoveryEnabled: multiplicity set at pre-compile, set at pre-compile, default-value=false  # IPv6 Path Mtu Discovery Enabled | Enables (TRUE) or disables (FALSE) Path MTU Discovery support for IPv6 according to IETF RFC 1981.
        integer TcpIpLocalAddrIpv6EntriesMax: 0..255, multiplicity set at pre-compile, set at pre-compile, default-value=0  # Local Addr IPv6 Entries Max | Maximum number of LocalAddr table entries for IPv6.
        boolean TcpIpNdpAddressResolutionUnrechabilityDetectionEnabled: multiplicity set at pre-compile, set at pre-compile, default-value=true  # NDP Address Resolution Unrechability Detection Enabled | Enables (TRUE) or disables (FALSE) support of Address Resoultion and Neighbor Unreachability Detetion via NDP.
        boolean TcpIpNdpPrefixAndRouterDiscoveryEnabled: multiplicity set at pre-compile, set at pre-compile, default-value=true  # NDP Prefix And Router Discovery Enabled | Enables (TRUE) or disables (FALSE) support of Prefix and Router Discovery via NDP.
        boolean TcpIpIpV6EthIfUpdatePhysAddrFilterApiEnabled: multiplicity set at pre-compile, origin=Vector Informatik, set at pre-compile, default-value=true  # IPv6 EthIf Update Phys Addr Filter Api Enabled | This parameter defines whether the IPv6 will call EthIf_SetPhysAddrFilter() in order to configure the ethernet group address Rx filter. Since the IPv6 Neighbor Discovery Protocol uses ethernet link-layer multicasts, the controller must be configured to accept received ethernet multicast IPv6 packets. If the controller is in promiscuous mode or statically configured to accept all neccessary multicasts, this parameter can be disabled in order to avoid superfluous calls to the EthIf API.
        boolean TcpIpIpV6SetTrafficClassAndFlowLabelApiEnabled: multiplicity set at pre-compile, origin=Vector Informatik, set at pre-compile, default-value=false  # IPv6 Set Traffic Class And Flow Label Api Enabled | This parameter defines whether the IPv6 provides the IpV6_SetTrafficClass() and IpV6_SetFlowLabel() APIs to change the Traffic Class octet of the IPv6 header for outgoing packets. If enabled the value can be set on a per-socket basis during runtime. The default values for the Traffic Class and the Flow Label for all outgoing packets are controller specific and are configured by the IpV6DefaultTrafficClass and IpV6DefaultFlowLabel parameters. [RFC2460 3. IPv6 Header Format] [RFC2460 7. Traffic Classes] see also [RFC2474 3. Differentiated Services Field Definition]
        boolean TcpIpIpV6ExtendedDestAddrValidationEnabled: multiplicity set at pre-compile, origin=Vector Informatik, set at pre-compile, default-value=false  # IPv6 Extended Dest Addr Validation Enabled | This parameter defines whether the IPv6 will check the destination address every time IpV6_ProvideTxBuffer() is called. If disabled the user should call IpV6_IsValidDestinationAddr() before IpV6_ProvideTxBuffer() is called the first time with a specific destination address.
        boolean TcpIpIpV6CacheLookupOptimizationEnabled: multiplicity set at pre-compile, origin=Vector Informatik, set at pre-compile, default-value=true  # IPv6 Cache Lookup Optimization Enabled | This parameter defines whether lookups in internal IPv6 data structures shall be optimized. If enabled the last lookup result is stored and reused for the next lookup. Disabling this feature will save some bytes in RAM and ROM but reduce performance.
        reference TcpIpIpV6DefaultCtrl [0..1]: multiplicity set at pre-compile, origin=Vector Informatik, set at pre-compile, destination=TcpIpIpV6Ctrl  # Default IPv6 Controller | Reference to a default controller that shall be used for outgoing messages if a socket is bound to TCPIP_LOCALADDRID_ANY and the controller cannot be determined by the subnet of the destination address.
      container TcpIpGeneration: multiplicity set at pre-compile  # Contains the generation configuration parameters of the module TcpIp. Please refer to the parameter description and to the TechnicalReference_CommonAsr_ComStackLib which is part of the delivery for more information. Please note that there are customizations which are only valid for a specific quality level (e.g. during the development phase).
        enumeration TcpIpOutOfBoundsWriteProtectionStrategy: multiplicity set at pre-compile, origin=Vector Informatik, set at pre-compile, default-value=NONE  # This parameter is used to configure a strategy to protect the code to write out of bounds. NONE: no protection strategy is generated in the data access. INDEX_SATURATION: arrays are blown up and the data access index is saturated by an appropriate mask. The advantage is the speed of the data access, but own data elements at other indexes of the same variable can be overridden. INDEX_CHECKING: the data access index is validated by a runtime check. The advantage is that values are never written to incorrect indexes of the data access.
          NONE  # none
          INDEX_SATURATION  # index saturation
          INDEX_CHECKING  # index checking
        boolean TcpIpOutOfBoundsWriteSanitizer: multiplicity set at pre-compile, origin=Vector Informatik, set at pre-compile, default-value=false  # This parameter activates/deactivates the generation of runtime checks which call a DET error notification function to find easily out of bounds write problems. FALSE: no checks are generated in the data access. TRUE: the data access is enriched with DET checks to validate indexes.
        boolean TcpIpOutOfBoundsReadSanitizer: multiplicity set at pre-compile, origin=Vector Informatik, set at pre-compile, default-value=false  # This parameter activates/deactivates the generation of runtime checks which call a DET error notification function to find easily out of bounds read problems. FALSE: no checks are generated in the data access. TRUE: the data access is enriched with DET checks to validate indexes.
        boolean TcpIpReduceConstantData2Define: multiplicity set at pre-compile, origin=Vector Informatik, set at pre-compile, default-value=false  # Reduce Constant Data To a Define | This parameter activates/deactivates the capability to generate CONFIG-CLASS PRE-COMPILE ROM arrays as constant define. FALSE: ROM arrays are generated as data even if all values are identical. TRUE: ROM arrays are generated as constant define if all values are identical.
        enumeration TcpIpBoolDataInArrayOfStructStrategy: multiplicity set at pre-compile, origin=Vector Informatik, set at pre-compile, default-value=BITMASKING  # This parameter is used to tailor the usage of boolean data in structures in all CONFIG-CLASSES ROM data. The difference between BITFIELD and BITMASKING depends on your compiler options and memory mapping. BOOLEAN: the datatype of boolean data is native boolean. BITFIELD: the bitfield type is used and the compiler extracts the boolean data from structures. BITMASKING: generated masks are used to extract the boolean data from structures.
          BOOLEAN  # boolean
          BITFIELD  # bitfield
          BITMASKING  # bitmasking
        boolean TcpIpDeduplicateIndirectedData: multiplicity set at pre-compile, origin=Vector Informatik, set at pre-compile, default-value=true  # This parameter activates/deactivates the capability to compress 0:N relational ROM data in all CONFIG-CLASSES without increasing the runtime. FALSE: 0:N relational ROM data is not compressed. TRUE: 0:N relational ROM data is compressed without increasing the runtime.
        enumeration TcpIpDataDeduplicationStrategy: multiplicity set at pre-compile, origin=Vector Informatik, set at pre-compile, default-value=NONE  # This parameter is used to taylor the the deduplication of CONFIG-CLASS PRE-COMPILE ROM data. NONE: The generated data is not deduplicated. DEDUPLICATE_CONST_DATA_WITHOUT_CAST: The data is deduplicated without using casts. DEDUPLICATE_CONST_DATA_WITH_CAST: The data is deduplicated using casts.
          NONE  # none
          DEDUPLICATE_CONST_DATA_WITHOUT_CAST  # deduplicate const data without cast
          DEDUPLICATE_CONST_DATA_WITH_CAST  # deduplicate const data with cast
        integer TcpIpReduceBoolDataByNegationThreshold: 0..9223372036854775807, multiplicity set at pre-compile, origin=Vector Informatik, set at pre-compile, default-value=2  # This parameter activates/deactivates the capability to compress boolean CONFIG-CLASS PRE-COMPILE ROM data by using the negation operator. 0: The optimization is deactivated. >0: If the number of deduplicateable elements is greater than this threshold the data optimization can be performed.
        integer TcpIpReduceBoolDataByNumericalComparisonThreshold: 0..9223372036854775807, multiplicity set at pre-compile, origin=Vector Informatik, set at pre-compile, default-value=2  # This parameter activates/deactivates the capability to compress boolean CONFIG-CLASS PRE-COMPILE ROM data by using numerical comparison with other ROM data. 0: The optimization is deactivated. >0: If the number of deduplicateable elements is greater than this threshold the data optimization can be performed.
        integer TcpIpReduceBoolDataByNumericalRelationThreshold: 0..9223372036854775807, multiplicity set at pre-compile, origin=Vector Informatik, set at pre-compile, default-value=2  # This parameter activates/deactivates the capability to compress boolean CONFIG-CLASS PRE-COMPILE ROM data by using relational comparison with other ROM data. 0: The optimization is deactivated. >0: If the number of deduplicateable elements is greater than this threshold the data optimization can be performed.
        enumeration TcpIpReduceBoolDataByNumericalOperandStrategy: multiplicity set at pre-compile, origin=Vector Informatik, set at pre-compile, default-value=DEDUPLICATE_DATA_WITH_ANY_VALUE  # This parameter is used to taylor the CONFIG-CLASS PRE-COMPILE ROM bool data with number deduplication mechanisms. A comparison with 0 is very efficient, but a numerical comparison with a value not 0 can be used to increase the ROM data compression rate. NONE: ROM data deduplications are switched off. DEDUPLICATE_DATA_WITH_ZERO: ROM data deduplications can be applied with the value 0. DEDUPLICATE_DATA_WITH_ANY_VALUE: ROM data deduplications can be applied with any numerical value.
          NONE  # none
          DEDUPLICATE_DATA_WITH_ZERO  # deduplicate data with zero
          DEDUPLICATE_DATA_WITH_ANY_VALUE  # deduplicate data with any value
        integer TcpIpReduceNumericalDataByOffsetThreshold: 0..9223372036854775807, multiplicity set at pre-compile, origin=Vector Informatik, set at pre-compile, default-value=0  # This parameter activates/deactivates the capability to compress numerical CONFIG-CLASS PRE-COMPILE ROM data by using a constant offset. 0: The optimization is deactivated. >0: If the number of deduplicateable elements is greater than this threshold the data optimization can be performed.
        integer TcpIpReduceNumericalDataByArraySubtractionThreshold: 0..9223372036854775807, multiplicity set at pre-compile, origin=Vector Informatik, set at pre-compile, default-value=2  # This parameter activates/deactivates the capability to compress numerical CONFIG-CLASS PRE-COMPILE ROM data by using a subtraction with other ROM data. 0: The optimization is deactivated. >0: If the number of deduplicateable elements is greater than this threshold the data optimization can be performed.
        boolean TcpIpReduceDataByStreaming: multiplicity set at pre-compile, origin=Vector Informatik, set at pre-compile, default-value=false  # This parameter activates/deactivates the capability to pack generated CONFIG-CLASS PRE-COMPILE ROM data into a data type dependent stream. FALSE: generated const data is not packed into a data type dependent stream. TRUE: generated const data is packed into a data type dependent stream.
        boolean TcpIpShortSymbols: multiplicity set at pre-compile, origin=Vector Informatik, set at pre-compile, default-value=false  # This parameter activates/deactivates the capability to generate shortened symbol names. FALSE: symbol names are generated in a human readable style based on the MIP, tags and variant names. TRUE: symbol names are generated based on the MIP and a CRC32.
        boolean TcpIpInterfacesForDeactivatedData: multiplicity set at pre-compile, origin=Vector Informatik, set at pre-compile, default-value=false  # This parameter activates/deactivates the capability to generate bsw data interfaces for deactivated data elements. This is an advantage for the BSW developer to reduce the time to market with a development environment using auto completition and to investigate potential interfaces. FALSE: data interfaces are not generated if the data elementis deactivated. TRUE: data interfaces are generated as e.g. emty macros.
        boolean TcpIpReferringKeysInComments: multiplicity set at pre-compile, origin=Vector Informatik, set at pre-compile, default-value=false  # This parameter activates/deactivates the capability to generate referring keys in comments. This is an advantage for the developer to investigate indirections, but this feature reduces the overall readability of the generated data. FALSE: referring keys are not generated in comments. TRUE: referring keys are generated in comments.
  bsw implementation TcpIp_Impl: programming-language=C, sw-version=14.03.03, used-code-generator=DaVinci Configurator, vendor-id=30, ar-release-version=4.02.01, behavior=TcpIpBehavior, preconfigured-configuration=TcpIp_Pre, recommended-configuration=TcpIp_Rec, vendor-specific-module-def=TcpIp
  module config TcpIp_Pre: definition=TcpIp
  module config TcpIp_Rec: definition=TcpIp
