AUTOSAR XML (schema 4-0-3)
package /MICROSAR
  module definition SoAd [0..1]: category=VENDOR_SPECIFIC_MODULE_DEFINITION, refined-module-def=SoAd, variants pre-compile/post-build-loadable  # Configuration of the SoAd (Socket Adaptor) module.
    container SoAdBswModules [0..*]  # Each container describes a specific BSW module that the SoAd shall interface to.
      boolean SoAdIf: set at pre-compile, default-value=false  # Specifies if the BSW module supports the Communication Interface APIs or not. Value true means that the APIs are supported. A module can have both Communication Interface APIs and Transport Protocol APIs (e.g. the PduR module).
      boolean SoAdIfTriggerTransmit: set at pre-compile, default-value=false  # Specifies if the BSW module supports the TriggerTransmit API or not. Value true means that the API is supported.
      boolean SoAdIfTxConfirmation: set at pre-compile, default-value=false  # Specifies if the BSW module supports the TxConfirmation API or not. Value true means that the API is supported.
      boolean SoAdLocalIpAddrAssigmentChg: set at pre-compile, default-value=false  # Specifies if the BSW module supports the LocalIpAddrAssigmentChg API or not. Value true means that the API is supported.
      boolean SoAdSoConModeChg: set at pre-compile, default-value=false  # Specifies if the BSW module supports the SoConModeChg API or not. Value true means that the API is supported.
      boolean SoAdTp: set at pre-compile, default-value=false  # Specifies if the BSW module supports the TransportProtocol APIs or not. Value true means that the APIs are supported. A module can have both Communication Interface APIs and Transport Protocol APIs (e.g. the PduR module).
      boolean SoAdUseCallerInfix: set at pre-compile, default-value=true  # Specifies if SoAd shall use (TRUE) the infix "SoAd" when calling an upper layer module function or not (FALSE). E.g. if SoAdUseCallerInfix is TRUE for the upper layer "ABC" then SoAd will call ABC_SoAdIfRxIndication() otherwise SoAd would call ABC_IfRxIndication().
      boolean SoAdUseTypeInfix: set at pre-compile, default-value=true  # Specifies if SoAd shall use (TRUE) the API type infix "Tp" or "If" when calling an upper layer module function or not (FALSE). E.g. if SoAdUseTypeInfix is TRUE for the upper layer "ABC" then SoAd will call ABC_IfRxIndication(), otherwise SoAd would call ABC_RxIndication().
      boolean SoAdShutdownFinishedCbk [0..1]: set at pre-compile, origin=Vector Informatik, default-value=false  # This parameter enables a callback which is called if SoAd is in shutdown state after successful call to SoAd_Shutdown().
      boolean SoAdTpCopyTxDataWithConstPointer [0..1]: set at pre-compile, origin=Vector Informatik, default-value=false  # This parameter specifies if the upper layer Ul_[SoAd][Tp]CopyTxData() function is implemented with constant pointer for parameter "info".
      boolean SoAdTpCopyRxDataWithConstPointer [0..1]: set at pre-compile, origin=Vector Informatik, default-value=false  # This parameter specifies if the upper layer Ul_[SoAd][Tp]CopyRxData() function is implemented with constant pointer for parameter "info".
      boolean SoAdTpStartOfReceptionWithConstPointer [0..1]: set at pre-compile, origin=Vector Informatik, default-value=false  # This parameter specifies if the upper layer Ul_[SoAd][Tp]StartOfReception() function is implemented with constant pointer for parameter "info".
      foreign reference SoAdBswModuleRef: set at pre-compile, destination-type=ECUC-MODULE-CONFIGURATION-VALUES  # This is a reference to one BSW module's configuration (i.e. not the ECUC parameter definition template). | Example, there could be several configurations of PduR and this reference selects one of them. SoAd has to figure out from the structure of the referenced BSW module's configuration, what kind of upper layer he deals with. In case of a CDD SoAd expects UL-APIs in form of _SoAd<If|Tp><function> and expects CDD Pdu configuration structures according to the Ecu Configuration specification (chapter CDD module\Socket Adaptor). In case it is one of the standardized AUTOSAR BSW modules, the configuration structures and API names for interaction with SoAd are defined in the corresponding SWS.
    container SoAdConfig  # This container contains the configuration parameters and sub containers of the AUTOSAR SoAd module. This container is a MultipleConfigurationContainer, i.e. this container and its sub-containers exist once per configuration set.
      container SoAdPduRoute [0..*]: post-build-changeable=true  # Describes the path of a PDU from an upper layer of the SoAd to the socket in the TCP/IP stack for transmission.
        integer SoAdTxPduId: 0..65535, set at pre-compile, symbolic-name-value=true, default-value=0  # PDU ID | Tx PDU ID of the PDU coming from the PDU Router.
        enumeration SoAdTxUpperLayerType: {IF, TP}, set at post-build in variant post-build-loadable / pre-compile in variant pre-compile, default-value=IF  # Upper Layer Type | Specifies the upper layer interface type (must be "IF" in case of multiple PduRoutes).
        boolean SoAdTxIfTriggerTransmit [0..1]: set at post-build in variant post-build-loadable / pre-compile in variant pre-compile, origin=Vector Informatik, default-value=false  # If Trigger Transmit | This parameter defines if this PDU is transmitted via TriggerTransmit API. true: On transmission current value is retrieved via call to TriggerTransmit API of upper layer. false: Transmission is performed in context of transmit service. In context of nPduUdpTxBuffer this behavior can be used to optimize the nPduUdpTxBuffer and replace it by a request queue.
        boolean SoAdTxTpOptimized [0..1]: set at post-build in variant post-build-loadable / pre-compile in variant pre-compile, origin=Vector Informatik, default-value=false  # Tp Optimized | This parameter defines if optimization for TP transmission shall be used for this PDU. true: SoAd handles transmission in context of SoAd_TpTransmit i.e. TpCopyTxData and TpTxConfirmation of upper layer may be called in context of SoAd_TpTransmit. false: SoAd stores transmission request in SoAd_TpTransmit and handles transmission in SoAd_MainFunction (accroding to AUTOSAR).
        boolean SoAdTxIfOptimized [0..1]: set at post-build in variant post-build-loadable / pre-compile in variant pre-compile, origin=Vector Informatik, default-value=false  # If Optimized | This parameter defines if optimization for IF transmission shall be used for this PDU. true: SoAd handles the transmission in context of SoAd_IfTransmit. This means Ul_[SoAd][If]TxConfirmation and Ul_[SoAd][If]TriggerTransmit of upper layer may be called in context of SoAd_IfTransmit. false: SoAd stores and forwards transmission requests according to AUTOSAR
        boolean SoAdTxIfTriggerTransmitForceSingleCall [0..1]: set at post-build in variant post-build-loadable / pre-compile in variant pre-compile, origin=Vector Informatik, default-value=false  # This parameter defines if the Ul_[SoAd][If]TriggerTransmit API is forced to be called only once. In case of a PDU fan-out, SoAd calls Ul_[SoAd][If]TriggerTransmit for each SoAdSocketConnection, otherwise. If this parameter is enabled, a SoAdIfTriggerTransmitBuffer is used to store the PDU data retrieved by Ul_[SoAd][If]TriggerTransmit before initiating the PDU fan-out. true: SoAd calls Ul_[SoAd][If]TriggerTransmit only once. false: SoAd calls Ul_[SoAd][If]TriggerTransmit for each SoAdSocketConnection.
        reference SoAdTxPduRef: set at post-build in variant post-build-loadable / pre-compile in variant pre-compile, destination=Pdu  # PDU | Reference to the global PDU structure
        container SoAdPduRouteDest [1..*]: post-build-changeable=true  # Specifies the PDU route destination.
          integer SoAdTxPduHeaderId [0..1]: 0..4294967296, set at post-build in variant post-build-loadable / pre-compile in variant pre-compile, default-value=0  # PDU Header ID | ID to be sent on the TCP/IP connection if the PDU header option is enabled.
          enumeration SoAdTxUdpTriggerMode [0..1]: {TRIGGER_ALWAYS, TRIGGER_NEVER}, set at post-build in variant post-build-loadable / pre-compile in variant pre-compile, default-value=TRIGGER_NEVER  # UDP Trigger Mode | Specifies whether a PDU triggers the transmission of the nPduUdpTxBuffer. NPduUdpTxBuffer can only be used for upper layers with "IF" API, i.e. this parameter shall only be set if all upper layers belonging to the related socket connection have SoAdTxUpperLayerType set to "IF". This parameter is only relevant for UDP connections. TRIGGER_ALWAYS: PDU transmission triggers transmission of nPduUdpTxBuffer TRIGGER_NEVER: PDU transmission is stored in nPduUdpTxBuffer and triggers nPduUdpTxBuffer transmission only if buffer size is not sufficient
          float SoAdTxUdpTriggerTimeout [0..1]: 0..65535, set at post-build in variant post-build-loadable / pre-compile in variant pre-compile, default-value=2  # UDP Trigger Timeout | Specifies the timeout in [s] the nPduUdpTxBuffer shall be transmitted at the latest after this PDU is put into the buffer. This optional parameter is only relevant if SoAdTxUdpTriggerMode is TRIGGER_NEVER.
          choice reference SoAdTxSocketConnOrSocketConnBundleRef: set at post-build in variant post-build-loadable / pre-compile in variant pre-compile, destination=[SoAdSocketConnection, SoAdSocketConnectionGroup]  # Choice Reference to a SocketConnection or to a SocketConnectionGroup on which the PDU is to be sent on. The reference to a SocketConnectionGroup shall only be used for upper layers with IF API.
          reference SoAdTxRoutingGroupRef [0..*]: set at post-build in variant post-build-loadable / pre-compile in variant pre-compile, destination=SoAdRoutingGroup  # Routing Group | Reference to the routing group.
      container SoAdRoutingGroup [0..*]: post-build-changeable=true  # Each container describes a specific routing group which can be enabled or disabled. A routing group consists of PDUs. Routing of PDUs can either be forwarding of PDUs from the upper layer to a TCP or UDP socket of the TCP/IP stack specified by a SoAdPduRoute or the other way around specified by a SoAdSocketRoute.
        integer SoAdRoutingGroupId: 0..65535, set at pre-compile, symbolic-name-value=true, default-value=0  # Routing Group ID | Unique ID of Routing Group
        boolean SoAdRoutingGroupIsEnabledAtInit: set at post-build in variant post-build-loadable / pre-compile in variant pre-compile, default-value=true  # Enable at Initialization | If set to true this routing group will be enabled after initializing the SoAd module (i.e. enabled in the SoAd_Init function).
        boolean SoAdRoutingGroupTxTriggerable: set at post-build in variant post-build-loadable / pre-compile in variant pre-compile, default-value=false  # Enable Tx Triggerable | Specifies if the If-TxPDUs related to the PduRouteDest containers | referenced by this routing group can be triggered via SoAd_IfRoutingGroupTransmit (TRUE) or not (FALSE).
      container SoAdSocketConnectionGroup [1..*]: post-build-changeable=true  # Specifies the configuration of a socket connection group, i.e. specifies the socket connections belonging to the group and the parameters which are common for all socket connections of the group. A socket connection specifies how data can be received and transmited via a TCP or UDP socket.
        boolean SoAdPduHeaderEnable: set at post-build in variant post-build-loadable / pre-compile in variant pre-compile, default-value=false  # Enable PDU Header | Enables the transmission of the PDU header (ID, length) on this socket connection. | TRUE: add SoAd PDU header before PDU data FALSE: No SoAd PDU header is used
        boolean SoAdResourceManagementEnable: set at post-build in variant post-build-loadable / pre-compile in variant pre-compile, default-value=false  # Enable Resource Management | Enables the resource management option for this socket. | May not be activated for UDP sockets in receive. TRUE: resource management option enabled FALSE: resource management option disabled
        boolean SoAdSocketAutomaticSoConSetup: set at post-build in variant post-build-loadable / pre-compile in variant pre-compile, default-value=true  # Enable Automatic Socket Connection Setup | Specifies if the setup of the socket connection shall be done automatically (TRUE) or manually (FALSE) via SoAd_OpenSoCon() and SoAd_CloseSoCon().
        integer SoAdSocketFramePriority [0..1]: 0..7, set at post-build in variant post-build-loadable / pre-compile in variant pre-compile, default-value=7  # Ethernet Frame Priority | Specifies the priority of the Ethernet frame. | If IEEE 802.1Q VLAN Tags are used, the specified priority will be used in the VLAN Tag PCP filed. If this optional parameter is not available the default priority specified in the TcpIp module is used.
        boolean SoAdSocketIpAddrAssignmentChgNotification: set at post-build in variant post-build-loadable / pre-compile in variant pre-compile, default-value=false  # Enable IP Address Assignment Change Notification | Specifies if the local IP address assignment change notification callback function of the upper layer shall be called if the assignment of the local IP address used by this socket connection changes.
        integer SoAdSocketLocalPort: 0..65535, set at post-build in variant post-build-loadable / pre-compile in variant pre-compile, default-value=0  # Local Port | Local UDP or TCP port used for this connection.If this parameter set to 0 SoAd requests TcpIp to select an ephemeral port.
        boolean SoAdSocketMsgAcceptanceFilterEnabled: set at post-build in variant post-build-loadable / pre-compile in variant pre-compile, default-value=true  # Enable Message Acceptance Filter | Specifies if the message acceptance filter is enabled (TRUE) or not (FALSE). | Note: if a wildcard is used in SoAdSocketRemoteAddress AND SoAdSocketUdpListenOnly is FALSE, this parameter must be TRUE. Note: if multiple SoAdSocketConnections are configured for one SoAdSocketConnectionGroup, this parameter must be TRUE.
        boolean SoAdSocketSoConModeChgNotification: set at post-build in variant post-build-loadable / pre-compile in variant pre-compile, default-value=false  # Enable Socket Connection Mode Change Notification | Specifies if the SoCon mode change notification callback function of the upper layer shall be called in case of SoCon mode change.
        integer SoAdSocketTpRxBufferMin [0..1]: 0..65535, set at post-build in variant post-build-loadable / pre-compile in variant pre-compile, default-value=512  # Minimum TP Rx Buffer | Specifies the amout of data in bytes (PDU data for the upper layer and PDU Header if used) the SoAd shall at least be able to buffer for data reception via each socket connection of the socket connection group and using an upper layer with TP. | Note: in case of a TCP socket where PduHeaderMode is used and an upper layer with IF-API, the required buffer size can be determined automatically.
        boolean SoAdBestMatchWithSockRouteEnabled: set at post-build in variant post-build-loadable / pre-compile in variant pre-compile, origin=Vector Informatik, default-value=false  # Enable Best Match Algorithm with SocketRoute validation | If this feature is enabled the best match algorithm for this socket connection group considers that a socket route is configured for a socket connection. This means: The best match algortihm will not choose a socket connection which has no receiver even if the remote address matches.
        boolean SoAdBestMatchWithPduHeaderEnabled: set at post-build in variant post-build-loadable / pre-compile in variant pre-compile, origin=Vector Informatik, default-value=false  # Enable Best Match Algorithm with PDU Header validation | If this feature is enabled the best match algorithm of this socket connection group considers the received PDU Header when choosing a socket connection. A received PDU is discarded if no socket route could be found containing the corresponding PDU Header ID.
        boolean SoAdSocketAutomaticSoConSetupKeepOnline: set at post-build in variant post-build-loadable / pre-compile in variant pre-compile, origin=Vector Informatik, default-value=false  # Enable Automatic Socket Connection Setup Keep Online | This parameter defines if the socket connection is kept online on transmission in case automatic socket connection setup is used together with a remote address containing wildcards. According to AUTOSAR, a socket connection can be opened on UDP reception or on TCP connection establishment. This applies if the configured remote address contains wildcards. After transmission of a PDU, the socket connection shall be closed. TRUE: The socket connection is not closed on PDU transmission. FALSE: The socket connection is closed on PDU transmission (standard AUTOSAR behavior).
        symbolic name reference SoAdSocketLocalAddressRef: set at post-build in variant post-build-loadable / pre-compile in variant pre-compile, destination=TcpIpLocalAddr  # Local Address Reference | Local IP address and interface used for this connection.
        container SoAdSocketConnection [1..*]: post-build-changeable=true  # Specifies the socket connection (Id and remote address information). | Note: Parameters which are common to all socket connections of a socket connection group are specified directly at the group.
          integer SoAdSocketId: 0..65535, set at pre-compile, symbolic-name-value=true, default-value=0  # Socket Connection ID | The Socket ID is used as a reference to a particular connection when transferring data to and from the PDU Router.
          boolean SoAdSocketGetReceivedRemoteAddressEnabled: set at post-build in variant post-build-loadable / pre-compile in variant pre-compile, origin=Vector Informatik, default-value=false  # This parameter defines the ability to store the remote IP address of the last received data on the corresponding Socket Connection. The remote IP address can be retrived by the upper layer by calling the SoAd_GetRcvRemoteAddr() API with the corresponding Socket Connection ID as function parameter. false: Remote IP address of last received data on Socket Connection isn't stored true: Remote IP address of last received data on Socket Connection is stored and can be retrieved by calling the SoAd_GetRcvRemoteAddr() API
          integer SoAdTcpTxQueueSize [0..1]: 1..65535, set at post-build in variant post-build-loadable / pre-compile in variant pre-compile, origin=Vector Informatik, default-value=1  # This parameter defines the size of a TxQueue to support parallel transmission requests on TCP and a streaming-based TxConfirmation.
          boolean SoAdVerifyRxPduEnable: set at post-build in variant post-build-loadable / pre-compile in variant pre-compile, origin=Vector Informatik, default-value=false  # This parameter enables the usage of the Rx PDU verification callback on this socket connection. The corresponding callback is configured by parameter SoAdVerifyRxPduCallback.
          reference SoAdAdditionalChgNotificationRef [0..255]: set at post-build in variant post-build-loadable / pre-compile in variant pre-compile, origin=Vector Informatik, destination=SoAdBswModules  # Reference to an additional SoAdBswModule which shall be registered to get change notifications (SoConModeChg, IpAddrAssignmentChg) for this socket connection. Which notification is called depends on specific SoAdBswModule configuration (parameter SoAdLocalIpAddrAssigmentChg and SoAdSoConModeChg). SoAdBswModules which are already registered via SoAdPduRouteDest or SoAdSocketRoute must not be added here.
          reference SoAdAdditionalSoConModeChgRef [0..255]: set at post-build in variant post-build-loadable / pre-compile in variant pre-compile, origin=Vector Informatik, destination=SoAdAdditionalSoConModeChgCallback  # This parameter defines a reference to an additional callback to notify any module about a socket connection state change on this socket connection.
          reference SoAdAdditionalLocalIpAddrAssignmentChgRef [0..255]: set at post-build in variant post-build-loadable / pre-compile in variant pre-compile, origin=Vector Informatik, destination=SoAdAdditionalLocalIpAddrAssignmentChgCallback  # This parameter defines a reference to an additional callback to notify any module about a local IP address assignment change on this socket connection.
          container SoAdSocketRemoteAddress [0..1]: post-build-changeable=true  # Subcontainer of SoAdSocketConnection to specify the remote address (IP address and port) for a socket connection. If remote address contains wildcards socket connection cannot be openned (set to online). The remote address has to be overwritten at runtime via API call, on UDP frame reception or via TCP connection establishment. | If SoAdSocketRemoteAddress is not specified the remote address has to be set by the upper layer via SoAd_SetRemoteAddr().
            string SoAdSocketRemoteIpAddress: set at post-build in variant post-build-loadable / pre-compile in variant pre-compile  # Remote IP Address | This parameter defines the IP address of remote node. To accept any remote IP address, leave this parameter empty. See message acceptance policy for more details. If this parameter is empty (wildcard) socket connection cannot be openned (set to online). The remote address has to be overwritten at runtime via API call, on UDP frame reception or via TCP connection establishment.
            integer SoAdSocketRemotePort: 0..65535, set at post-build in variant post-build-loadable / pre-compile in variant pre-compile, default-value=0  # Remote Port | This parameter defines the UDP or TCP port of remote node. To accept any remote port, set SoAdSocketRemotePort to 0. See message acceptance policy for more details. If this parameter is set to 0 socket connection cannot be openned (set to online). The remote address has to be overwritten at runtime via API call, on UDP frame reception or via TCP connection establishment.
            boolean SoAdSocketRemoteIpAddressNotSet: set at post-build in variant post-build-loadable / pre-compile in variant pre-compile, origin=Vector Informatik, default-value=false  # Remote IP Address not set | This parameter defines whether remote IP address is set (valid or wildcard) or not set. True: IP address not set, False: IP address set (valid/wildcard).
            boolean SoAdSocketRemotePortNotSet: set at post-build in variant post-build-loadable / pre-compile in variant pre-compile, origin=Vector Informatik, default-value=false  # Remote Port not set | This parameter defines whether remote port is set (valid or wildcard) or not set. True: port not set, False: port set (valid/wildcard).
          container SoAdTcpTlsConfig [0..1]: post-build-changeable=true  # This container contains the TLS configuration for a socket connection. TLS is supported on TCP client sockets only (SoAdSocketTcp/TcpInitiate = TRUE). If this container does not exist TLS is disabled on this socket connection.
            integer SoAdTcpTlsTxBufferSize: 1..4294967295, set at post-build in variant post-build-loadable / pre-compile in variant pre-compile, origin=Vector Informatik, default-value=512  # This parameter defines the transmission buffer size for Tls. The value of this parameter is forwarded to TcpIp and Tls on socket creation at runtime.
            integer SoAdTcpTlsRxBufferSize: 1..4294967295, set at post-build in variant post-build-loadable / pre-compile in variant pre-compile, origin=Vector Informatik, default-value=512  # This parameter defines the reception buffer size for Tls. The value of this parameter is forwarded to TcpIp and Tls on socket creation at runtime.
            reference SoAdTcpTlsCallbackRef [0..1]: set at post-build in variant post-build-loadable / pre-compile in variant pre-compile, origin=Vector Informatik, destination=SoAdTcpTlsCallback  # This parameter defines a reference to a callback container to notify a user about a socket connection specific TLS event.
        choice container SoAdSocketProtocol: post-build-changeable=true  # Specifies the transport protocol and transport protocol specific parameters used for the socket connections of the socket connection group.
          container SoAdSocketTcp [0..1]: post-build-changeable=true  # Specifies that TCP is used as transport protocol for the socket connection group and parameters only related to TCP socket connections.
            boolean SoAdSocketTcpImmediateTpTxConfirmation: set at post-build in variant post-build-loadable / pre-compile in variant pre-compile, default-value=false  # Enable Immediate Tx Confirmation | If set to FALSE, SoAd notifies the TP upper layer via transmit confirmation after a Tcp Ack has been received. If set to TRUE, SoAd notifies the TP upper layer via transmit confirmation immediately after transmit has been accepted by TcpIp.
            boolean SoAdSocketTcpInitiate: set at post-build in variant post-build-loadable / pre-compile in variant pre-compile, default-value=false  # Initiate TCP Connection | Specifies the initiator for this TCP connection. It will not be defined for UDP sockets. | TRUE: This TCP connection is initiated by this module. FALSE: This TCP connection is to be initiated in the listen mode.
            boolean SoAdSocketTcpKeepAlive: set at post-build in variant post-build-loadable / pre-compile in variant pre-compile, default-value=false  # Enable Keep Alive | Specifies to use the keep-alive mechanism for this connection. It will not be defined for UDP sockets. TRUE: This TCP connection will use the keep-alive mechanism. FALSE: This TCP connection will not use the keep-alive mechanism. Note: This parameter must not be set to TRUE if TcpIpTcpKeepAliveEnabled is set to FALSE.
            float SoAdSocketTcpKeepAliveInterval [0..1]: 0..65535, set at post-build in variant post-build-loadable / pre-compile in variant pre-compile, default-value=1  # Keep Alive Interval | Specifies the interval in seconds between subsequent keepalive probes.
            integer SoAdSocketTcpKeepAliveProbesMax [0..1]: 0..65535, set at post-build in variant post-build-loadable / pre-compile in variant pre-compile, default-value=1  # Maximum Keep Alive Probes | Maximum number of times that TCP retransmits an individual data segment before aborting the connection.
            float SoAdSocketTcpKeepAliveTime [0..1]: 0..65535, set at post-build in variant post-build-loadable / pre-compile in variant pre-compile, default-value=7200  # Keep Alive Time | Specifies the time in seconds between the last data packet sent and the first keepalive probe.
            boolean SoAdSocketTcpNoDelay [0..1]: set at post-build in variant post-build-loadable / pre-compile in variant pre-compile, default-value=false  # Disable TCP Congestion Control | Specifies not to use the congestion control mechanism for this connection. It will not be defined for UDP sockets. | TRUE: This TCP connection will NOT use congestion control. FALSE: This TCP connection will use congestion control. If the optional parameter is not enabled, the default behavior configured for TcpIp via the parameter TcpIpTcpNagleEnabled is applied. Note: This parameter must not be set to FALSE if TcpIpTcpNagleEnabled is set to FALSE.
            integer SoAdSocketTcpTxQuota [0..1]: 0..4294967295, set at post-build in variant post-build-loadable / pre-compile in variant pre-compile, default-value=4294967295  # Transmission Quota | Specifies the maximum amout of bytes (PDU data provided by the upper layer and PDU Header if used) the SoAd may queue for transmission via TCP at the TcpIp module for each socket connection of this socket connection group. (not used) | Rationale: prohibits that a socket connection consumes all available transmit buffers at the TcpIp and blocks transmissions via other socket connections. If the optional parameter is not enabled, the amout of data is not limited.
            integer SoAdSocketTcpTxBufferMin [0..1]: 1..65535, set at post-build in variant post-build-loadable / pre-compile in variant pre-compile, origin=Vector Informatik, default-value=512  # Minimum Tx Buffer | This parameter defines a minimum transmission buffer size the TcpIp must be able to provide on each socket connection of this group. The value is forwarded to TcpIp on socket creation at runtime. If this optional parameter is not configured TcpIp will use a default value.
          container SoAdSocketUdp [0..1]: post-build-changeable=true  # Specifies that UDP is used as transport protocol for the socket connection group and parameters only related to UDP socket connections.
            float SoAdSocketUdpAliveSupervisionTimeout [0..1]: 0..320, set at post-build in variant post-build-loadable / pre-compile in variant pre-compile, default-value=1  # Alive Supervision Timeout | Specifies the time in [s] a UDP socket connection remains in the mode SOAD_SOCON_ONLINE after the latest reception of a frame from the remote peer specified by the remote address. If this optional parameter is not enabled UDP Alive Supervision is deactivated for the related socket connection group.
            boolean SoAdSocketUdpListenOnly: set at post-build in variant post-build-loadable / pre-compile in variant pre-compile, default-value=false  # Enable Listen Only | Specifies if the socket connection group is only used for reception (TRUE) or used for both reception and transmission (FALSE).
            boolean SoAdSocketUdpStrictHeaderLenCheckEnabled: set at post-build in variant post-build-loadable / pre-compile in variant pre-compile, default-value=false  # Specifies if UDP messages shall be dropped (TRUE) if the length of all contained PDUs does not match the length of the whole message or not (FALSE). Shall only be set to TRUE if SoAdPduHeaderEnable is also set to TRUE.
            float SoAdSocketUdpTriggerTimeout [0..1]: 0..65535, set at post-build in variant post-build-loadable / pre-compile in variant pre-compile, default-value=2  # Timeout for Trigger Transmission | Specifies the timeout in [s] a nPduUdpTxBuffer is waiting for a PDU with TriggerMode = TRIGGER_ALWAYS, i.e. when the timeout expires the nPduUdpTxBuffer is transmitted. Timer is reset after each UDP transmission. This optional parameter is only relevant if a nPduUdpTxBuffer is used.
            integer SoAdSocketnPduUdpTxBufferMin [0..1]: 0..65535, set at post-build in variant post-build-loadable / pre-compile in variant pre-compile, default-value=32  # Socket n Pdu Udp Tx Buffer Min | Specifies the amout of data in bytes (PDU data provided by the upper layer and PDU Header if used) the SoAd shall be able to buffer for data transmission via this socket connection in case the UDP message shall be buffered for transmission of multiple PDUs per UDP (nPduUdpTxBuffer). This parameter must not exist if no nPduUdpTxBuffer is used. | Note: in case of a UDP socket and an upper layer with TP API or an upper layer with IF API with UDP transmit retry (for single PDUs) configured, the required buffer size can be determined automatically. This optional parameter is only relevant if a nPduUdpTxBuffer is used.
            boolean SoAdSocketUdpAddressResolutionRetryEnabled: set at post-build in variant post-build-loadable / pre-compile in variant pre-compile, origin=Vector Informatik, default-value=true  # Enable Address Resolution Retry | Specifies if a transmission request shall be stored in TcpIp module to retry transmission in case of missing address resolution (ARP/NDP). True: Retry enabled False: Retry disabled
            boolean SoAdSocketUdpImmediateIfTxConfirmation: set at post-build in variant post-build-loadable / pre-compile in variant pre-compile, origin=Vector Informatik, default-value=false  # This parameter defines the ability to notify the IF upper layers via TX Confirmation in context of Ethernet driver's TX Confirmation. All upper layers using a Socket Connection of a Socket Connection Group configured for UDP communication with this feature enabled will be notified by the TX Confirmation in context of Ethernet driver's TX Confirmation. false: Upper Layers are notified by the TX Confirmation called in next main function cycle of SoAd (Task-Context). The call is independent from the TX Confirmation by the lower layer of SoAd. true: Upper Layers are notified by the TX Confirmation propagated through the Ethernet Stack starting by the Ethernet Driver (Task- or Interrupt-Context).
            integer SoAdSocketUdpImmediateIfTxConfirmationListSize [0..1]: 1..255, set at post-build in variant post-build-loadable / pre-compile in variant pre-compile, origin=Vector Informatik, default-value=1  # This parameter specifies the size of a list which is used in the TcpIp module to handle UDP transmissions with TxConfirmation. Please refer to TcpIp parameter "TcpIpUdpTxReqListSize" for more details. This parameter is used if "SoAdSocketUdpImmediateIfTxConfirmation" is enabled.
            integer SoAdSocketnPduUdpTxQueueSize [0..1]: 1..255, set at post-build in variant post-build-loadable / pre-compile in variant pre-compile, origin=Vector Informatik, default-value=2  # Socket n Pdu Udp Tx Queue Size | This parameter defines the size of a management queue for each socket connection. This queue is used to manage PDUs in the nPduUdpTxBuffer and PDU transmission requests for trigger transmit. Both transmission types are stored within one queue, so make sure that size is sufficient for all related SoAdPduRoutes. This parameter must not exist if no related SoAdPduRoute exisits with enabled SoAdTxIfTriggerTransmit.
            integer SoAdSocketUdpAddressResolutionRetryQueueLimit: 0..255, set at post-build in variant post-build-loadable / pre-compile in variant pre-compile, origin=Vector Informatik, default-value=1  # This parameter sets the limitation of maximum used UDP transmission retry queue elements for this socket. The value is forwarded to the TcpIp module on socket creation. Example: A transmission over a UDP socket fails in TcpIp module since address resolution (ARP) is not finished yet. This transmission is stored in the retry queue and the transmission request is assumed as successful. If the limitation is set to 1 TcpIp will reject further transmission requests until retry queue element is released.
            boolean SoAdSocketUdpBroadcastReceptionEnabled [0..1]: set at post-build in variant post-build-loadable / pre-compile in variant pre-compile, origin=Vector Informatik, default-value=true  # This parameter defines if the reception of broadcasts (IPv4 limited and directed broadcast) and multicasts (IPv6 all nodes and all routers multicast) is enabled. The parameter must exist if SoAdSocketApiType is LINUX or QNX and if SoAdSocketLocalAddressRef references a unicast address. Otherwise, this parameter must not exist. True: Broadcasts and multicasts shall be received. False: Broadcasts and multicasts shall not be received.
      container SoAdSocketRoute [0..*]: post-build-changeable=true  # Describes the path of a PDU from a socket in the TCP/IP stack to an upper layer of the SoAd after reception in the TCP/IP Stack.
        integer SoAdRxPduHeaderId [0..1]: 0..4294967296, set at post-build in variant post-build-loadable / pre-compile in variant pre-compile, default-value=0  # PDU Header ID | ID contained in the packet received on the TCP/IP connection if the PDU header option is enabled.
        choice reference SoAdRxSocketConnOrSocketConnBundleRef: set at post-build in variant post-build-loadable / pre-compile in variant pre-compile, destination=[SoAdSocketConnection, SoAdSocketConnectionGroup]  # Choice Reference to a SocketConnection or to a SocketConnectionGroup on which the PDU was received. The reference to a SocketConnectionGroup shall only be used for upper layers with IF API.
        container SoAdSocketRouteDest [1..*]: post-build-changeable=true  # Describes the upper layer destination PDU for a message received on a TcpIp socket.
          integer SoAdRxPduId [0..1]: 0..65535, set at pre-compile, symbolic-name-value=true, default-value=0  # PDU ID | This unique identifier is used for a receive cancellation request from an upper layer of the SoAd.
          enumeration SoAdRxUpperLayerType: {IF, TP}, set at post-build in variant post-build-loadable / pre-compile in variant pre-compile, default-value=IF  # Upper Layer Type | Specifies the upper layer interface type (must be "IF" in case of multiple RxPdus).
          reference SoAdRxPduRef: set at post-build in variant post-build-loadable / pre-compile in variant pre-compile, destination=Pdu  # PDU | Reference to the global PDU structure
          reference SoAdRxRoutingGroupRef [0..*]: set at post-build in variant post-build-loadable / pre-compile in variant pre-compile, destination=SoAdRoutingGroup  # Routing Group | Reference to the routing group.
      container SoAdIpConfig [0..1]: post-build-changeable=true  # This container provides IP related configuration parameter.
        container SoAdIpFragmentationBuffer [0..65535]: post-build-changeable=true  # This container provides parameter to configure an IP fragmentation buffer. An IP fragmentation buffer is used when a SoAdPduRoute configures SoAdTxIfTriggerTransmit to true and no nPduUdpTxBuffer is used on a UDP socket. In this case a buffer is required since TcpIp copies the PDU fragmented (multiple SoAd API calls) but TriggerTransmit API allows only one call. The IP fragmentation buffers are shared by all socket connections. A transmission request fails when no buffer is available at the moment.
          integer SoAdIpFragmentationBufferSize: 1..65535, set at post-build in variant post-build-loadable / pre-compile in variant pre-compile, origin=Vector Informatik, default-value=3000  # This parameter defines the size of the IP fragmentation buffer.
      container SoAdIfTriggerTransmitConfig [0..1]: post-build-changeable=true  # This container provides trigger transmit related configuration parameter.
        container SoAdIfTriggerTransmitBuffer [1..65535]: post-build-changeable=true  # This container provides parameter to configure a trigger transmit buffer. A trigger transmit buffer is used whenever PDU data has to be stored in SoAd before transmission is possible and SoAdTxIfTriggerTransmit is enabled. This applies for example if SoAdTxIfTriggerTransmitForceSingleCall is enabled for a PDU fan-out or for transmissions via TCP.
          integer SoAdIfTriggerTransmitBufferSize: 1..65535, set at post-build in variant post-build-loadable / pre-compile in variant pre-compile, origin=Vector Informatik, default-value=1500  # This parameter defines the size of the trigger transmit buffer.
    container SoAdGeneral  # This container contains all global configuration parameters of SoAd.
      boolean SoAdDevErrorDetect: set at pre-compile, default-value=true  # Development Error Detection | Pre-processor switch for enabling development error detection support.
      boolean SoAdIPv6AddressEnabled: set at pre-compile, default-value=false  # IPv6 Address Enabled | Allows for increased memory allocation to store IPv6 addresses. | TRUE: Enables support for IPv6 addresses FALSE: Only IPv4 addresses are supported
      float SoAdMainFunctionPeriod: 0..65535, set at pre-compile, default-value=0.005  # Main Function Period | Determines the frequency at which the SoAd_MainFunction() is called in [s].
      integer SoAdRoutingGroupMax: 0..65535, set at pre-compile, default-value=0  # Routing Group Count | Specifies the maximum number of SoAd routing groups. Furthermore it defines the platform type used for RoutingGroupIdType. If SoAdRoutingGroupMax is not greater than 256, an uint8 is used, | otherwise an uint16.
      integer SoAdSoConMax: 0..65535, set at pre-compile, default-value=0  # Socket Connection Count | Count of configured SoAd Socket Connections. | Furthermore it defines the platform type used for SoAd_SoConIdType. If SoAdSoConMax is not greater than 256, an uint8 is used, otherwise uint16.
      boolean SoAdVersionInfoApi: set at pre-compile, default-value=false  # Version Info API | Activates the SoAd_GetVersionInfo() API. | TRUE: Enables the SoAd_GetVersionInfo() API. FALSE: SoAd_GetVersionInfo() API is not included.
      string SoAdUserConfigFile [0..1]: set at pre-compile, origin=Vector Informatik, default-value=SoAd_UserCfg.h  # User Config File | If a file path will be specified, the file is read and its contents are put at the end of the SoAd config file.
      float SoAdShutdownFinishedWaitTime: 0..65535, set at pre-compile, origin=Vector Informatik, default-value=2  # Shutdown Finished Wait Time | This parameter defines a timout for the shutdown mechanism which is initiated by call to SoAd_Shutdown(). If this timeout expires SoAd will switch to state shutdown even if sockets are not yet closed completely.
      string SoAdHeaderFileInclusion [0..255]: set at pre-compile, origin=Vector Informatik, max-length=255, min-length=0  # This parameter defines a list of include header files containing callback declarations (e.g. for TLS callback configuration). These header files are included in the SoAd_Lcfg.c file.
      string SoAdHeaderFileInclusionExtended [0..255]: set at pre-compile, origin=Vector Informatik, max-length=255, min-length=0  # This parameter defines a list of include header files containing extended information which are needed in static SoAd source file (e.g. linux/if_oacket.h). These header files are included in the SoAd_Cfg.h file.
      boolean SoAdTcpTlsEnabled: set at pre-compile, origin=Vector Informatik, default-value=false  # This parameter defines if TLS communication shall be enabled for SoAd.
      boolean SoAdTxDynamicLengthEnabled: set at pre-compile, origin=Vector Informatik, default-value=false  # This parameter defines if data length can be modified or set during transmission process. In case of transmission via IfRoutingGroupTrannsmit API no PDU length is known until call to TriggerTransmit callback to retrieve data from upper layer. Therefore an internal buffer is used to store the PDU first before transmit function of TcpIp module can be called. If this feature is enabled the mentioned buffer is not needed anymore since TcpIp module can handle setting length on transmission. In case of transmission via IfTriggerTransmit API length can differ between transmission request and TriggerTransmit callback. If this feature is not enabled such transmissions are aborted. In case of nPdu and if IfTriggerTransmit is enabled on the corresponding SoAdPduRoutes nPduUdpTxBuffer can be optimized and is replaced by a request queue if this feature is enabled.
      boolean SoAdMainFunctionSplitEnabled: set at pre-compile, origin=Vector Informatik, default-value=false  # This parameter specifies whether SoAd shall split up the SoAd_MainFunction into three functions: SoAd_MainFunctionRx SoAd_MainFunctionState SoAd_MainFunctionTx This allows optimizing the data reception and data transmission path for a specific use case. Note: All three MainFunctions must be called from the same task or at least from tasks that do not interrupt each other.
      boolean SoAdSafeBswChecks: set at pre-compile, origin=Vector Informatik, default-value=false  # Selects if safety checks are used. These checks improve robustness as e.g. invalid parameters are checked before function is executed. This attribute has to be enabled for safety projects where this component is mapped to an ASIL partition.
      integer SoAdMetaDataRxBufferSize [0..1]: 1..65535, set at post-build in variant post-build-loadable / pre-compile in variant pre-compile, origin=Vector Informatik, default-value=1  # This parameter defines the size of a buffer used to forward PDUs using meta data. The size of this buffer has to be 2 bytes larger than the maximum length of all PDUs using meta data. Ths last 2 bytes are used to store the meta data.
      boolean SoAdGetAndResetMeasurementDataApi: set at pre-compile, origin=Vector Informatik, default-value=false  # This parameter enables/disables the function SoAd_GetAndResetMeasurementData() to get/reset the measurement data.
      container SoAdTcpTlsCallback [0..255]  # This container contains a callback which is called if a Tls socket was created.
        function name SoAdTcpTlsSocketCreatedNotification: set at pre-compile, origin=Vector Informatik, max-length=255, min-length=0  # This parameter defines a callback which is called if a TLS socket was created. The callback can be used to set additional parameters for TLS communication (e.g. set client certificate).
      container SoAdAdditionalLocalIpAddrAssignmentChgCallback [0..255]  # This container contains an addtional callback to notify an user about a local IP address assignment change.
        function name SoAdAdditionalLocalIpAddrAssignmentChg: set at pre-compile, origin=Vector Informatik, max-length=255, min-length=0  # This parameter defines an additional callback to notify any module about a local IP address assignment change on a socket connection (LocalIpAddrAssignmentChg). There are no restrictions reagrding name but function parameters have to match the specification. This additional callback may be required if notified component is no SoAd upper layer.
      container SoAdAdditionalSoConModeChgCallback [0..255]  # This container contains an addtional callback to notify an user about a socket connection state change.
        function name SoAdAdditionalSoConModeChg: set at pre-compile, origin=Vector Informatik, max-length=255, min-length=0  # This parameter defines an additional callback to notify any module about a socket connection mode change (SoConModeChg). There are no restrictions reagrding name but function parameters have to match the specification. This additional callback may be required if notified component is no SoAd upper layer.
      container SoAdShutdownFinishedCallback [0..255]  # This container contains a callback to notify an user about finished shutdown.
        function name SoAdShutdownFinished: set at pre-compile, origin=Vector Informatik, max-length=255, min-length=0  # This parameter defines a callback to notify any module about a successful shutdown after call to SoAd_Shutdown().
      container SoAdEventQueueOptimization [0..1]: post-build-changeable=true  # This container provides optimization parameter for module internal event queues.
        integer SoAdEventQueueLimitTpRxSoCon [0..1]: 1..65535, set at post-build in variant post-build-loadable / pre-compile in variant pre-compile, origin=Vector Informatik, default-value=1  # This parameter limits the number of handled TP receptions on socket connections per main function. If more TP receptions are active they will be handled in further main functions. This parameter can be used to minimize main function runtime but may lead to performance losses for TP receptions.
        integer SoAdEventQueueLimitStateSoCon [0..1]: 1..65535, set at post-build in variant post-build-loadable / pre-compile in variant pre-compile, origin=Vector Informatik, default-value=1  # This parameter limits the number of handled socket connection events per main function (e.g. after remote address change). If more socket connection events have to be handled they will be handled in further main functions. This parameter can be used to minimize main function runtime but may lead to performance losses on socket connections state change (e.g. open/close).
        integer SoAdEventQueueLimitTcpTxSoCon [0..1]: 1..65535, set at post-build in variant post-build-loadable / pre-compile in variant pre-compile, origin=Vector Informatik, default-value=1  # This parameter limits the number of handled TCP transmissions in case of BSD on socket connections per main function. If more transmissions are active they will be handled in further main functions. This parameter can be used to minimize main function runtime but may lead to performance losses for TCP transmissions in case of BSD.
        integer SoAdEventQueueLimitIfUdpPduRoute [0..1]: 1..65535, set at post-build in variant post-build-loadable / pre-compile in variant pre-compile, origin=Vector Informatik, default-value=1  # This parameter limits the number of handled IF TxConfirmations on PduRoutes per main function. If more TxConfirmations are pending they will be handled in further main functions. This parameter can be used to minimize main function runtime but may lead to performance losses for IF PduRoutes since TxConfirmation may be called delayed.
        integer SoAdEventQueueLimitIfTxRouteGrp [0..1]: 1..65535, set at post-build in variant post-build-loadable / pre-compile in variant pre-compile, origin=Vector Informatik, default-value=1  # This parameter limits the number of handled IF Routing Group transmissions per main function. If more transmissions are pending they will be handled in further main functions. This parameter can be used to minimize main function runtime but may lead to performance losses for IF Routing Group transmissions.
        integer SoAdEventQueueLimitSocketIdx [0..1]: 1..65535, set at post-build in variant post-build-loadable / pre-compile in variant pre-compile, origin=Vector Informatik, default-value=1  # This parameter limits the number of handled events on sockets (e.g. TCP socket state changes, reception of data) per main function in case of BSD. If more events are pending they will be handled in further main functions. This parameter can be used to minimize main function runtime but may lead to performance losses for socket handling.
        integer SoAdEventQueueLimitLocalAddr [0..1]: 1..65535, set at post-build in variant post-build-loadable / pre-compile in variant pre-compile, origin=Vector Informatik, default-value=1  # This parameter limits the number of handled events on local addresses (e.g. IP address assignment) per main function in case of BSD. If more events are pending they will be handled in further main functions. This parameter can be used to minimize main function runtime but may lead to performance losses for local address handling (e.g. slow IP address assignment).
        integer SoAdEventQueueLimitTpTxSoCon [0..1]: 1..65535, set at post-build in variant post-build-loadable / pre-compile in variant pre-compile, origin=Vector Informatik, default-value=1  # This parameter limits the number of handled TP transmissions on socket connections per main function. If more transmissions are active they will be handled in further main functions. This parameter can be used to minimize main function runtime but may lead to performance losses for TP transmissions.
      container SoAdTimeoutListOptimization [0..1]: post-build-changeable=true  # This container provides optimization parameter for module internal timeout lists.
        integer SoAdTimeoutListLimitNPduUdpTx [0..1]: 1..65535, set at post-build in variant post-build-loadable / pre-compile in variant pre-compile, origin=Vector Informatik, default-value=1  # This parameter limits the number of parallel nPdu transmissions per main function. All further transmission requests are rejected if list is filled. This parameter can be used to minimize main function runtime and RAM.
      container SoAdVerifyRxPduCallback [0..1]  # This container contains a callback to verify if a Rx PDU is allowed to be received. The callback forwards local socket address, remote socket address, PDU Header ID and a configured number of PDU data to an user. If callback fails SoAd drops the received PDU completely. Otherwise SoAd forwards the received PDU. Via SoAdVerifyRxPduEnable the feature can be enabled on each socket connection separately. Hint: This feature is only available for TP-PDUs with PDU header option on TCP socket connections.
        function name SoAdVerifyRxPdu: set at pre-compile, origin=Vector Informatik, max-length=255, min-length=0  # This parameter defines the callback name for the Rx PDU verification.
        integer SoAdVerifyRxPduMaxDataLength: 0..255, set at pre-compile, origin=Vector Informatik, default-value=0  # This parameter defines the number of received PDU data which are forwarded to the user for Rx PDU verification.
      container SoAdGeneration  # Contains the generation configuration parameters of the module SoAd.
        enumeration SoAdOutOfBoundsWriteProtectionStrategy: set at pre-compile, origin=Vector Informatik, default-value=NONE  # This parameter is used to configure a strategy to protect the code to write out of bounds. NONE: no protection strategy is generated in the data access. INDEX_SATURATION: arrays are blown up and the data access index is saturated by an appropriate mask. The advantage is the speed of the data access, but own data elements at other indexes of the same variable can be overridden. INDEX_CHECKING: the data access index is validated by a runtime check. The advantage is that values are never written to incorrect indexes of the data access.
          NONE  # none
          INDEX_SATURATION  # index saturation
          INDEX_CHECKING  # index checking
        boolean SoAdOutOfBoundsWriteSanitizer: set at pre-compile, origin=Vector Informatik, default-value=false  # This parameter activates/deactivates the generation of runtime checks which call a DET error notification function to find easily out of bounds write problems. FALSE: no checks are generated in the data access. TRUE: the data access is enriched with DET checks to validate indexes.
        boolean SoAdOutOfBoundsReadSanitizer: set at pre-compile, origin=Vector Informatik, default-value=false  # This parameter activates/deactivates the generation of runtime checks which call a DET error notification function to find easily out of bounds read problems. FALSE: no checks are generated in the data access. TRUE: the data access is enriched with DET checks to validate indexes.
        boolean SoAdReduceConstantData2Define: set at pre-compile, origin=Vector Informatik, default-value=false  # Reduce Constant Data To a Define | This parameter activates/deactivates the capability to generate CONFIG-CLASS PRE-COMPILE ROM arrays as constant define. FALSE: ROM arrays are generated as data even if all values are identical. TRUE: ROM arrays are generated as constant define if all values are identical.
        enumeration SoAdBoolDataInArrayOfStructStrategy: set at pre-compile, origin=Vector Informatik, default-value=BOOLEAN  # This parameter is used to tailor the usage of boolean data in structures in all CONFIG-CLASSES ROM data. The difference between BITFIELD and BITMASKING depends on your compiler options and memory mapping. BOOLEAN: the datatype of boolean data is native boolean. BITFIELD: the bitfield type is used and the compiler extracts the boolean data from structures. BITMASKING: generated masks are used to extract the boolean data from structures.
          BOOLEAN  # boolean
          BITFIELD  # bitfield
          BITMASKING  # bitmasking
        boolean SoAdDeduplicateIndirectedData: set at pre-compile, origin=Vector Informatik, default-value=false  # This parameter activates/deactivates the capability to compress 0:N relational ROM data in all CONFIG-CLASSES without increasing the runtime. FALSE: 0:N relational ROM data is not compressed. TRUE: 0:N relational ROM data is compressed without increasing the runtime.
        enumeration SoAdDataDeduplicationStrategy: set at pre-compile, origin=Vector Informatik, default-value=NONE  # This parameter is used to taylor the the deduplication of CONFIG-CLASS PRE-COMPILE ROM data. NONE: The generated data is not deduplicated. DEDUPLICATE_CONST_DATA_WITHOUT_CAST: The data is deduplicated without using casts. DEDUPLICATE_CONST_DATA_WITH_CAST: The data is deduplicated using casts.
          NONE  # none
          DEDUPLICATE_CONST_DATA_WITHOUT_CAST  # deduplicate const data without cast
          DEDUPLICATE_CONST_DATA_WITH_CAST  # deduplicate const data with cast
        integer SoAdReduceBoolDataByNegationThreshold: 0..9223372036854775807, set at pre-compile, origin=Vector Informatik, default-value=0  # This parameter activates/deactivates the capability to compress boolean CONFIG-CLASS PRE-COMPILE ROM data by using the negation operator. 0: The optimization is deactivated. >0: If the number of deduplicateable elements is greater than this threshold the data optimization can be performed.
        integer SoAdReduceBoolDataByNumericalComparisonThreshold: 0..9223372036854775807, set at pre-compile, origin=Vector Informatik, default-value=0  # This parameter activates/deactivates the capability to compress boolean CONFIG-CLASS PRE-COMPILE ROM data by using numerical comparison with other ROM data. 0: The optimization is deactivated. >0: If the number of deduplicateable elements is greater than this threshold the data optimization can be performed.
        integer SoAdReduceBoolDataByNumericalRelationThreshold: 0..9223372036854775807, set at pre-compile, origin=Vector Informatik, default-value=0  # This parameter activates/deactivates the capability to compress boolean CONFIG-CLASS PRE-COMPILE ROM data by using relational comparison with other ROM data. 0: The optimization is deactivated. >0: If the number of deduplicateable elements is greater than this threshold the data optimization can be performed.
        enumeration SoAdReduceBoolDataByNumericalOperandStrategy: set at pre-compile, origin=Vector Informatik, default-value=NONE  # This parameter is used to taylor the CONFIG-CLASS PRE-COMPILE ROM bool data with number deduplication mechanisms. A comparison with 0 is very efficient, but a numerical comparison with a value not 0 can be used to increase the ROM data compression rate. NONE: ROM data deduplications are switched off. DEDUPLICATE_DATA_WITH_ZERO: ROM data deduplications can be applied with the value 0. DEDUPLICATE_DATA_WITH_ANY_VALUE: ROM data deduplications can be applied with any numerical value.
          NONE  # none
          DEDUPLICATE_DATA_WITH_ZERO  # deduplicate data with zero
          DEDUPLICATE_DATA_WITH_ANY_VALUE  # deduplicate data with any value
        integer SoAdReduceNumericalDataByOffsetThreshold: 0..9223372036854775807, set at pre-compile, origin=Vector Informatik, default-value=0  # This parameter activates/deactivates the capability to compress numerical CONFIG-CLASS PRE-COMPILE ROM data by using a constant offset. 0: The optimization is deactivated. >0: If the number of deduplicateable elements is greater than this threshold the data optimization can be performed.
        integer SoAdReduceNumericalDataByArraySubtractionThreshold: 0..9223372036854775807, set at pre-compile, origin=Vector Informatik, default-value=0  # This parameter activates/deactivates the capability to compress numerical CONFIG-CLASS PRE-COMPILE ROM data by using a subtraction with other ROM data. 0: The optimization is deactivated. >0: If the number of deduplicateable elements is greater than this threshold the data optimization can be performed.
        boolean SoAdReduceDataByStreaming: set at pre-compile, origin=Vector Informatik, default-value=false  # This parameter activates/deactivates the capability to pack generated CONFIG-CLASS PRE-COMPILE ROM data into a data type dependent stream. FALSE: generated const data is not packed into a data type dependent stream. TRUE: generated const data is packed into a data type dependent stream.
        boolean SoAdShortSymbols: set at pre-compile, origin=Vector Informatik, default-value=false  # This parameter activates/deactivates the capability to generate shortened symbol names. FALSE: symbol names are generated in a human readable style based on the MIP, tags and variant names. TRUE: symbol names are generated based on the MIP and a CRC32.
        boolean SoAdInterfacesForDeactivatedData: set at pre-compile, origin=Vector Informatik, default-value=false  # This parameter activates/deactivates the capability to generate bsw data interfaces for deactivated data elements. This is an advantage for the BSW developer to reduce the time to market with a development environment using auto completition and to investigate potential interfaces. FALSE: data interfaces are not generated if the data elementis deactivated. TRUE: data interfaces are generated as e.g. emty macros.
        boolean SoAdReferringKeysInComments: set at pre-compile, origin=Vector Informatik, default-value=false  # This parameter activates/deactivates the capability to generate referring keys in comments. This is an advantage for the developer to investigate indirections, but this feature reduces the overall readability of the generated data. FALSE: referring keys are not generated in comments. TRUE: referring keys are generated in comments.
      container SoAdSocketApi  # This container contains configuration parameters describing socket API dependent parameter.
        enumeration SoAdSocketApiType: {AUTOSAR, LINUX, QNX, INTEGRITY}, set at pre-compile, origin=Vector Informatik, default-value=AUTOSAR  # This parameter defines the socket API. AUTOSAR: AUTOSAR compatible API. LINUX: Linux compatible API (used in Linux operating system). QNX: QNX compatible API (used in QNX operating system). INTEGRITY: INTEGRITY compatible API (used in INTEGRITY operating system).
        integer SoAdSocketTxBufferSize [0..1]: 1..65535, set at pre-compile, origin=Vector Informatik, default-value=1452  # This parameter defines the size of a global buffer which is used to store data to be transmitted. This buffer is used for UDP and TCP transmissions. It is recommended to set this value to the maximum transmission unit on SoAd level (MTU without IP and UDP/TCP header). This parameter is only relevant if a socket API is used which is based on polling (e.g. Linux). | Note: in case of a TCP socket where PduHeaderMode is used and an upper layer with IF-API, the required buffer size can be determined automatically.
        integer SoAdSocketTxBufferNum [0..1]: 1..254, set at pre-compile, origin=Vector Informatik, default-value=1  # This parameter defines the number of global buffer which are used to store data to be transmitted. In case transmission to socket API fails for TCP, SoAd performs a retry for the buffer until the data could be sent or the socket is closed. This parameter is only relevant if a socket API is used which is based on polling (e.g. Linux). | Note: in case of a TCP socket where PduHeaderMode is used and an upper layer with IF-API, the required buffer size can be determined automatically.
        integer SoAdSocketTxBufferMaxNumPerSocket [0..1]: 1..254, set at pre-compile, origin=Vector Informatik, default-value=1  # This parameter defines the maximum number of socket transmission buffer which can be assigned to a single socket at the same time. The transmission request fails for all subsequent transmission requests. This parameter is only relevant if a socket API is used which is based on polling (e.g. Linux).
        integer SoAdSocketRxBufferSize [0..1]: 1..65535, set at pre-compile, origin=Vector Informatik, default-value=1452  # This parameter defines the size of a global buffer which is used to store received data.This buffer is used for UDP only. It is recommended to set this value to the maximum reception unit on SoAd level (MTU without IP and UDP/TCP header). This parameter is only relevant if a socket API is used which is based on polling (e.g. Linux). | Note: in case of a TCP socket where PduHeaderMode is used and an upper layer with IF-API, the required buffer size can be determined automatically.
        boolean SoAdSocketLingerTimeoutEnabled [0..1]: set at post-build in variant post-build-loadable / pre-compile in variant pre-compile, origin=Vector Informatik, default-value=false  # Indicates whether the SoAd sets linger time to 0 (SO_LINGER) via setsockopt(). This option can be used to close TCP connections immediately. true: option is set on socket creation false: option is not set on socket creation This parameter is only relevant if a socket API is used which is related to the BSD API (e.g. Linux).
        function name SoAdSocketReportErrorFunction [0..1]: set at pre-compile, origin=Vector Informatik, max-length=255, min-length=1  # This parameter defines a callback which is called in case any call to socket API returns an unexpected error. This parameter is only relevant if a socket API is used which is related to the BSD API (e.g. Linux).
        float SoAdLocalIpAddrCheckInterval [0..1]: 0..65535, set at post-build in variant post-build-loadable / pre-compile in variant pre-compile, origin=Vector Informatik, default-value=0.1  # This parameter defines the interval used to check if a local IP address is available. This interval can be used to optimze calls to the socket API to prevent timing issues. If parameter is 0 the check is perfomed in each main function cycle.
      container SoAdDhcpEventCallback [0..255]  # This container contains a callback to notify user of a DHCP event.
        function name SoAdDhcpEvent: set at pre-compile, origin=Vector Informatik, max-length=255, min-length=0  # This parameter defines a callback to notify any module of a DHCP event.
  bsw implementation SoAd_Impl: programming-language=C, sw-version=16.05.01, used-code-generator=DaVinci Configurator, vendor-id=30, ar-release-version=4.02.02, behavior=SoAdBehavior, preconfigured-configuration=SoAd_Pre, recommended-configuration=SoAd_Rec, vendor-specific-module-def=SoAd
  module config SoAd_Pre: definition=SoAd
  module config SoAd_Rec: definition=SoAd
