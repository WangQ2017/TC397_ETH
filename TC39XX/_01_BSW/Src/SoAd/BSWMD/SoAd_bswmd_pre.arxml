AUTOSAR XML (schema 4-0-3)
package /MICROSAR
  module config SoAd_Pre: definition=SoAd
  module config SoAd_Pre_Class1: definition=SoAd
    SoAdGeneral
      SoAdGeneration: SoAdBoolDataInArrayOfStructStrategy=BOOLEAN
