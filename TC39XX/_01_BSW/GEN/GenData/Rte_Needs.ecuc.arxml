AUTOSAR XML (schema 4-0-3)
package /DaVinci_Project
  module config Rte
    8 x RteBswModuleInstance:
      BswM
        BswM_MainFunctionTimingEvent0 (RteBswEventToTaskMapping): RteBswUsedOsAlarmRef=Os/Rte_Al_TE2_OsTask_Bsw_OsCore0_0_10ms
      Det
      Dio
      EcuM
        6 x RteBswEventToTaskMapping:
          EcuM_MainFunctionTimingEvent0: RteBswUsedOsAlarmRef=Os/Rte_Al_TE2_OsTask_Bsw_OsCore0_0_10ms
          EcuM_MainFunctionTimingEvent1: RteBswUsedOsAlarmRef=Os/Rte_Al_TE2_EcuM_EcuM_MainFunction
          EcuM_MainFunctionTimingEvent2: RteBswUsedOsAlarmRef=Os/Rte_Al_TE3_EcuM_EcuM_MainFunction
          EcuM_MainFunctionTimingEvent3: RteBswUsedOsAlarmRef=Os/Rte_Al_TE4_EcuM_EcuM_MainFunction
          EcuM_MainFunctionTimingEvent4: RteBswUsedOsAlarmRef=Os/Rte_Al_TE5_EcuM_EcuM_MainFunction
          EcuM_MainFunctionTimingEvent5: RteBswUsedOsAlarmRef=Os/Rte_Al_TE6_EcuM_EcuM_MainFunction
      Irq
      McalLib
      Mcu
      Port
    18 x RteSwComponentInstance:
      BswM_EcuSwComposition
        Timer_BswM_MainFunction (RteEventToTaskMapping): RteUsedOsAlarmRef=Os/Rte_Al_TE2_OsTask_Bsw_OsCore0_0_10ms
      Cdd_Core0_EcuSwComposition
        TMT_Runnable_20 (RteEventToTaskMapping): RteUsedOsEventRef=Rte_Ev_Run_Cdd_Core0_Runnable_20, RteUsedOsAlarmRef=Os/Rte_Al_TE_Cdd_Core0_Runnable_20
        TMT_Runnable_5ms (RteEventToTaskMapping): RteUsedOsEventRef=Rte_Ev_Run_Cdd_Core0_Runnable_5ms, RteUsedOsAlarmRef=Os/Rte_Al_TE_Cdd_Core0_Runnable_5ms
      Cdd_Core1_EcuSwComposition
        TMT_Cdd_Core1_Runnable10ms (RteEventToTaskMapping): RteUsedOsAlarmRef=Os/Rte_Al_TE_Cdd_Core1_Cdd_Core1_Runnable10ms
      Cdd_Core2_EcuSwComposition
        TMT_Cdd_Core2_Runnable10ms (RteEventToTaskMapping): RteUsedOsAlarmRef=Os/Rte_Al_TE_Cdd_Core2_Cdd_Core2_Runnable10ms
      Cdd_Core3_EcuSwComposition
        TMT_Cdd_Core3_Runnable10ms (RteEventToTaskMapping): RteUsedOsAlarmRef=Os/Rte_Al_TE_Cdd_Core3_Cdd_Core3_Runnable10ms
      Cdd_Core4_EcuSwComposition
        TMT_Cdd_Core4_Runnable10ms (RteEventToTaskMapping): RteUsedOsAlarmRef=Os/Rte_Al_TE_Cdd_Core4_Cdd_Core4_Runnable10ms
      Cdd_Core5_EcuSwComposition
        TMT_Cdd_Core5_Runnable10ms (RteEventToTaskMapping): RteUsedOsAlarmRef=Os/Rte_Al_TE_Cdd_Core5_Cdd_Core5_Runnable10ms
      Cdd_nm_EcuSwComposition
        TMT_Cdd_Nm_Runnable10ms (RteEventToTaskMapping): RteUsedOsEventRef=Rte_Ev_Run_Cdd_nm_Cdd_Nm_Runnable10ms, RteUsedOsAlarmRef=Os/Rte_Al_TE_Cdd_nm_Cdd_Nm_Runnable10ms
      Det_EcuSwComposition
      EcuM_EcuSwComposition
        Timer_EcuM_MainFunction (RteEventToTaskMapping): RteUsedOsAlarmRef=Os/Rte_Al_TE2_OsTask_Bsw_OsCore0_0_10ms
      Os_OsCore{0..5}_swc_EcuSwComposition
      swc_lock_EcuSwComposition
        TMT_Runnable_2ms (RteEventToTaskMapping): RteUsedOsAlarmRef=Os/Rte_Al_TE_swc_lock_Runnable_2ms
      window_core1_EcuSwComposition
        TMT_Runnable_windows_2ms (RteEventToTaskMapping): RteUsedOsAlarmRef=Os/Rte_Al_TE_window_core1_Runnable_windows_2ms
    RteOsInteraction
      16 x RteUsedOsActivation, all with RteExpectedActivationOffset=0:
        Rte_Al_TE_Cdd_Core0_Runnable_20: RteActivationOsAlarmRef=Os/Rte_Al_TE_Cdd_Core0_Runnable_20, RteActivationOsTaskRef=OsTask_Asw_OsCore0
        Rte_Al_TE_Cdd_Core0_Runnable_5ms: RteActivationOsAlarmRef=Os/Rte_Al_TE_Cdd_Core0_Runnable_5ms, RteActivationOsTaskRef=OsTask_Asw_OsCore0
        Rte_Al_TE_Cdd_nm_Cdd_Nm_Runnable10ms: RteActivationOsAlarmRef=Os/Rte_Al_TE_Cdd_nm_Cdd_Nm_Runnable10ms, RteActivationOsTaskRef=OsTask_Asw_OsCore0
        Rte_Al_TE_Cdd_Core{1..5}_Cdd_Core{1..5}_Runnable10ms: RteActivationOsAlarmRef=Os/Rte_Al_TE_Cdd_Core{1..5}_Cdd_Core{1..5}_Runnable10ms, RteActivationOsTaskRef=OsTask_Asw_OsCore{1..5}
        Rte_Al_TE2_OsTask_Bsw_OsCore0_0_10ms: RteActivationOsAlarmRef=Os/Rte_Al_TE2_OsTask_Bsw_OsCore0_0_10ms, RteActivationOsTaskRef=OsTask_Bsw_OsCore0
        Rte_Al_TE2_EcuM_EcuM_MainFunction: RteActivationOsAlarmRef=Os/Rte_Al_TE2_EcuM_EcuM_MainFunction, RteActivationOsTaskRef=OsTask_Bsw_OsCore1
        Rte_Al_TE3_EcuM_EcuM_MainFunction: RteActivationOsAlarmRef=Os/Rte_Al_TE3_EcuM_EcuM_MainFunction, RteActivationOsTaskRef=OsTask_Bsw_OsCore2
        Rte_Al_TE4_EcuM_EcuM_MainFunction: RteActivationOsAlarmRef=Os/Rte_Al_TE4_EcuM_EcuM_MainFunction, RteActivationOsTaskRef=OsTask_Bsw_OsCore3
        Rte_Al_TE5_EcuM_EcuM_MainFunction: RteActivationOsAlarmRef=Os/Rte_Al_TE5_EcuM_EcuM_MainFunction, RteActivationOsTaskRef=OsTask_Bsw_OsCore4
        Rte_Al_TE6_EcuM_EcuM_MainFunction: RteActivationOsAlarmRef=Os/Rte_Al_TE6_EcuM_EcuM_MainFunction, RteActivationOsTaskRef=OsTask_Bsw_OsCore5
        Rte_Al_TE_swc_lock_Runnable_2ms: RteActivationOsAlarmRef=Os/Rte_Al_TE_swc_lock_Runnable_2ms, RteActivationOsTaskRef=OsTask_lock_2ms
        Rte_Al_TE_window_core1_Runnable_windows_2ms: RteActivationOsAlarmRef=Os/Rte_Al_TE_window_core1_Runnable_windows_2ms, RteActivationOsTaskRef=OsTask_window_2ms
  module config NvM
  module config Os
    OsTask_Asw_OsCore0 (OsTask):
      OsTaskActivation = 1
      OsTaskPriority = 15
      OsTaskSchedule = FULL
      OsTaskEventRef = Rte_Ev_Run_Cdd_Core0_Runnable_20
      OsTaskEventRef = Rte_Ev_Run_Cdd_Core0_Runnable_5ms
      OsTaskEventRef = Rte_Ev_Run_Cdd_nm_Cdd_Nm_Runnable10ms
      OsTaskAccessingApplication = OsApplication_OsCore{1..5}
    3 x OsAlarm, all with OsAlarmCounterRef=SystemTimer_OsCore0, OsAlarmAccessingApplication=OsApplication_OsCore1, OsAlarmAccessingApplication=OsApplication_OsCore2, OsAlarmAccessingApplication=OsApplication_OsCore3, OsAlarmAccessingApplication=OsApplication_OsCore4, OsAlarmAccessingApplication=OsApplication_OsCore5:
      Rte_Al_TE_Cdd_Core0_Runnable_20
        OsAlarmAction
          OsAlarmSetEvent: OsAlarmSetEventRef=Rte_Ev_Run_Cdd_Core0_Runnable_20, OsAlarmSetEventTaskRef=OsTask_Asw_OsCore0
      Rte_Al_TE_Cdd_Core0_Runnable_5ms
        OsAlarmAction
          OsAlarmSetEvent: OsAlarmSetEventRef=Rte_Ev_Run_Cdd_Core0_Runnable_5ms, OsAlarmSetEventTaskRef=OsTask_Asw_OsCore0
      Rte_Al_TE_Cdd_nm_Cdd_Nm_Runnable10ms
        OsAlarmAction
          OsAlarmSetEvent: OsAlarmSetEventRef=Rte_Ev_Run_Cdd_nm_Cdd_Nm_Runnable10ms, OsAlarmSetEventTaskRef=OsTask_Asw_OsCore0
    OsTask_Asw_OsCore1 (OsTask):
      OsTaskActivation = 100
      OsTaskPriority = 14
      OsTaskSchedule = FULL
      OsTaskAccessingApplication = OsApplication_OsCore0
      OsTaskAccessingApplication = OsApplication_OsCore{2..5}
    Rte_Al_TE_Cdd_Core1_Cdd_Core1_Runnable10ms (OsAlarm):
      OsAlarmCounterRef = SystemTimer_OsCore1
      OsAlarmAccessingApplication = OsApplication_OsCore0
      OsAlarmAccessingApplication = OsApplication_OsCore{2..5}
      OsAlarmAction
        OsAlarmActivateTask: OsAlarmActivateTaskRef=OsTask_Asw_OsCore1
    OsTask_Asw_OsCore2 (OsTask):
      OsTaskActivation = 100
      OsTaskPriority = 13
      OsTaskSchedule = FULL
      OsTaskAccessingApplication = OsApplication_OsCore0
      OsTaskAccessingApplication = OsApplication_OsCore1
      OsTaskAccessingApplication = OsApplication_OsCore{3..5}
    Rte_Al_TE_Cdd_Core2_Cdd_Core2_Runnable10ms (OsAlarm):
      OsAlarmCounterRef = SystemTimer_OsCore2
      OsAlarmAccessingApplication = OsApplication_OsCore0
      OsAlarmAccessingApplication = OsApplication_OsCore1
      OsAlarmAccessingApplication = OsApplication_OsCore{3..5}
      OsAlarmAction
        OsAlarmActivateTask: OsAlarmActivateTaskRef=OsTask_Asw_OsCore2
    OsTask_Asw_OsCore3 (OsTask):
      OsTaskActivation = 100
      OsTaskPriority = 12
      OsTaskSchedule = FULL
      OsTaskAccessingApplication = OsApplication_OsCore{0..2}
      OsTaskAccessingApplication = OsApplication_OsCore4
      OsTaskAccessingApplication = OsApplication_OsCore5
    Rte_Al_TE_Cdd_Core3_Cdd_Core3_Runnable10ms (OsAlarm):
      OsAlarmCounterRef = SystemTimer_OsCore3
      OsAlarmAccessingApplication = OsApplication_OsCore{0..2}
      OsAlarmAccessingApplication = OsApplication_OsCore4
      OsAlarmAccessingApplication = OsApplication_OsCore5
      OsAlarmAction
        OsAlarmActivateTask: OsAlarmActivateTaskRef=OsTask_Asw_OsCore3
    OsTask_Asw_OsCore4 (OsTask):
      OsTaskActivation = 100
      OsTaskPriority = 11
      OsTaskSchedule = FULL
      OsTaskAccessingApplication = OsApplication_OsCore{0..3}
      OsTaskAccessingApplication = OsApplication_OsCore5
    Rte_Al_TE_Cdd_Core4_Cdd_Core4_Runnable10ms (OsAlarm):
      OsAlarmCounterRef = SystemTimer_OsCore4
      OsAlarmAccessingApplication = OsApplication_OsCore{0..3}
      OsAlarmAccessingApplication = OsApplication_OsCore5
      OsAlarmAction
        OsAlarmActivateTask: OsAlarmActivateTaskRef=OsTask_Asw_OsCore4
    OsTask_Asw_OsCore5 (OsTask):
      OsTaskActivation = 100
      OsTaskPriority = 10
      OsTaskSchedule = FULL
      OsTaskAccessingApplication = OsApplication_OsCore{0..4}
    Rte_Al_TE_Cdd_Core5_Cdd_Core5_Runnable10ms (OsAlarm):
      OsAlarmCounterRef = SystemTimer_OsCore5
      OsAlarmAccessingApplication = OsApplication_OsCore{0..4}
      OsAlarmAction
        OsAlarmActivateTask: OsAlarmActivateTaskRef=OsTask_Asw_OsCore5
    OsTask_Bsw_OsCore0 (OsTask):
      OsTaskActivation = 3
      OsTaskPriority = 30
      OsTaskSchedule = FULL
      OsTaskAccessingApplication = OsApplication_OsCore{1..5}
    Rte_Al_TE2_OsTask_Bsw_OsCore0_0_10ms (OsAlarm):
      OsAlarmCounterRef = SystemTimer_OsCore0
      OsAlarmAccessingApplication = OsApplication_OsCore{1..5}
      OsAlarmAction
        OsAlarmActivateTask: OsAlarmActivateTaskRef=OsTask_Bsw_OsCore0
    OsTask_Bsw_OsCore1 (OsTask):
      OsTaskActivation = 100
      OsTaskPriority = 34
      OsTaskSchedule = FULL
      OsTaskAccessingApplication = OsApplication_OsCore0
      OsTaskAccessingApplication = OsApplication_OsCore{2..5}
    Rte_Al_TE2_EcuM_EcuM_MainFunction (OsAlarm):
      OsAlarmCounterRef = SystemTimer_OsCore1
      OsAlarmAccessingApplication = OsApplication_OsCore0
      OsAlarmAccessingApplication = OsApplication_OsCore{2..5}
      OsAlarmAction
        OsAlarmActivateTask: OsAlarmActivateTaskRef=OsTask_Bsw_OsCore1
    OsTask_Bsw_OsCore2 (OsTask):
      OsTaskActivation = 100
      OsTaskPriority = 33
      OsTaskSchedule = FULL
      OsTaskAccessingApplication = OsApplication_OsCore0
      OsTaskAccessingApplication = OsApplication_OsCore1
      OsTaskAccessingApplication = OsApplication_OsCore{3..5}
    Rte_Al_TE3_EcuM_EcuM_MainFunction (OsAlarm):
      OsAlarmCounterRef = SystemTimer_OsCore2
      OsAlarmAccessingApplication = OsApplication_OsCore0
      OsAlarmAccessingApplication = OsApplication_OsCore1
      OsAlarmAccessingApplication = OsApplication_OsCore{3..5}
      OsAlarmAction
        OsAlarmActivateTask: OsAlarmActivateTaskRef=OsTask_Bsw_OsCore2
    OsTask_Bsw_OsCore3 (OsTask):
      OsTaskActivation = 100
      OsTaskPriority = 32
      OsTaskSchedule = FULL
      OsTaskAccessingApplication = OsApplication_OsCore{0..2}
      OsTaskAccessingApplication = OsApplication_OsCore4
      OsTaskAccessingApplication = OsApplication_OsCore5
    Rte_Al_TE4_EcuM_EcuM_MainFunction (OsAlarm):
      OsAlarmCounterRef = SystemTimer_OsCore3
      OsAlarmAccessingApplication = OsApplication_OsCore{0..2}
      OsAlarmAccessingApplication = OsApplication_OsCore4
      OsAlarmAccessingApplication = OsApplication_OsCore5
      OsAlarmAction
        OsAlarmActivateTask: OsAlarmActivateTaskRef=OsTask_Bsw_OsCore3
    OsTask_Bsw_OsCore4 (OsTask):
      OsTaskActivation = 100
      OsTaskPriority = 31
      OsTaskSchedule = FULL
      OsTaskAccessingApplication = OsApplication_OsCore{0..3}
      OsTaskAccessingApplication = OsApplication_OsCore5
    Rte_Al_TE5_EcuM_EcuM_MainFunction (OsAlarm):
      OsAlarmCounterRef = SystemTimer_OsCore4
      OsAlarmAccessingApplication = OsApplication_OsCore{0..3}
      OsAlarmAccessingApplication = OsApplication_OsCore5
      OsAlarmAction
        OsAlarmActivateTask: OsAlarmActivateTaskRef=OsTask_Bsw_OsCore4
    OsTask_Bsw_OsCore5 (OsTask):
      OsTaskActivation = 100
      OsTaskPriority = 30
      OsTaskSchedule = FULL
      OsTaskAccessingApplication = OsApplication_OsCore{0..4}
    Rte_Al_TE6_EcuM_EcuM_MainFunction (OsAlarm):
      OsAlarmCounterRef = SystemTimer_OsCore5
      OsAlarmAccessingApplication = OsApplication_OsCore{0..4}
      OsAlarmAction
        OsAlarmActivateTask: OsAlarmActivateTaskRef=OsTask_Bsw_OsCore5
    7 x OsTask, all with OsTaskSchedule=FULL:
      OsTask_Init_OsCore0: OsTaskActivation=1, OsTaskPriority=48, OsTaskAccessingApplication=OsApplication_OsCore1, OsTaskAccessingApplication=OsApplication_OsCore2, OsTaskAccessingApplication=OsApplication_OsCore3, OsTaskAccessingApplication=OsApplication_OsCore4, OsTaskAccessingApplication=OsApplication_OsCore5
      OsTask_Init_OsCore1: OsTaskActivation=1, OsTaskPriority=48, OsTaskAccessingApplication=OsApplication_OsCore0, OsTaskAccessingApplication=OsApplication_OsCore2, OsTaskAccessingApplication=OsApplication_OsCore3, OsTaskAccessingApplication=OsApplication_OsCore4, OsTaskAccessingApplication=OsApplication_OsCore5
      OsTask_Init_OsCore2: OsTaskActivation=1, OsTaskPriority=48, OsTaskAccessingApplication=OsApplication_OsCore0, OsTaskAccessingApplication=OsApplication_OsCore1, OsTaskAccessingApplication=OsApplication_OsCore3, OsTaskAccessingApplication=OsApplication_OsCore4, OsTaskAccessingApplication=OsApplication_OsCore5
      OsTask_Init_OsCore3: OsTaskActivation=1, OsTaskPriority=48, OsTaskAccessingApplication=OsApplication_OsCore0, OsTaskAccessingApplication=OsApplication_OsCore1, OsTaskAccessingApplication=OsApplication_OsCore2, OsTaskAccessingApplication=OsApplication_OsCore4, OsTaskAccessingApplication=OsApplication_OsCore5
      OsTask_Init_OsCore4: OsTaskActivation=1, OsTaskPriority=48, OsTaskAccessingApplication=OsApplication_OsCore0, OsTaskAccessingApplication=OsApplication_OsCore1, OsTaskAccessingApplication=OsApplication_OsCore2, OsTaskAccessingApplication=OsApplication_OsCore3, OsTaskAccessingApplication=OsApplication_OsCore5
      OsTask_Init_OsCore5: OsTaskActivation=1, OsTaskPriority=48, OsTaskAccessingApplication=OsApplication_OsCore0, OsTaskAccessingApplication=OsApplication_OsCore1, OsTaskAccessingApplication=OsApplication_OsCore2, OsTaskAccessingApplication=OsApplication_OsCore3, OsTaskAccessingApplication=OsApplication_OsCore4
      OsTask_lock_2ms: OsTaskActivation=3, OsTaskPriority=40, OsTaskAccessingApplication=OsApplication_OsCore1, OsTaskAccessingApplication=OsApplication_OsCore2, OsTaskAccessingApplication=OsApplication_OsCore3, OsTaskAccessingApplication=OsApplication_OsCore4, OsTaskAccessingApplication=OsApplication_OsCore5
    Rte_Al_TE_swc_lock_Runnable_2ms (OsAlarm):
      OsAlarmCounterRef = SystemTimer_OsCore0
      OsAlarmAccessingApplication = OsApplication_OsCore{1..5}
      OsAlarmAction
        OsAlarmActivateTask: OsAlarmActivateTaskRef=OsTask_lock_2ms
    OsTask_window_2ms (OsTask):
      OsTaskActivation = 3
      OsTaskPriority = 41
      OsTaskSchedule = FULL
      OsTaskAccessingApplication = OsApplication_OsCore0
      OsTaskAccessingApplication = OsApplication_OsCore{2..5}
    Rte_Al_TE_window_core1_Runnable_windows_2ms (OsAlarm):
      OsAlarmCounterRef = SystemTimer_OsCore1
      OsAlarmAccessingApplication = OsApplication_OsCore0
      OsAlarmAccessingApplication = OsApplication_OsCore{2..5}
      OsAlarmAction
        OsAlarmActivateTask: OsAlarmActivateTaskRef=OsTask_window_2ms
    3 x OsEvent:
      Rte_Ev_Run_Cdd_Core0_Runnable_20
      Rte_Ev_Run_Cdd_Core0_Runnable_5ms
      Rte_Ev_Run_Cdd_nm_Cdd_Nm_Runnable10ms
    6 x OsApplication, all with OsTrusted=true:
      OsApplication_OsCore0: OsAppTaskRef=OsTask_Asw_OsCore0, OsAppAlarmRef=Os/Rte_Al_TE_Cdd_Core0_Runnable_20, OsAppAlarmRef=Os/Rte_Al_TE_Cdd_Core0_Runnable_5ms, OsAppAlarmRef=Os/Rte_Al_TE_Cdd_nm_Cdd_Nm_Runnable10ms, OsAppTaskRef=OsTask_Bsw_OsCore0, OsAppAlarmRef=Os/Rte_Al_TE2_OsTask_Bsw_OsCore0_0_10ms, OsAppTaskRef=OsTask_Init_OsCore0, OsAppTaskRef=OsTask_lock_2ms, OsAppAlarmRef=Os/Rte_Al_TE_swc_lock_Runnable_2ms
      OsApplication_OsCore1: OsAppTaskRef=OsTask_Asw_OsCore1, OsAppAlarmRef=Os/Rte_Al_TE_Cdd_Core1_Cdd_Core1_Runnable10ms, OsAppTaskRef=OsTask_Bsw_OsCore1, OsAppAlarmRef=Os/Rte_Al_TE2_EcuM_EcuM_MainFunction, OsAppTaskRef=OsTask_Init_OsCore1, OsAppTaskRef=OsTask_window_2ms, OsAppAlarmRef=Os/Rte_Al_TE_window_core1_Runnable_windows_2ms
      OsApplication_OsCore2: OsAppTaskRef=OsTask_Asw_OsCore2, OsAppAlarmRef=Os/Rte_Al_TE_Cdd_Core2_Cdd_Core2_Runnable10ms, OsAppTaskRef=OsTask_Bsw_OsCore2, OsAppAlarmRef=Os/Rte_Al_TE3_EcuM_EcuM_MainFunction, OsAppTaskRef=OsTask_Init_OsCore2
      OsApplication_OsCore3: OsAppTaskRef=OsTask_Asw_OsCore3, OsAppAlarmRef=Os/Rte_Al_TE_Cdd_Core3_Cdd_Core3_Runnable10ms, OsAppTaskRef=OsTask_Bsw_OsCore3, OsAppAlarmRef=Os/Rte_Al_TE4_EcuM_EcuM_MainFunction, OsAppTaskRef=OsTask_Init_OsCore3
      OsApplication_OsCore4: OsAppTaskRef=OsTask_Asw_OsCore4, OsAppAlarmRef=Os/Rte_Al_TE_Cdd_Core4_Cdd_Core4_Runnable10ms, OsAppTaskRef=OsTask_Bsw_OsCore4, OsAppAlarmRef=Os/Rte_Al_TE5_EcuM_EcuM_MainFunction, OsAppTaskRef=OsTask_Init_OsCore4
      OsApplication_OsCore5: OsAppTaskRef=OsTask_Asw_OsCore5, OsAppAlarmRef=Os/Rte_Al_TE_Cdd_Core5_Cdd_Core5_Runnable10ms, OsAppTaskRef=OsTask_Bsw_OsCore5, OsAppAlarmRef=Os/Rte_Al_TE6_EcuM_EcuM_MainFunction, OsAppTaskRef=OsTask_Init_OsCore5
  module config EcuC
  ecuc value collection DaVinci_Project: ecuc-values=[Com, Rte, Os, EcuC, NvM]
