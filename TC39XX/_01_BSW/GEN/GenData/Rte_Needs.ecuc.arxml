AUTOSAR XML (schema 4-0-3)
package /DaVinci_Project
  module config Rte
    12 x RteBswModuleInstance:
      BswM
        BswM_MainFunctionTimingEvent0 (RteBswEventToTaskMapping): RteBswUsedOsAlarmRef=Os/Rte_Al_TE2_OsTask_Bsw_10ms_Core0_0_10ms
      Crc
      Det
      Dio
      EcuM
        6 x RteBswEventToTaskMapping:
          EcuM_MainFunctionTimingEvent0: RteBswUsedOsAlarmRef=Os/Rte_Al_TE2_OsTask_Bsw_10ms_Core0_0_10ms
          EcuM_MainFunctionTimingEvent1: RteBswUsedOsAlarmRef=Os/Rte_Al_TE2_EcuM_EcuM_MainFunction
          EcuM_MainFunctionTimingEvent2: RteBswUsedOsAlarmRef=Os/Rte_Al_TE3_EcuM_EcuM_MainFunction
          EcuM_MainFunctionTimingEvent3: RteBswUsedOsAlarmRef=Os/Rte_Al_TE4_EcuM_EcuM_MainFunction
          EcuM_MainFunctionTimingEvent4: RteBswUsedOsAlarmRef=Os/Rte_Al_TE5_EcuM_EcuM_MainFunction
          EcuM_MainFunctionTimingEvent5: RteBswUsedOsAlarmRef=Os/Rte_Al_TE6_EcuM_EcuM_MainFunction
      EthTrcv
        EthTrcv_30_Tja1100_MainFunctionTimingEvent0 (RteBswEventToTaskMapping): RteBswUsedOsAlarmRef=Os/Rte_Al_TE2_OsTask_Bsw_20ms_Core0_0_20ms
        EthTrcv_30_Tja1100_MainFunctionLinkHandlingTimingEvent0 (RteBswEventToTaskMapping): RteBswUsedOsAlarmRef=Os/Rte_Al_TE_EthTrcv_30_Tja1100_EthTrcv_30_Tja1100_MainFunctionLinkHandling
      Eth
        Eth_30_Tc3xx_MainFunctionTimingEvent0 (RteBswEventToTaskMapping): RteBswUsedOsAlarmRef=Os/Rte_Al_TE2_OsTask_Bsw_20ms_Core0_0_20ms
      Irq
      McalLib
      Mcu
      Port
      Uart
        Uart_MainFunction_ReadTimingEvent0 (RteBswEventToTaskMapping): RteBswUsedOsAlarmRef=Os/Rte_Al_TE_Uart_Uart_MainFunction_Read
        Uart_MainFunction_WriteTimingEvent0 (RteBswEventToTaskMapping)
    17 x RteSwComponentInstance:
      BswM_EcuSwComposition
        Timer_BswM_MainFunction (RteEventToTaskMapping): RteUsedOsAlarmRef=Os/Rte_Al_TE2_OsTask_Bsw_10ms_Core0_0_10ms
      Cdd_Core0_EcuSwComposition
        4 x RteEventToTaskMapping:
          TMT_Runnable_5ms: RteUsedOsEventRef=Rte_Ev_Cyclic_OsTask_Asw_OsCore0_0_10ms, RteUsedOsAlarmRef=Os/Rte_Al_TE_OsTask_Asw_OsCore0_0_10ms
          TMT_Cdd_Core0_Runnable1ms: RteUsedOsEventRef=Rte_Ev_Run_Cdd_Core0_Cdd_Core0_Runnable1ms, RteUsedOsAlarmRef=Os/Rte_Al_TE_Cdd_Core0_Cdd_Core0_Runnable1ms
          TMT_Runnable_20: RteUsedOsEventRef=Rte_Ev_Run_Cdd_Core0_Cdd_Core0_Runnable20ms, RteUsedOsAlarmRef=Os/Rte_Al_TE_Cdd_Core0_Cdd_Core0_Runnable20ms
          TMT_Cdd_Nm_Runnable5ms: RteUsedOsEventRef=Rte_Ev_Cyclic_OsTask_Asw_OsCore0_0_5ms, RteUsedOsAlarmRef=Os/Rte_Al_TE_OsTask_Asw_OsCore0_0_5ms
      Cdd_Core1_EcuSwComposition
        TMT_Cdd_Core1_Runnable10ms (RteEventToTaskMapping): RteUsedOsAlarmRef=Os/Rte_Al_TE_Cdd_Core1_Cdd_Core1_Runnable10ms
      Cdd_Core2_EcuSwComposition
        TMT_Cdd_Core2_Runnable10ms (RteEventToTaskMapping): RteUsedOsAlarmRef=Os/Rte_Al_TE_Cdd_Core2_Cdd_Core2_Runnable10ms
      Cdd_Core3_EcuSwComposition
        TMT_Cdd_Core3_Runnable10ms (RteEventToTaskMapping): RteUsedOsAlarmRef=Os/Rte_Al_TE_Cdd_Core3_Cdd_Core3_Runnable10ms
      Cdd_Core4_EcuSwComposition
        TMT_Cdd_Core4_Runnable10ms (RteEventToTaskMapping): RteUsedOsAlarmRef=Os/Rte_Al_TE_Cdd_Core4_Cdd_Core4_Runnable10ms
      Cdd_Core5_EcuSwComposition
        TMT_Cdd_Core5_Runnable10ms (RteEventToTaskMapping): RteUsedOsAlarmRef=Os/Rte_Al_TE_Cdd_Core5_Cdd_Core5_Runnable10ms
      Cdd_log_EcuSwComposition
        TMT_Cdd_Log_Runnable5ms (RteEventToTaskMapping): RteUsedOsEventRef=Rte_Ev_Cyclic_OsTask_Asw_OsCore0_0_5ms, RteUsedOsAlarmRef=Os/Rte_Al_TE_OsTask_Asw_OsCore0_0_5ms
      Cdd_nm_EcuSwComposition
        TMT_Cdd_Nm_Runnable10ms (RteEventToTaskMapping): RteUsedOsEventRef=Rte_Ev_Cyclic_OsTask_Asw_OsCore0_0_10ms, RteUsedOsAlarmRef=Os/Rte_Al_TE_OsTask_Asw_OsCore0_0_10ms
      Det_EcuSwComposition
      EcuM_EcuSwComposition
        Timer_EcuM_MainFunction (RteEventToTaskMapping): RteUsedOsAlarmRef=Os/Rte_Al_TE2_OsTask_Bsw_10ms_Core0_0_10ms
      Os_OsCore{0..5}_swc_EcuSwComposition
    RteOsInteraction
      18 x RteUsedOsActivation, all with RteExpectedActivationOffset=0:
        Rte_Al_TE_Cdd_Core0_Cdd_Core0_Runnable1ms: RteActivationOsAlarmRef=Os/Rte_Al_TE_Cdd_Core0_Cdd_Core0_Runnable1ms, RteActivationOsTaskRef=OsTask_Asw_OsCore0
        Rte_Al_TE_Cdd_Core0_Cdd_Core0_Runnable20ms: RteActivationOsAlarmRef=Os/Rte_Al_TE_Cdd_Core0_Cdd_Core0_Runnable20ms, RteActivationOsTaskRef=OsTask_Asw_OsCore0
        Rte_Al_TE_OsTask_Asw_OsCore0_0_10ms: RteActivationOsAlarmRef=Os/Rte_Al_TE_OsTask_Asw_OsCore0_0_10ms, RteActivationOsTaskRef=OsTask_Asw_OsCore0
        Rte_Al_TE_OsTask_Asw_OsCore0_0_5ms: RteActivationOsAlarmRef=Os/Rte_Al_TE_OsTask_Asw_OsCore0_0_5ms, RteActivationOsTaskRef=OsTask_Asw_OsCore0
        Rte_Al_TE_Cdd_Core{1..5}_Cdd_Core{1..5}_Runnable10ms: RteActivationOsAlarmRef=Os/Rte_Al_TE_Cdd_Core{1..5}_Cdd_Core{1..5}_Runnable10ms, RteActivationOsTaskRef=OsTask_Asw_OsCore{1..5}
        Rte_Al_TE2_OsTask_Bsw_10ms_Core0_0_10ms: RteActivationOsAlarmRef=Os/Rte_Al_TE2_OsTask_Bsw_10ms_Core0_0_10ms, RteActivationOsTaskRef=OsTask_Bsw_10ms_Core0
        Rte_Al_TE_Uart_Uart_MainFunction_Read: RteActivationOsAlarmRef=Os/Rte_Al_TE_Uart_Uart_MainFunction_Read, RteActivationOsTaskRef=OsTask_Bsw_1ms_Core0
        Rte_Al_TE2_OsTask_Bsw_20ms_Core0_0_20ms: RteActivationOsAlarmRef=Os/Rte_Al_TE2_OsTask_Bsw_20ms_Core0_0_20ms, RteActivationOsTaskRef=OsTask_Bsw_20ms_Core0
        Rte_Al_TE_EthTrcv_30_Tja1100_EthTrcv_30_Tja1100_MainFunctionLinkHandling: RteActivationOsAlarmRef=Os/Rte_Al_TE_EthTrcv_30_Tja1100_EthTrcv_30_Tja1100_MainFunctionLinkHandling, RteActivationOsTaskRef=OsTask_Bsw_5ms_Core0
        Rte_Al_TE2_EcuM_EcuM_MainFunction: RteActivationOsAlarmRef=Os/Rte_Al_TE2_EcuM_EcuM_MainFunction, RteActivationOsTaskRef=OsTask_Bsw_OsCore1
        Rte_Al_TE3_EcuM_EcuM_MainFunction: RteActivationOsAlarmRef=Os/Rte_Al_TE3_EcuM_EcuM_MainFunction, RteActivationOsTaskRef=OsTask_Bsw_OsCore2
        Rte_Al_TE4_EcuM_EcuM_MainFunction: RteActivationOsAlarmRef=Os/Rte_Al_TE4_EcuM_EcuM_MainFunction, RteActivationOsTaskRef=OsTask_Bsw_OsCore3
        Rte_Al_TE5_EcuM_EcuM_MainFunction: RteActivationOsAlarmRef=Os/Rte_Al_TE5_EcuM_EcuM_MainFunction, RteActivationOsTaskRef=OsTask_Bsw_OsCore4
        Rte_Al_TE6_EcuM_EcuM_MainFunction: RteActivationOsAlarmRef=Os/Rte_Al_TE6_EcuM_EcuM_MainFunction, RteActivationOsTaskRef=OsTask_Bsw_OsCore5
  module config NvM
  module config Os
    OsTask_Asw_OsCore0 (OsTask):
      OsTaskActivation = 1
      OsTaskPriority = 15
      OsTaskSchedule = FULL
      OsTaskEventRef = Rte_Ev_Cyclic_OsTask_Asw_OsCore0_0_10ms
      OsTaskEventRef = Rte_Ev_Cyclic_OsTask_Asw_OsCore0_0_5ms
      OsTaskEventRef = Rte_Ev_Run_Cdd_Core0_Cdd_Core0_Runnable1ms
      OsTaskEventRef = Rte_Ev_Run_Cdd_Core0_Cdd_Core0_Runnable20ms
      OsTaskAccessingApplication = OsApplication_OsCore{1..5}
      OsTaskAccessingApplication = SystemApplication_OsCore0
    4 x OsAlarm, all with OsAlarmCounterRef=SystemTimer_OsCore0, OsAlarmAccessingApplication=OsApplication_OsCore1, OsAlarmAccessingApplication=OsApplication_OsCore2, OsAlarmAccessingApplication=OsApplication_OsCore3, OsAlarmAccessingApplication=OsApplication_OsCore4, OsAlarmAccessingApplication=OsApplication_OsCore5, OsAlarmAccessingApplication=SystemApplication_OsCore0:
      Rte_Al_TE_Cdd_Core0_Cdd_Core0_Runnable1ms
        OsAlarmAction
          OsAlarmSetEvent: OsAlarmSetEventRef=Rte_Ev_Run_Cdd_Core0_Cdd_Core0_Runnable1ms, OsAlarmSetEventTaskRef=OsTask_Asw_OsCore0
      Rte_Al_TE_Cdd_Core0_Cdd_Core0_Runnable20ms
        OsAlarmAction
          OsAlarmSetEvent: OsAlarmSetEventRef=Rte_Ev_Run_Cdd_Core0_Cdd_Core0_Runnable20ms, OsAlarmSetEventTaskRef=OsTask_Asw_OsCore0
      Rte_Al_TE_OsTask_Asw_OsCore0_0_10ms
        OsAlarmAction
          OsAlarmSetEvent: OsAlarmSetEventRef=Rte_Ev_Cyclic_OsTask_Asw_OsCore0_0_10ms, OsAlarmSetEventTaskRef=OsTask_Asw_OsCore0
      Rte_Al_TE_OsTask_Asw_OsCore0_0_5ms
        OsAlarmAction
          OsAlarmSetEvent: OsAlarmSetEventRef=Rte_Ev_Cyclic_OsTask_Asw_OsCore0_0_5ms, OsAlarmSetEventTaskRef=OsTask_Asw_OsCore0
    OsTask_Asw_OsCore1 (OsTask):
      OsTaskActivation = 100
      OsTaskPriority = 14
      OsTaskSchedule = FULL
      OsTaskAccessingApplication = OsApplication_OsCore0
      OsTaskAccessingApplication = OsApplication_OsCore{2..5}
      OsTaskAccessingApplication = SystemApplication_OsCore0
    Rte_Al_TE_Cdd_Core1_Cdd_Core1_Runnable10ms (OsAlarm):
      OsAlarmCounterRef = SystemTimer_OsCore1
      OsAlarmAccessingApplication = OsApplication_OsCore0
      OsAlarmAccessingApplication = OsApplication_OsCore{2..5}
      OsAlarmAccessingApplication = SystemApplication_OsCore0
      OsAlarmAction
        OsAlarmActivateTask: OsAlarmActivateTaskRef=OsTask_Asw_OsCore1
    OsTask_Asw_OsCore2 (OsTask):
      OsTaskActivation = 100
      OsTaskPriority = 13
      OsTaskSchedule = FULL
      OsTaskAccessingApplication = OsApplication_OsCore0
      OsTaskAccessingApplication = OsApplication_OsCore1
      OsTaskAccessingApplication = OsApplication_OsCore{3..5}
      OsTaskAccessingApplication = SystemApplication_OsCore0
    Rte_Al_TE_Cdd_Core2_Cdd_Core2_Runnable10ms (OsAlarm):
      OsAlarmCounterRef = SystemTimer_OsCore2
      OsAlarmAccessingApplication = OsApplication_OsCore0
      OsAlarmAccessingApplication = OsApplication_OsCore1
      OsAlarmAccessingApplication = OsApplication_OsCore{3..5}
      OsAlarmAccessingApplication = SystemApplication_OsCore0
      OsAlarmAction
        OsAlarmActivateTask: OsAlarmActivateTaskRef=OsTask_Asw_OsCore2
    OsTask_Asw_OsCore3 (OsTask):
      OsTaskActivation = 100
      OsTaskPriority = 12
      OsTaskSchedule = FULL
      OsTaskAccessingApplication = OsApplication_OsCore{0..2}
      OsTaskAccessingApplication = OsApplication_OsCore4
      OsTaskAccessingApplication = OsApplication_OsCore5
      OsTaskAccessingApplication = SystemApplication_OsCore0
    Rte_Al_TE_Cdd_Core3_Cdd_Core3_Runnable10ms (OsAlarm):
      OsAlarmCounterRef = SystemTimer_OsCore3
      OsAlarmAccessingApplication = OsApplication_OsCore{0..2}
      OsAlarmAccessingApplication = OsApplication_OsCore4
      OsAlarmAccessingApplication = OsApplication_OsCore5
      OsAlarmAccessingApplication = SystemApplication_OsCore0
      OsAlarmAction
        OsAlarmActivateTask: OsAlarmActivateTaskRef=OsTask_Asw_OsCore3
    OsTask_Asw_OsCore4 (OsTask):
      OsTaskActivation = 100
      OsTaskPriority = 11
      OsTaskSchedule = FULL
      OsTaskAccessingApplication = OsApplication_OsCore{0..3}
      OsTaskAccessingApplication = OsApplication_OsCore5
      OsTaskAccessingApplication = SystemApplication_OsCore0
    Rte_Al_TE_Cdd_Core4_Cdd_Core4_Runnable10ms (OsAlarm):
      OsAlarmCounterRef = SystemTimer_OsCore4
      OsAlarmAccessingApplication = OsApplication_OsCore{0..3}
      OsAlarmAccessingApplication = OsApplication_OsCore5
      OsAlarmAccessingApplication = SystemApplication_OsCore0
      OsAlarmAction
        OsAlarmActivateTask: OsAlarmActivateTaskRef=OsTask_Asw_OsCore4
    OsTask_Asw_OsCore5 (OsTask):
      OsTaskActivation = 100
      OsTaskPriority = 10
      OsTaskSchedule = FULL
      OsTaskAccessingApplication = OsApplication_OsCore{0..4}
      OsTaskAccessingApplication = SystemApplication_OsCore0
    Rte_Al_TE_Cdd_Core5_Cdd_Core5_Runnable10ms (OsAlarm):
      OsAlarmCounterRef = SystemTimer_OsCore5
      OsAlarmAccessingApplication = OsApplication_OsCore{0..4}
      OsAlarmAccessingApplication = SystemApplication_OsCore0
      OsAlarmAction
        OsAlarmActivateTask: OsAlarmActivateTaskRef=OsTask_Asw_OsCore5
    OsTask_Bsw_10ms_Core0 (OsTask):
      OsTaskActivation = 1
      OsTaskPriority = 30
      OsTaskSchedule = FULL
      OsTaskAccessingApplication = OsApplication_OsCore{1..5}
      OsTaskAccessingApplication = SystemApplication_OsCore0
    Rte_Al_TE2_OsTask_Bsw_10ms_Core0_0_10ms (OsAlarm):
      OsAlarmCounterRef = SystemTimer_OsCore0
      OsAlarmAccessingApplication = OsApplication_OsCore{1..5}
      OsAlarmAccessingApplication = SystemApplication_OsCore0
      OsAlarmAction
        OsAlarmActivateTask: OsAlarmActivateTaskRef=OsTask_Bsw_10ms_Core0
    OsTask_Bsw_1ms_Core0 (OsTask):
      OsTaskActivation = 3
      OsTaskPriority = 50
      OsTaskSchedule = FULL
      OsTaskAccessingApplication = OsApplication_OsCore{1..5}
      OsTaskAccessingApplication = SystemApplication_OsCore0
    Rte_Al_TE_Uart_Uart_MainFunction_Read (OsAlarm):
      OsAlarmCounterRef = SystemTimer_OsCore0
      OsAlarmAccessingApplication = OsApplication_OsCore{1..5}
      OsAlarmAccessingApplication = SystemApplication_OsCore0
      OsAlarmAction
        OsAlarmActivateTask: OsAlarmActivateTaskRef=OsTask_Bsw_1ms_Core0
    OsTask_Bsw_20ms_Core0 (OsTask):
      OsTaskActivation = 3
      OsTaskPriority = 50
      OsTaskSchedule = FULL
      OsTaskAccessingApplication = OsApplication_OsCore{0..5}
    Rte_Al_TE2_OsTask_Bsw_20ms_Core0_0_20ms (OsAlarm):
      OsAlarmCounterRef = SystemTimer_OsCore0
      OsAlarmAccessingApplication = OsApplication_OsCore{0..5}
      OsAlarmAction
        OsAlarmActivateTask: OsAlarmActivateTaskRef=OsTask_Bsw_20ms_Core0
    OsTask_Bsw_5ms_Core0 (OsTask):
      OsTaskActivation = 3
      OsTaskPriority = 50
      OsTaskSchedule = FULL
      OsTaskAccessingApplication = OsApplication_OsCore{0..5}
    Rte_Al_TE_EthTrcv_30_Tja1100_EthTrcv_30_Tja1100_MainFunctionLinkHandling (OsAlarm):
      OsAlarmCounterRef = SystemTimer_OsCore0
      OsAlarmAccessingApplication = OsApplication_OsCore{0..5}
      OsAlarmAction
        OsAlarmActivateTask: OsAlarmActivateTaskRef=OsTask_Bsw_5ms_Core0
    OsTask_Bsw_OsCore1 (OsTask):
      OsTaskActivation = 100
      OsTaskPriority = 34
      OsTaskSchedule = FULL
      OsTaskAccessingApplication = OsApplication_OsCore0
      OsTaskAccessingApplication = OsApplication_OsCore{2..5}
      OsTaskAccessingApplication = SystemApplication_OsCore0
    Rte_Al_TE2_EcuM_EcuM_MainFunction (OsAlarm):
      OsAlarmCounterRef = SystemTimer_OsCore1
      OsAlarmAccessingApplication = OsApplication_OsCore0
      OsAlarmAccessingApplication = OsApplication_OsCore{2..5}
      OsAlarmAccessingApplication = SystemApplication_OsCore0
      OsAlarmAction
        OsAlarmActivateTask: OsAlarmActivateTaskRef=OsTask_Bsw_OsCore1
    OsTask_Bsw_OsCore2 (OsTask):
      OsTaskActivation = 100
      OsTaskPriority = 33
      OsTaskSchedule = FULL
      OsTaskAccessingApplication = OsApplication_OsCore0
      OsTaskAccessingApplication = OsApplication_OsCore1
      OsTaskAccessingApplication = OsApplication_OsCore{3..5}
      OsTaskAccessingApplication = SystemApplication_OsCore0
    Rte_Al_TE3_EcuM_EcuM_MainFunction (OsAlarm):
      OsAlarmCounterRef = SystemTimer_OsCore2
      OsAlarmAccessingApplication = OsApplication_OsCore0
      OsAlarmAccessingApplication = OsApplication_OsCore1
      OsAlarmAccessingApplication = OsApplication_OsCore{3..5}
      OsAlarmAccessingApplication = SystemApplication_OsCore0
      OsAlarmAction
        OsAlarmActivateTask: OsAlarmActivateTaskRef=OsTask_Bsw_OsCore2
    OsTask_Bsw_OsCore3 (OsTask):
      OsTaskActivation = 100
      OsTaskPriority = 32
      OsTaskSchedule = FULL
      OsTaskAccessingApplication = OsApplication_OsCore{0..2}
      OsTaskAccessingApplication = OsApplication_OsCore4
      OsTaskAccessingApplication = OsApplication_OsCore5
      OsTaskAccessingApplication = SystemApplication_OsCore0
    Rte_Al_TE4_EcuM_EcuM_MainFunction (OsAlarm):
      OsAlarmCounterRef = SystemTimer_OsCore3
      OsAlarmAccessingApplication = OsApplication_OsCore{0..2}
      OsAlarmAccessingApplication = OsApplication_OsCore4
      OsAlarmAccessingApplication = OsApplication_OsCore5
      OsAlarmAccessingApplication = SystemApplication_OsCore0
      OsAlarmAction
        OsAlarmActivateTask: OsAlarmActivateTaskRef=OsTask_Bsw_OsCore3
    OsTask_Bsw_OsCore4 (OsTask):
      OsTaskActivation = 100
      OsTaskPriority = 31
      OsTaskSchedule = FULL
      OsTaskAccessingApplication = OsApplication_OsCore{0..3}
      OsTaskAccessingApplication = OsApplication_OsCore5
      OsTaskAccessingApplication = SystemApplication_OsCore0
    Rte_Al_TE5_EcuM_EcuM_MainFunction (OsAlarm):
      OsAlarmCounterRef = SystemTimer_OsCore4
      OsAlarmAccessingApplication = OsApplication_OsCore{0..3}
      OsAlarmAccessingApplication = OsApplication_OsCore5
      OsAlarmAccessingApplication = SystemApplication_OsCore0
      OsAlarmAction
        OsAlarmActivateTask: OsAlarmActivateTaskRef=OsTask_Bsw_OsCore4
    OsTask_Bsw_OsCore5 (OsTask):
      OsTaskActivation = 100
      OsTaskPriority = 30
      OsTaskSchedule = FULL
      OsTaskAccessingApplication = OsApplication_OsCore{0..4}
      OsTaskAccessingApplication = SystemApplication_OsCore0
    Rte_Al_TE6_EcuM_EcuM_MainFunction (OsAlarm):
      OsAlarmCounterRef = SystemTimer_OsCore5
      OsAlarmAccessingApplication = OsApplication_OsCore{0..4}
      OsAlarmAccessingApplication = SystemApplication_OsCore0
      OsAlarmAction
        OsAlarmActivateTask: OsAlarmActivateTaskRef=OsTask_Bsw_OsCore5
    6 x OsTask, all with OsTaskActivation=1, OsTaskPriority=48, OsTaskSchedule=FULL, OsTaskAccessingApplication=SystemApplication_OsCore0:
      OsTask_Init_OsCore0: OsTaskAccessingApplication=OsApplication_OsCore1, OsTaskAccessingApplication=OsApplication_OsCore2, OsTaskAccessingApplication=OsApplication_OsCore3, OsTaskAccessingApplication=OsApplication_OsCore4, OsTaskAccessingApplication=OsApplication_OsCore5
      OsTask_Init_OsCore1: OsTaskAccessingApplication=OsApplication_OsCore0, OsTaskAccessingApplication=OsApplication_OsCore2, OsTaskAccessingApplication=OsApplication_OsCore3, OsTaskAccessingApplication=OsApplication_OsCore4, OsTaskAccessingApplication=OsApplication_OsCore5
      OsTask_Init_OsCore2: OsTaskAccessingApplication=OsApplication_OsCore0, OsTaskAccessingApplication=OsApplication_OsCore1, OsTaskAccessingApplication=OsApplication_OsCore3, OsTaskAccessingApplication=OsApplication_OsCore4, OsTaskAccessingApplication=OsApplication_OsCore5
      OsTask_Init_OsCore3: OsTaskAccessingApplication=OsApplication_OsCore0, OsTaskAccessingApplication=OsApplication_OsCore1, OsTaskAccessingApplication=OsApplication_OsCore2, OsTaskAccessingApplication=OsApplication_OsCore4, OsTaskAccessingApplication=OsApplication_OsCore5
      OsTask_Init_OsCore4: OsTaskAccessingApplication=OsApplication_OsCore0, OsTaskAccessingApplication=OsApplication_OsCore1, OsTaskAccessingApplication=OsApplication_OsCore2, OsTaskAccessingApplication=OsApplication_OsCore3, OsTaskAccessingApplication=OsApplication_OsCore5
      OsTask_Init_OsCore5: OsTaskAccessingApplication=OsApplication_OsCore0, OsTaskAccessingApplication=OsApplication_OsCore1, OsTaskAccessingApplication=OsApplication_OsCore2, OsTaskAccessingApplication=OsApplication_OsCore3, OsTaskAccessingApplication=OsApplication_OsCore4
    4 x OsEvent:
      Rte_Ev_Cyclic_OsTask_Asw_OsCore0_0_10ms
      Rte_Ev_Cyclic_OsTask_Asw_OsCore0_0_5ms
      Rte_Ev_Run_Cdd_Core0_Cdd_Core0_Runnable1ms
      Rte_Ev_Run_Cdd_Core0_Cdd_Core0_Runnable20ms
    7 x OsApplication, all with OsTrusted=true:
      OsApplication_OsCore0: OsAppTaskRef=OsTask_Asw_OsCore0, OsAppAlarmRef=Os/Rte_Al_TE_Cdd_Core0_Cdd_Core0_Runnable1ms, OsAppAlarmRef=Os/Rte_Al_TE_Cdd_Core0_Cdd_Core0_Runnable20ms, OsAppAlarmRef=Os/Rte_Al_TE_OsTask_Asw_OsCore0_0_10ms, OsAppAlarmRef=Os/Rte_Al_TE_OsTask_Asw_OsCore0_0_5ms, OsAppTaskRef=OsTask_Bsw_10ms_Core0, OsAppAlarmRef=Os/Rte_Al_TE2_OsTask_Bsw_10ms_Core0_0_10ms, OsAppTaskRef=OsTask_Bsw_1ms_Core0, OsAppAlarmRef=Os/Rte_Al_TE_Uart_Uart_MainFunction_Read, OsAppTaskRef=OsTask_Init_OsCore0
      OsApplication_OsCore1: OsAppTaskRef=OsTask_Asw_OsCore1, OsAppAlarmRef=Os/Rte_Al_TE_Cdd_Core1_Cdd_Core1_Runnable10ms, OsAppTaskRef=OsTask_Bsw_OsCore1, OsAppAlarmRef=Os/Rte_Al_TE2_EcuM_EcuM_MainFunction, OsAppTaskRef=OsTask_Init_OsCore1
      OsApplication_OsCore2: OsAppTaskRef=OsTask_Asw_OsCore2, OsAppAlarmRef=Os/Rte_Al_TE_Cdd_Core2_Cdd_Core2_Runnable10ms, OsAppTaskRef=OsTask_Bsw_OsCore2, OsAppAlarmRef=Os/Rte_Al_TE3_EcuM_EcuM_MainFunction, OsAppTaskRef=OsTask_Init_OsCore2
      OsApplication_OsCore3: OsAppTaskRef=OsTask_Asw_OsCore3, OsAppAlarmRef=Os/Rte_Al_TE_Cdd_Core3_Cdd_Core3_Runnable10ms, OsAppTaskRef=OsTask_Bsw_OsCore3, OsAppAlarmRef=Os/Rte_Al_TE4_EcuM_EcuM_MainFunction, OsAppTaskRef=OsTask_Init_OsCore3
      OsApplication_OsCore4: OsAppTaskRef=OsTask_Asw_OsCore4, OsAppAlarmRef=Os/Rte_Al_TE_Cdd_Core4_Cdd_Core4_Runnable10ms, OsAppTaskRef=OsTask_Bsw_OsCore4, OsAppAlarmRef=Os/Rte_Al_TE5_EcuM_EcuM_MainFunction, OsAppTaskRef=OsTask_Init_OsCore4
      OsApplication_OsCore5: OsAppTaskRef=OsTask_Asw_OsCore5, OsAppAlarmRef=Os/Rte_Al_TE_Cdd_Core5_Cdd_Core5_Runnable10ms, OsAppTaskRef=OsTask_Bsw_OsCore5, OsAppAlarmRef=Os/Rte_Al_TE6_EcuM_EcuM_MainFunction, OsAppTaskRef=OsTask_Init_OsCore5
      SystemApplication_OsCore0: OsAppTaskRef=OsTask_Bsw_20ms_Core0, OsAppAlarmRef=Os/Rte_Al_TE2_OsTask_Bsw_20ms_Core0_0_20ms, OsAppTaskRef=OsTask_Bsw_5ms_Core0, OsAppAlarmRef=Os/Rte_Al_TE_EthTrcv_30_Tja1100_EthTrcv_30_Tja1100_MainFunctionLinkHandling
  module config EcuC
  ecuc value collection DaVinci_Project: ecuc-values=[Com, Rte, Os, EcuC, NvM]
