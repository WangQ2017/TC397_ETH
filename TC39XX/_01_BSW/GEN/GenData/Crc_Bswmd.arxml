AUTOSAR XML (schema 4-2-2)
# Copyright (C) Infineon Technologies (2020)
# All rights reserved.
package /AUTOSAR_Crc/BswModuleDescriptions
  bsw module description Crc: category=BSW_MODULE, module-id=201  # Cyclic Redundacy Check
    bsw module dependency McalLibDependency: target-module-id=255, required-entrys=[Mcal_SetBitAtomic, Mcal_WritePeripEndInitProtReg, Mcal_GetSpinlock, Mcal_ReleaseSpinlock]
    bsw module dependency McalSafetyErrorDependency: target-module-id=255, required-entrys=Mcal_ReportSafetyError
    bsw internal behavior CrcBehavior
      exclusive area CriticalSection
package /AUTOSAR_Crc/Implementations
  bsw implementation Crc: programming-language=C, sw-version=10.40.0, vendor-id=17, ar-release-version=4.2.2, behavior=CrcBehavior, vendor-specific-module-def=Crc
    code-descriptors:
      code Files: artifact-descriptors=[{short-label=ssc::src::Crc.c, category=SWSRC}, {short-label=ssc::inc::Crc.h, category=SWHDR}]
    generated-artifacts:
      dependency on artifact Crc_Cfg_h: artifact-descriptor={short-label=generate::template::inc::Crc_Cfg.h, category=SWTEMPLATE}, usages=COMPILE
      dependency on artifact Crc_xdm: artifact-descriptor={short-label=config::Crc.xdm, category=SWTOOL}, usages=CODEGENERATION
      dependency on artifact Crc_bmd: artifact-descriptor={short-label=autosar::TC39x::TC397x::Crc.bmd, category=SWTOOL}, usages=CODEGENERATION
    resource consumption ResourceConsumption
      6 x memory section:
        CONST_ASIL_B_GLOBAL_8: alignment=8, sw-addrmethod=CONST
        CONST_ASIL_B_GLOBAL_16: alignment=16, sw-addrmethod=CONST
        CONST_ASIL_B_GLOBAL_32: alignment=32, sw-addrmethod=CONST
        VAR_INIT_ASIL_B_GLOBAL_8: alignment=8, sw-addrmethod=VAR_INIT
        VAR_INIT_ASIL_B_GLOBAL_32: alignment=32, sw-addrmethod=VAR_INIT
        CODE_ASIL_B_GLOBAL: alignment=UNSPECIFIED, sw-addrmethod=CODE
      section name prefix CRC
