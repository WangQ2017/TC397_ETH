AUTOSAR XML (schema 4-2-2)
# Copyright (C) Infineon Technologies (2020)
# All rights reserved.
package /AURIX2G_Irq/BswModuleDescriptions
  bsw module description Irq: category=BSW_MODULE, module-id=255, provided-entrys=[Irq_ClearAllInterruptFlags, IrqGpsr_Init, IrqGtm_Init]  # IRQ Driver
    bsw internal behavior IrqBehavior
      bsw called entity IrqGtm_Init: reentrancy-level=NON-REENTRANT, implemented-entry=IrqGtm_Init
      bsw called entity IrqGpsr_Init: reentrancy-level=NON-REENTRANT, implemented-entry=IrqGpsr_Init
      bsw called entity Irq_ClearAllInterruptFlags: reentrancy-level=NON-REENTRANT, implemented-entry=Irq_ClearAllInterruptFlags
package /AURIX2G_Irq/BswModuleEntrys
  bsw module entry Irq_ClearAllInterruptFlags: is-reentrant=false, is-synchronous=true, call-type=REGULAR, execution-context=TASK, sw-service-impl-policy=STANDARD
  bsw module entry IrqGpsr_Init: is-reentrant=false, is-synchronous=true, call-type=REGULAR, execution-context=TASK, sw-service-impl-policy=STANDARD
  bsw module entry IrqGtm_Init: is-reentrant=false, is-synchronous=true, call-type=REGULAR, execution-context=TASK, sw-service-impl-policy=STANDARD
package /AURIX2G_Irq/Implementations
  bsw implementation Irq: programming-language=C, sw-version=10.40.0, vendor-id=17, ar-release-version=4.2.2, behavior=IrqBehavior, vendor-specific-module-def=Irq
    code-descriptors:
      code Files: artifact-descriptors=[{short-label=ssc::src::Irq.c, category=SWSRC}, {short-label=ssc::inc::Irq.h, category=SWHDR}]
    generated-artifacts:
      dependency on artifact Irq_Cfg_h: artifact-descriptor={short-label=generate::template::inc::Irq_Cfg.h, category=SWTEMPLATE}, usages=COMPILE
      dependency on artifact Irq_xdm: artifact-descriptor={short-label=config::Irq.xdm, category=SWTOOL}, usages=CODEGENERATION
      dependency on artifact Irq_bmd: artifact-descriptor={short-label=autosar::TC39x::TC397x::irq.bmd, category=SWTOOL}, usages=CODEGENERATION
    resource consumption ResourceConsumption
      memory section CODE_QM_GLOBAL: alignment=UNSPECIFIED, sw-addrmethod=CODE
      section name prefix IRQ
