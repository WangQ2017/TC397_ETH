AUTOSAR XML (schema 00046)
package /ResourceM
  module config ResourceM: implementation-config-variant=VARIANT-PRE-COMPILE
    ResourceMMcalConfig_0 (ResourceMMcalConfig): ResourceMMasterCore=CORE0, ResourceMNumberOfActiveCores=6
      6 x ResourceMMcalCore:
        ResourceMMcalCore_{0..5}: ResourceMCoreID=CORE{0..5}
package /McalLib
  module config McalLib: implementation-config-variant=VARIANT-PRE-COMPILE
    CommonPublishedInformation:
      ArMajorVersion = 4
      ArMinorVersion = 4
      ArPatchVersion = 0
      ModuleId = 255
      Release = _TRICORE_TC397
      SwMajorVersion = 20
      SwMinorVersion = 25
      SwPatchVersion = 0
      VendorId = 17
    McalLibGeneral: McalLibSafetyEnable=0
    McalLibPublishedInformation:
      McalLibBackUpClockFreq = 100
      McalLibDsprCore0EndAddr = 1879293951
      McalLibDsprCore0StartAddr = 1879048192
      McalLibDsprCore1EndAddr = 1610858495
      McalLibDsprCore1StartAddr = 1610612736
      McalLibDsprCore2EndAddr = 1342275583
      McalLibDsprCore2StartAddr = 1342177280
      McalLibDsprCore3EndAddr = 1073840127
      McalLibDsprCore3StartAddr = 1073741824
      McalLibDsprCore4EndAddr = 805404671
      McalLibDsprCore4StartAddr = 805306368
      McalLibDsprCore5EndAddr = 268533759
      McalLibDsprCore5StartAddr = 268435456
      McalLibMcalAvailableCores = 6
      McalLibPsprCore0EndAddr = 1880162303
      McalLibPsprCore0StartAddr = 1880096768
      McalLibPsprCore1EndAddr = 1611726847
      McalLibPsprCore1StartAddr = 1611661312
      McalLibPsprCore2EndAddr = 1343291391
      McalLibPsprCore2StartAddr = 1343225856
      McalLibPsprCore3EndAddr = 1074855935
      McalLibPsprCore3StartAddr = 1074790400
      McalLibPsprCore4EndAddr = 806420479
      McalLibPsprCore4StartAddr = 806354944
      McalLibPsprCore5EndAddr = 269549567
      McalLibPsprCore5StartAddr = 269484032
package /Dio
  module config Dio: implementation-config-variant=VARIANT-LINK-TIME
    CommonPublishedInformation:
      ArMajorVersion = 4
      ArMinorVersion = 4
      ArPatchVersion = 0
      ModuleId = 120
      Release = _TRICORE_TC397
      SwMajorVersion = 20
      SwMinorVersion = 25
      SwPatchVersion = 0
      VendorId = 17
    DioConfig
      DioPort_0 (DioPort): DioPortId=0
        DioChannel_PHY_RESET (DioChannel): DioChannelId=0
        DioChannel_PHY_WAKE (DioChannel): DioChannelId=1
      DioPort_33 (DioPort): DioPortId=33
        4 x DioChannel:
          DioChannel_LED0: DioChannelId=1
          DioChannel_LED1: DioChannelId=2
          DioChannel_LED2: DioChannelId=3
          DioChannel_LED3: DioChannelId=4
    DioGeneral: DioDevErrorDetect=0, DioFlipChannelApi=1, DioMaskedWritePortApi=0, DioSafetyEnable=0, DioVersionInfoApi=0
package /Port
  module config Port: implementation-config-variant=VARIANT-POST-BUILD
    CommonPublishedInformation:
      ArMajorVersion = 4
      ArMinorVersion = 4
      ArPatchVersion = 0
      ModuleId = 124
      Release = _TRICORE_TC397
      SwMajorVersion = 20
      SwMinorVersion = 10
      SwPatchVersion = 0
      VendorId = 17
    PortConfigSet
      17 x PortContainer:
        PortContainer_0: PortNumber=0, PortNumberOfPortPins=13
          13 x PortPin, all with PortPinControllerSelect=DISABLE, PortPinDirectionChangeable=0, PortPinEmergencyStop=0, PortPinEnableAnalogInputOnly=PORT_PIN_ANALOG_INPUT_DISABLE, PortPinInitialMode=GPIO, PortPinInputPadLevel=PORT_INPUT_LEVEL_CMOS_AUTOMOTIVE, PortPinLevelValue=PORT_PIN_LEVEL_LOW, PortPinMode=PORT_PIN_MODE_ALL, PortPinModeChangeable=0, PortPinOutputPinDriveMode=PORT_PIN_OUT_PUSHPULL:
            PortPin_0: PortPinDirection=PORT_PIN_OUT, PortPinId=0, PortPinInputPullResistor=PORT_PIN_IN_PULL_UP, PortPinOutputPadDriveStrength=PORT_PIN_MEDIUM_DRIVER, PortPinSymbolicName=PORT_0_PIN_0_PHY_RESET
            PortPin_1: PortPinDirection=PORT_PIN_OUT, PortPinId=1, PortPinInputPullResistor=PORT_PIN_IN_PULL_UP, PortPinOutputPadDriveStrength=PORT_PIN_MEDIUM_DRIVER, PortPinSymbolicName=PORT_0_PIN_1_PHY_WAKE
            PortPin_{10..12}: PortPinDirection=PORT_PIN_IN, PortPinId={10..12}, PortPinInputPullResistor=PORT_PIN_IN_NO_PULL, PortPinOutputPadDriveStrength=PORT_PIN_DEFAULT_DRIVER, PortPinSymbolicName=PORT_0_PIN_{10..12}
            PortPin_{2..9}: PortPinDirection=PORT_PIN_IN, PortPinId={2..9}, PortPinInputPullResistor=PORT_PIN_IN_NO_PULL, PortPinOutputPadDriveStrength=PORT_PIN_DEFAULT_DRIVER, PortPinSymbolicName=PORT_0_PIN_{2..9}
        PortContainer_1: PortNumber=1, PortNumberOfPortPins=5
          5 x PortPin, all with PortPinControllerSelect=DISABLE, PortPinDirection=PORT_PIN_IN, PortPinDirectionChangeable=0, PortPinEmergencyStop=0, PortPinEnableAnalogInputOnly=PORT_PIN_ANALOG_INPUT_DISABLE, PortPinInitialMode=GPIO, PortPinInputPadLevel=PORT_INPUT_LEVEL_CMOS_AUTOMOTIVE, PortPinInputPullResistor=PORT_PIN_IN_PULL_UP, PortPinLevelValue=PORT_PIN_LEVEL_LOW, PortPinMode=PORT_PIN_MODE_ALL, PortPinModeChangeable=0, PortPinOutputPadDriveStrength=PORT_PIN_DEFAULT_DRIVER, PortPinOutputPinDriveMode=PORT_PIN_OUT_PUSHPULL:
            PortPin_0: PortPinId=19, PortPinSymbolicName=PORT_1_PIN_3
            PortPin_1: PortPinId=20, PortPinSymbolicName=PORT_1_PIN_4
            PortPin_2: PortPinId=21, PortPinSymbolicName=PORT_1_PIN_5
            PortPin_3: PortPinId=22, PortPinSymbolicName=PORT_1_PIN_6
            PortPin_4: PortPinId=23, PortPinSymbolicName=PORT_1_PIN_7
        PortContainer_10: PortNumber=10, PortNumberOfPortPins=9
          9 x PortPin, all with PortPinControllerSelect=DISABLE, PortPinDirection=PORT_PIN_IN, PortPinDirectionChangeable=0, PortPinEmergencyStop=0, PortPinEnableAnalogInputOnly=PORT_PIN_ANALOG_INPUT_DISABLE, PortPinInitialMode=GPIO, PortPinInputPadLevel=PORT_INPUT_LEVEL_CMOS_AUTOMOTIVE, PortPinInputPullResistor=PORT_PIN_IN_PULL_UP, PortPinLevelValue=PORT_PIN_LEVEL_LOW, PortPinMode=PORT_PIN_MODE_ALL, PortPinModeChangeable=0, PortPinOutputPadDriveStrength=PORT_PIN_DEFAULT_DRIVER, PortPinOutputPinDriveMode=PORT_PIN_OUT_PUSHPULL:
            PortPin_0: PortPinId=160, PortPinSymbolicName=PORT_10_PIN_0
            PortPin_1: PortPinId=161, PortPinSymbolicName=PORT_10_PIN_1
            PortPin_2: PortPinId=162, PortPinSymbolicName=PORT_10_PIN_2
            PortPin_3: PortPinId=163, PortPinSymbolicName=PORT_10_PIN_3
            PortPin_4: PortPinId=164, PortPinSymbolicName=PORT_10_PIN_4
            PortPin_5: PortPinId=165, PortPinSymbolicName=PORT_10_PIN_5
            PortPin_6: PortPinId=166, PortPinSymbolicName=PORT_10_PIN_6
            PortPin_7: PortPinId=167, PortPinSymbolicName=PORT_10_PIN_7
            PortPin_8: PortPinId=168, PortPinSymbolicName=PORT_10_PIN_8
        PortContainer_11: PortNumber=11, PortNumberOfPortPins=16
          16 x PortPin, all with PortPinControllerSelect=DISABLE, PortPinDirectionChangeable=0, PortPinEmergencyStop=0, PortPinEnableAnalogInputOnly=PORT_PIN_ANALOG_INPUT_DISABLE, PortPinInputPadLevel=PORT_INPUT_LEVEL_CMOS_AUTOMOTIVE, PortPinInputPullResistor=PORT_PIN_IN_PULL_UP, PortPinLevelValue=PORT_PIN_LEVEL_LOW, PortPinMode=PORT_PIN_MODE_ALL, PortPinModeChangeable=0, PortPinOutputPinDriveMode=PORT_PIN_OUT_PUSHPULL:
            PortPin_0: PortPinDirection=PORT_PIN_OUT, PortPinId=176, PortPinInitialMode=ALT6, PortPinOutputPadDriveStrength=PORT_PIN_RGMII_DRIVER, PortPinSymbolicName=PORT_11_PIN_0_GETH_TXD3
            PortPin_1: PortPinDirection=PORT_PIN_OUT, PortPinId=177, PortPinInitialMode=ALT6, PortPinOutputPadDriveStrength=PORT_PIN_RGMII_DRIVER, PortPinSymbolicName=PORT_11_PIN_1_GETH_TXD2
            PortPin_10: PortPinDirection=PORT_PIN_IN, PortPinId=186, PortPinInitialMode=GPIO, PortPinOutputPadDriveStrength=PORT_PIN_DEFAULT_DRIVER, PortPinSymbolicName=PORT_11_PIN_10_GETH_RXD0
            PortPin_11: PortPinDirection=PORT_PIN_IN, PortPinId=187, PortPinInitialMode=GPIO, PortPinOutputPadDriveStrength=PORT_PIN_DEFAULT_DRIVER, PortPinSymbolicName=PORT_11_PIN_11_GETH_RXDV
            PortPin_12: PortPinDirection=PORT_PIN_IN, PortPinId=188, PortPinInitialMode=GPIO, PortPinOutputPadDriveStrength=PORT_PIN_DEFAULT_DRIVER, PortPinSymbolicName=PORT_11_PIN_12_GETH_RXCLK
            PortPin_13: PortPinDirection=PORT_PIN_IN, PortPinId=189, PortPinInitialMode=GPIO, PortPinOutputPadDriveStrength=PORT_PIN_DEFAULT_DRIVER, PortPinSymbolicName=PORT_11_PIN_13_GETH_RXERA_MII
            PortPin_14: PortPinDirection=PORT_PIN_IN, PortPinId=190, PortPinInitialMode=GPIO, PortPinOutputPadDriveStrength=PORT_PIN_DEFAULT_DRIVER, PortPinSymbolicName=PORT_11_PIN_14
            PortPin_15: PortPinDirection=PORT_PIN_IN, PortPinId=191, PortPinInitialMode=GPIO, PortPinOutputPadDriveStrength=PORT_PIN_DEFAULT_DRIVER, PortPinSymbolicName=PORT_11_PIN_15
            PortPin_2: PortPinDirection=PORT_PIN_OUT, PortPinId=178, PortPinInitialMode=ALT6, PortPinOutputPadDriveStrength=PORT_PIN_RGMII_DRIVER, PortPinSymbolicName=PORT_11_PIN_2_GETH_TXD1
            PortPin_3: PortPinDirection=PORT_PIN_OUT, PortPinId=179, PortPinInitialMode=ALT6, PortPinOutputPadDriveStrength=PORT_PIN_RGMII_DRIVER, PortPinSymbolicName=PORT_11_PIN_3_GETH_TXD0
            PortPin_4: PortPinDirection=PORT_PIN_OUT, PortPinId=180, PortPinInitialMode=ALT6, PortPinOutputPadDriveStrength=PORT_PIN_RGMII_DRIVER, PortPinSymbolicName=PORT_11_PIN_4_GETH_TXER_MII
            PortPin_5: PortPinDirection=PORT_PIN_IN, PortPinId=181, PortPinInitialMode=GPIO, PortPinOutputPadDriveStrength=PORT_PIN_DEFAULT_DRIVER, PortPinSymbolicName=PORT_11_PIN_5_GETH_TXCLKA_MII
            PortPin_6: PortPinDirection=PORT_PIN_OUT, PortPinId=182, PortPinInitialMode=ALT6, PortPinOutputPadDriveStrength=PORT_PIN_RGMII_DRIVER, PortPinSymbolicName=PORT_11_PIN_6_GETH_TXEN
            PortPin_7: PortPinDirection=PORT_PIN_IN, PortPinId=183, PortPinInitialMode=GPIO, PortPinOutputPadDriveStrength=PORT_PIN_DEFAULT_DRIVER, PortPinSymbolicName=PORT_11_PIN_7_GETH_RXD3
            PortPin_8: PortPinDirection=PORT_PIN_IN, PortPinId=184, PortPinInitialMode=GPIO, PortPinOutputPadDriveStrength=PORT_PIN_DEFAULT_DRIVER, PortPinSymbolicName=PORT_11_PIN_8_GETH_RXD2
            PortPin_9: PortPinDirection=PORT_PIN_IN, PortPinId=185, PortPinInitialMode=GPIO, PortPinOutputPadDriveStrength=PORT_PIN_DEFAULT_DRIVER, PortPinSymbolicName=PORT_11_PIN_9_GETH_RXD1
        PortContainer_12: PortNumber=12, PortNumberOfPortPins=2
          PortPin_0 (PortPin):
            PortPinControllerSelect = DISABLE
            PortPinDirection = PORT_PIN_OUT
            PortPinDirectionChangeable = 0
            PortPinEmergencyStop = 0
            PortPinEnableAnalogInputOnly = PORT_PIN_ANALOG_INPUT_DISABLE
            PortPinId = 192
            PortPinInitialMode = ALT6
            PortPinInputPadLevel = PORT_INPUT_LEVEL_CMOS_AUTOMOTIVE
            PortPinInputPullResistor = PORT_PIN_IN_PULL_UP
            PortPinLevelValue = PORT_PIN_LEVEL_LOW
            PortPinMode = PORT_PIN_MODE_ALL
            PortPinModeChangeable = 0
            PortPinOutputPadDriveStrength = PORT_PIN_MEDIUM_DRIVER_SHARP_EDGE
            PortPinOutputPinDriveMode = PORT_PIN_OUT_PUSHPULL
            PortPinSymbolicName = PORT_12_PIN_0_GETH_MDC
          PortPin_1 (PortPin):
            PortPinControllerSelect = DISABLE
            PortPinDirection = PORT_PIN_OUT
            PortPinDirectionChangeable = 0
            PortPinEmergencyStop = 0
            PortPinEnableAnalogInputOnly = PORT_PIN_ANALOG_INPUT_DISABLE
            PortPinId = 193
            PortPinInitialMode = GPIO
            PortPinInputPadLevel = PORT_INPUT_LEVEL_CMOS_AUTOMOTIVE
            PortPinInputPullResistor = PORT_PIN_IN_PULL_UP
            PortPinLevelValue = PORT_PIN_LEVEL_HIGH
            PortPinMode = PORT_PIN_MODE_ALL
            PortPinModeChangeable = 0
            PortPinOutputPadDriveStrength = PORT_PIN_MEDIUM_DRIVER_SHARP_EDGE
            PortPinOutputPinDriveMode = PORT_PIN_OUT_PUSHPULL
            PortPinSymbolicName = PORT_12_PIN_1_GETH_MDIO
        PortContainer_13: PortNumber=13, PortNumberOfPortPins=4
          PortLVDS_0 (PortLVDS):
            PortLVDSMode = LVDSH
            PortLVDSPadSupply = V3_3
            PortLVDSPinPair = Pin_0_Pin_1
            PortLVDSRxEnController = PORT_CONTROLLED
            PortLVDSRxPathEnable = 0
            PortLVDSRxTerminationMode = INTERNAL_TERMINATION
            PortLVDSTxEnController = PORT_CONTROLLED
            PortLVDSTxPathEnable = 0
            PortLVDSTxPowerDownPullDown = DISABLE
          PortLVDS_1 (PortLVDS):
            PortLVDSMode = LVDSH
            PortLVDSPadSupply = V3_3
            PortLVDSPinPair = Pin_2_Pin_3
            PortLVDSRxEnController = PORT_CONTROLLED
            PortLVDSRxPathEnable = 0
            PortLVDSRxTerminationMode = INTERNAL_TERMINATION
            PortLVDSTxEnController = PORT_CONTROLLED
            PortLVDSTxPathEnable = 0
            PortLVDSTxPowerDownPullDown = DISABLE
          4 x PortPin, all with PortPinControllerSelect=DISABLE, PortPinDirection=PORT_PIN_IN, PortPinDirectionChangeable=0, PortPinEmergencyStop=0, PortPinEnableAnalogInputOnly=PORT_PIN_ANALOG_INPUT_DISABLE, PortPinInitialMode=GPIO, PortPinInputPadLevel=PORT_INPUT_LEVEL_CMOS_AUTOMOTIVE, PortPinInputPullResistor=PORT_PIN_IN_NO_PULL, PortPinLevelValue=PORT_PIN_LEVEL_LOW, PortPinMode=PORT_PIN_MODE_ALL, PortPinModeChangeable=0, PortPinOutputPadDriveStrength=PORT_PIN_DEFAULT_DRIVER, PortPinOutputPinDriveMode=PORT_PIN_OUT_PUSHPULL:
            PortPin_0: PortPinId=208, PortPinSymbolicName=PORT_13_PIN_0
            PortPin_1: PortPinId=209, PortPinSymbolicName=PORT_13_PIN_1
            PortPin_2: PortPinId=210, PortPinSymbolicName=PORT_13_PIN_2
            PortPin_3: PortPinId=211, PortPinSymbolicName=PORT_13_PIN_3
        PortContainer_14: PortNumber=14, PortNumberOfPortPins=11
          PortLVDS_0 (PortLVDS):
            PortLVDSMode = LVDSH
            PortLVDSPadSupply = V3_3
            PortLVDSPinPair = Pin_10_Pin_9
            PortLVDSRxEnController = PORT_CONTROLLED
            PortLVDSRxPathEnable = 0
            PortLVDSRxTerminationMode = INTERNAL_TERMINATION
            PortLVDSTxEnController = PORT_CONTROLLED
            PortLVDSTxPathEnable = 0
            PortLVDSTxPowerDownPullDown = DISABLE
          11 x PortPin, all with PortPinControllerSelect=DISABLE, PortPinDirectionChangeable=0, PortPinEmergencyStop=0, PortPinEnableAnalogInputOnly=PORT_PIN_ANALOG_INPUT_DISABLE, PortPinInputPadLevel=PORT_INPUT_LEVEL_CMOS_AUTOMOTIVE, PortPinLevelValue=PORT_PIN_LEVEL_LOW, PortPinMode=PORT_PIN_MODE_ALL, PortPinModeChangeable=0, PortPinOutputPinDriveMode=PORT_PIN_OUT_PUSHPULL:
            PortPin_0: PortPinDirection=PORT_PIN_OUT, PortPinId=224, PortPinInitialMode=ALT2, PortPinInputPullResistor=PORT_PIN_IN_PULL_UP, PortPinOutputPadDriveStrength=PORT_PIN_MEDIUM_DRIVER, PortPinSymbolicName=PORT_14_PIN_0_UART_TX
            PortPin_1: PortPinDirection=PORT_PIN_IN, PortPinId=225, PortPinInitialMode=GPIO, PortPinInputPullResistor=PORT_PIN_IN_PULL_UP, PortPinOutputPadDriveStrength=PORT_PIN_DEFAULT_DRIVER, PortPinSymbolicName=PORT_14_PIN_1_UART_RX
            PortPin_10: PortPinDirection=PORT_PIN_IN, PortPinId=234, PortPinInitialMode=GPIO, PortPinInputPullResistor=PORT_PIN_IN_NO_PULL, PortPinOutputPadDriveStrength=PORT_PIN_DEFAULT_DRIVER, PortPinSymbolicName=PORT_14_PIN_10
            PortPin_2: PortPinDirection=PORT_PIN_IN, PortPinId=226, PortPinInitialMode=GPIO, PortPinInputPullResistor=PORT_PIN_IN_NO_PULL, PortPinOutputPadDriveStrength=PORT_PIN_DEFAULT_DRIVER, PortPinSymbolicName=PORT_14_PIN_2
            PortPin_3: PortPinDirection=PORT_PIN_IN, PortPinId=227, PortPinInitialMode=GPIO, PortPinInputPullResistor=PORT_PIN_IN_NO_PULL, PortPinOutputPadDriveStrength=PORT_PIN_DEFAULT_DRIVER, PortPinSymbolicName=PORT_14_PIN_3
            PortPin_4: PortPinDirection=PORT_PIN_IN, PortPinId=228, PortPinInitialMode=GPIO, PortPinInputPullResistor=PORT_PIN_IN_NO_PULL, PortPinOutputPadDriveStrength=PORT_PIN_DEFAULT_DRIVER, PortPinSymbolicName=PORT_14_PIN_4
            PortPin_5: PortPinDirection=PORT_PIN_IN, PortPinId=229, PortPinInitialMode=GPIO, PortPinInputPullResistor=PORT_PIN_IN_NO_PULL, PortPinOutputPadDriveStrength=PORT_PIN_DEFAULT_DRIVER, PortPinSymbolicName=PORT_14_PIN_5
            PortPin_6: PortPinDirection=PORT_PIN_IN, PortPinId=230, PortPinInitialMode=GPIO, PortPinInputPullResistor=PORT_PIN_IN_NO_PULL, PortPinOutputPadDriveStrength=PORT_PIN_DEFAULT_DRIVER, PortPinSymbolicName=PORT_14_PIN_6
            PortPin_7: PortPinDirection=PORT_PIN_IN, PortPinId=231, PortPinInitialMode=GPIO, PortPinInputPullResistor=PORT_PIN_IN_NO_PULL, PortPinOutputPadDriveStrength=PORT_PIN_DEFAULT_DRIVER, PortPinSymbolicName=PORT_14_PIN_7
            PortPin_8: PortPinDirection=PORT_PIN_IN, PortPinId=232, PortPinInitialMode=GPIO, PortPinInputPullResistor=PORT_PIN_IN_NO_PULL, PortPinOutputPadDriveStrength=PORT_PIN_DEFAULT_DRIVER, PortPinSymbolicName=PORT_14_PIN_8
            PortPin_9: PortPinDirection=PORT_PIN_IN, PortPinId=233, PortPinInitialMode=GPIO, PortPinInputPullResistor=PORT_PIN_IN_NO_PULL, PortPinOutputPadDriveStrength=PORT_PIN_DEFAULT_DRIVER, PortPinSymbolicName=PORT_14_PIN_9
        PortContainer_15: PortNumber=15, PortNumberOfPortPins=9
          9 x PortPin, all with PortPinControllerSelect=DISABLE, PortPinDirection=PORT_PIN_IN, PortPinDirectionChangeable=0, PortPinEmergencyStop=0, PortPinEnableAnalogInputOnly=PORT_PIN_ANALOG_INPUT_DISABLE, PortPinInitialMode=GPIO, PortPinInputPadLevel=PORT_INPUT_LEVEL_CMOS_AUTOMOTIVE, PortPinInputPullResistor=PORT_PIN_IN_NO_PULL, PortPinLevelValue=PORT_PIN_LEVEL_LOW, PortPinMode=PORT_PIN_MODE_ALL, PortPinModeChangeable=0, PortPinOutputPadDriveStrength=PORT_PIN_DEFAULT_DRIVER, PortPinOutputPinDriveMode=PORT_PIN_OUT_PUSHPULL:
            PortPin_0: PortPinId=240, PortPinSymbolicName=PORT_15_PIN_0
            PortPin_1: PortPinId=241, PortPinSymbolicName=PORT_15_PIN_1
            PortPin_2: PortPinId=242, PortPinSymbolicName=PORT_15_PIN_2
            PortPin_3: PortPinId=243, PortPinSymbolicName=PORT_15_PIN_3
            PortPin_4: PortPinId=244, PortPinSymbolicName=PORT_15_PIN_4
            PortPin_5: PortPinId=245, PortPinSymbolicName=PORT_15_PIN_5
            PortPin_6: PortPinId=246, PortPinSymbolicName=PORT_15_PIN_6
            PortPin_7: PortPinId=247, PortPinSymbolicName=PORT_15_PIN_7
            PortPin_8: PortPinId=248, PortPinSymbolicName=PORT_15_PIN_8
        PortContainer_2: PortNumber=2, PortNumberOfPortPins=12
          12 x PortPin, all with PortPinControllerSelect=DISABLE, PortPinDirection=PORT_PIN_IN, PortPinDirectionChangeable=0, PortPinEmergencyStop=0, PortPinEnableAnalogInputOnly=PORT_PIN_ANALOG_INPUT_DISABLE, PortPinInitialMode=GPIO, PortPinInputPadLevel=PORT_INPUT_LEVEL_CMOS_AUTOMOTIVE, PortPinInputPullResistor=PORT_PIN_IN_PULL_UP, PortPinLevelValue=PORT_PIN_LEVEL_LOW, PortPinMode=PORT_PIN_MODE_ALL, PortPinModeChangeable=0, PortPinOutputPadDriveStrength=PORT_PIN_DEFAULT_DRIVER, PortPinOutputPinDriveMode=PORT_PIN_OUT_PUSHPULL:
            PortPin_0: PortPinId=32, PortPinSymbolicName=PORT_2_PIN_0
            PortPin_1: PortPinId=33, PortPinSymbolicName=PORT_2_PIN_1
            PortPin_10: PortPinId=42, PortPinSymbolicName=PORT_2_PIN_10
            PortPin_11: PortPinId=43, PortPinSymbolicName=PORT_2_PIN_11
            PortPin_2: PortPinId=34, PortPinSymbolicName=PORT_2_PIN_2
            PortPin_3: PortPinId=35, PortPinSymbolicName=PORT_2_PIN_3
            PortPin_4: PortPinId=36, PortPinSymbolicName=PORT_2_PIN_4
            PortPin_5: PortPinId=37, PortPinSymbolicName=PORT_2_PIN_5
            PortPin_6: PortPinId=38, PortPinSymbolicName=PORT_2_PIN_6
            PortPin_7: PortPinId=39, PortPinSymbolicName=PORT_2_PIN_7
            PortPin_8: PortPinId=40, PortPinSymbolicName=PORT_2_PIN_8
            PortPin_9: PortPinId=41, PortPinSymbolicName=PORT_2_PIN_9
        PortContainer_20: PortNumber=20, PortNumberOfPortPins=13
          13 x PortPin, all with PortPinControllerSelect=DISABLE, PortPinDirection=PORT_PIN_IN, PortPinDirectionChangeable=0, PortPinEmergencyStop=0, PortPinEnableAnalogInputOnly=PORT_PIN_ANALOG_INPUT_DISABLE, PortPinInitialMode=GPIO, PortPinInputPadLevel=PORT_INPUT_LEVEL_CMOS_AUTOMOTIVE, PortPinInputPullResistor=PORT_PIN_IN_PULL_UP, PortPinLevelValue=PORT_PIN_LEVEL_LOW, PortPinMode=PORT_PIN_MODE_ALL, PortPinModeChangeable=0, PortPinOutputPadDriveStrength=PORT_PIN_DEFAULT_DRIVER, PortPinOutputPinDriveMode=PORT_PIN_OUT_PUSHPULL:
            PortPin_0: PortPinId=320, PortPinSymbolicName=PORT_20_PIN_0
            PortPin_1: PortPinId=321, PortPinSymbolicName=PORT_20_PIN_1
            PortPin_10: PortPinId=332, PortPinSymbolicName=PORT_20_PIN_12
            PortPin_11: PortPinId=333, PortPinSymbolicName=PORT_20_PIN_13
            PortPin_12: PortPinId=334, PortPinSymbolicName=PORT_20_PIN_14
            PortPin_2: PortPinId=322, PortPinSymbolicName=PORT_20_PIN_2
            PortPin_3: PortPinId=323, PortPinSymbolicName=PORT_20_PIN_3
            PortPin_4: PortPinId=326, PortPinSymbolicName=PORT_20_PIN_6
            PortPin_5: PortPinId=327, PortPinSymbolicName=PORT_20_PIN_7
            PortPin_6: PortPinId=328, PortPinSymbolicName=PORT_20_PIN_8
            PortPin_7: PortPinId=329, PortPinSymbolicName=PORT_20_PIN_9
            PortPin_8: PortPinId=330, PortPinSymbolicName=PORT_20_PIN_10
            PortPin_9: PortPinId=331, PortPinSymbolicName=PORT_20_PIN_11
        PortContainer_21: PortNumber=21, PortNumberOfPortPins=8
          3 x PortLVDS, all with PortLVDSMode=LVDSH, PortLVDSPadSupply=V3_3, PortLVDSRxEnController=PORT_CONTROLLED, PortLVDSRxPathEnable=0, PortLVDSRxTerminationMode=INTERNAL_TERMINATION, PortLVDSTxEnController=PORT_CONTROLLED, PortLVDSTxPathEnable=0, PortLVDSTxPowerDownPullDown=DISABLE:
            PortLVDS_0: PortLVDSPinPair=Pin_0_Pin_1
            PortLVDS_1: PortLVDSPinPair=Pin_2_Pin_3
            PortLVDS_2: PortLVDSPinPair=Pin_4_Pin_5
          8 x PortPin, all with PortPinControllerSelect=DISABLE, PortPinDirection=PORT_PIN_IN, PortPinDirectionChangeable=0, PortPinEmergencyStop=0, PortPinEnableAnalogInputOnly=PORT_PIN_ANALOG_INPUT_DISABLE, PortPinInitialMode=GPIO, PortPinInputPadLevel=PORT_INPUT_LEVEL_CMOS_AUTOMOTIVE, PortPinInputPullResistor=PORT_PIN_IN_PULL_UP, PortPinLevelValue=PORT_PIN_LEVEL_LOW, PortPinMode=PORT_PIN_MODE_ALL, PortPinModeChangeable=0, PortPinOutputPadDriveStrength=PORT_PIN_DEFAULT_DRIVER, PortPinOutputPinDriveMode=PORT_PIN_OUT_PUSHPULL:
            PortPin_0: PortPinId=336, PortPinSymbolicName=PORT_21_PIN_0
            PortPin_1: PortPinId=337, PortPinSymbolicName=PORT_21_PIN_1
            PortPin_2: PortPinId=338, PortPinSymbolicName=PORT_21_PIN_2
            PortPin_3: PortPinId=339, PortPinSymbolicName=PORT_21_PIN_3
            PortPin_4: PortPinId=340, PortPinSymbolicName=PORT_21_PIN_4
            PortPin_5: PortPinId=341, PortPinSymbolicName=PORT_21_PIN_5
            PortPin_6: PortPinId=342, PortPinSymbolicName=PORT_21_PIN_6
            PortPin_7: PortPinId=343, PortPinSymbolicName=PORT_21_PIN_7
        PortContainer_22: PortNumber=22, PortNumberOfPortPins=12
          PortLVDS_0 (PortLVDS):
            PortLVDSMode = LVDSH
            PortLVDSPadSupply = V3_3
            PortLVDSPinPair = Pin_0_Pin_1
            PortLVDSRxEnController = PORT_CONTROLLED
            PortLVDSRxPathEnable = 0
            PortLVDSRxTerminationMode = INTERNAL_TERMINATION
            PortLVDSTxEnController = PORT_CONTROLLED
            PortLVDSTxPathEnable = 0
            PortLVDSTxPowerDownPullDown = DISABLE
          PortLVDS_1 (PortLVDS):
            PortLVDSMode = LVDSH
            PortLVDSPadSupply = V3_3
            PortLVDSPinPair = Pin_2_Pin_3
            PortLVDSRxEnController = PORT_CONTROLLED
            PortLVDSRxPathEnable = 0
            PortLVDSRxTerminationMode = INTERNAL_TERMINATION
            PortLVDSTxEnController = PORT_CONTROLLED
            PortLVDSTxPathEnable = 0
            PortLVDSTxPowerDownPullDown = DISABLE
          12 x PortPin, all with PortPinControllerSelect=DISABLE, PortPinDirection=PORT_PIN_IN, PortPinDirectionChangeable=0, PortPinEmergencyStop=0, PortPinEnableAnalogInputOnly=PORT_PIN_ANALOG_INPUT_DISABLE, PortPinInitialMode=GPIO, PortPinInputPadLevel=PORT_INPUT_LEVEL_CMOS_AUTOMOTIVE, PortPinInputPullResistor=PORT_PIN_IN_PULL_UP, PortPinLevelValue=PORT_PIN_LEVEL_LOW, PortPinMode=PORT_PIN_MODE_ALL, PortPinModeChangeable=0, PortPinOutputPadDriveStrength=PORT_PIN_DEFAULT_DRIVER, PortPinOutputPinDriveMode=PORT_PIN_OUT_PUSHPULL:
            PortPin_0: PortPinId=352, PortPinSymbolicName=PORT_22_PIN_0
            PortPin_1: PortPinId=353, PortPinSymbolicName=PORT_22_PIN_1
            PortPin_10: PortPinId=362, PortPinSymbolicName=PORT_22_PIN_10
            PortPin_11: PortPinId=363, PortPinSymbolicName=PORT_22_PIN_11
            PortPin_2: PortPinId=354, PortPinSymbolicName=PORT_22_PIN_2
            PortPin_3: PortPinId=355, PortPinSymbolicName=PORT_22_PIN_3
            PortPin_4: PortPinId=356, PortPinSymbolicName=PORT_22_PIN_4
            PortPin_5: PortPinId=357, PortPinSymbolicName=PORT_22_PIN_5
            PortPin_6: PortPinId=358, PortPinSymbolicName=PORT_22_PIN_6
            PortPin_7: PortPinId=359, PortPinSymbolicName=PORT_22_PIN_7
            PortPin_8: PortPinId=360, PortPinSymbolicName=PORT_22_PIN_8
            PortPin_9: PortPinId=361, PortPinSymbolicName=PORT_22_PIN_9
        PortContainer_23: PortNumber=23, PortNumberOfPortPins=8
          8 x PortPin, all with PortPinControllerSelect=DISABLE, PortPinDirection=PORT_PIN_IN, PortPinDirectionChangeable=0, PortPinEmergencyStop=0, PortPinEnableAnalogInputOnly=PORT_PIN_ANALOG_INPUT_DISABLE, PortPinInitialMode=GPIO, PortPinInputPadLevel=PORT_INPUT_LEVEL_CMOS_AUTOMOTIVE, PortPinInputPullResistor=PORT_PIN_IN_PULL_UP, PortPinLevelValue=PORT_PIN_LEVEL_LOW, PortPinMode=PORT_PIN_MODE_ALL, PortPinModeChangeable=0, PortPinOutputPadDriveStrength=PORT_PIN_DEFAULT_DRIVER, PortPinOutputPinDriveMode=PORT_PIN_OUT_PUSHPULL:
            PortPin_0: PortPinId=368, PortPinSymbolicName=PORT_23_PIN_0
            PortPin_1: PortPinId=369, PortPinSymbolicName=PORT_23_PIN_1
            PortPin_2: PortPinId=370, PortPinSymbolicName=PORT_23_PIN_2
            PortPin_3: PortPinId=371, PortPinSymbolicName=PORT_23_PIN_3
            PortPin_4: PortPinId=372, PortPinSymbolicName=PORT_23_PIN_4
            PortPin_5: PortPinId=373, PortPinSymbolicName=PORT_23_PIN_5
            PortPin_6: PortPinId=374, PortPinSymbolicName=PORT_23_PIN_6
            PortPin_7: PortPinId=375, PortPinSymbolicName=PORT_23_PIN_7
        PortContainer_32: PortNumber=32, PortNumberOfPortPins=8
          8 x PortPin, all with PortPinControllerSelect=DISABLE, PortPinDirection=PORT_PIN_IN, PortPinDirectionChangeable=0, PortPinEmergencyStop=0, PortPinEnableAnalogInputOnly=PORT_PIN_ANALOG_INPUT_DISABLE, PortPinInitialMode=GPIO, PortPinInputPadLevel=PORT_INPUT_LEVEL_CMOS_AUTOMOTIVE, PortPinInputPullResistor=PORT_PIN_IN_PULL_UP, PortPinLevelValue=PORT_PIN_LEVEL_LOW, PortPinMode=PORT_PIN_MODE_ALL, PortPinModeChangeable=0, PortPinOutputPadDriveStrength=PORT_PIN_DEFAULT_DRIVER, PortPinOutputPinDriveMode=PORT_PIN_OUT_PUSHPULL:
            PortPin_0: PortPinId=512, PortPinSymbolicName=PORT_32_PIN_0
            PortPin_1: PortPinId=513, PortPinSymbolicName=PORT_32_PIN_1
            PortPin_2: PortPinId=514, PortPinSymbolicName=PORT_32_PIN_2
            PortPin_3: PortPinId=515, PortPinSymbolicName=PORT_32_PIN_3
            PortPin_4: PortPinId=516, PortPinSymbolicName=PORT_32_PIN_4
            PortPin_5: PortPinId=517, PortPinSymbolicName=PORT_32_PIN_5
            PortPin_6: PortPinId=518, PortPinSymbolicName=PORT_32_PIN_6
            PortPin_7: PortPinId=519, PortPinSymbolicName=PORT_32_PIN_7
        PortContainer_33: PortNumber=33, PortNumberOfPortPins=16
          16 x PortPin, all with PortPinControllerSelect=DISABLE, PortPinDirectionChangeable=0, PortPinEmergencyStop=0, PortPinEnableAnalogInputOnly=PORT_PIN_ANALOG_INPUT_DISABLE, PortPinInitialMode=GPIO, PortPinInputPadLevel=PORT_INPUT_LEVEL_CMOS_AUTOMOTIVE, PortPinInputPullResistor=PORT_PIN_IN_PULL_UP, PortPinMode=PORT_PIN_MODE_ALL, PortPinModeChangeable=0, PortPinOutputPadDriveStrength=PORT_PIN_DEFAULT_DRIVER, PortPinOutputPinDriveMode=PORT_PIN_OUT_PUSHPULL:
            PortPin_0: PortPinDirection=PORT_PIN_IN, PortPinId=528, PortPinLevelValue=PORT_PIN_LEVEL_LOW, PortPinSymbolicName=PORT_33_PIN_0
            PortPin_1: PortPinDirection=PORT_PIN_OUT, PortPinId=529, PortPinLevelValue=PORT_PIN_LEVEL_HIGH, PortPinSymbolicName=PORT_33_PIN_1
            PortPin_10: PortPinDirection=PORT_PIN_IN, PortPinId=538, PortPinLevelValue=PORT_PIN_LEVEL_LOW, PortPinSymbolicName=PORT_33_PIN_10
            PortPin_11: PortPinDirection=PORT_PIN_IN, PortPinId=539, PortPinLevelValue=PORT_PIN_LEVEL_LOW, PortPinSymbolicName=PORT_33_PIN_11
            PortPin_12: PortPinDirection=PORT_PIN_IN, PortPinId=540, PortPinLevelValue=PORT_PIN_LEVEL_LOW, PortPinSymbolicName=PORT_33_PIN_12
            PortPin_13: PortPinDirection=PORT_PIN_IN, PortPinId=541, PortPinLevelValue=PORT_PIN_LEVEL_LOW, PortPinSymbolicName=PORT_33_PIN_13
            PortPin_14: PortPinDirection=PORT_PIN_IN, PortPinId=542, PortPinLevelValue=PORT_PIN_LEVEL_LOW, PortPinSymbolicName=PORT_33_PIN_14
            PortPin_15: PortPinDirection=PORT_PIN_IN, PortPinId=543, PortPinLevelValue=PORT_PIN_LEVEL_LOW, PortPinSymbolicName=PORT_33_PIN_15
            PortPin_2: PortPinDirection=PORT_PIN_OUT, PortPinId=530, PortPinLevelValue=PORT_PIN_LEVEL_HIGH, PortPinSymbolicName=PORT_33_PIN_2
            PortPin_3: PortPinDirection=PORT_PIN_OUT, PortPinId=531, PortPinLevelValue=PORT_PIN_LEVEL_HIGH, PortPinSymbolicName=PORT_33_PIN_3
            PortPin_4: PortPinDirection=PORT_PIN_OUT, PortPinId=532, PortPinLevelValue=PORT_PIN_LEVEL_HIGH, PortPinSymbolicName=PORT_33_PIN_4
            PortPin_5: PortPinDirection=PORT_PIN_IN, PortPinId=533, PortPinLevelValue=PORT_PIN_LEVEL_LOW, PortPinSymbolicName=PORT_33_PIN_5
            PortPin_6: PortPinDirection=PORT_PIN_IN, PortPinId=534, PortPinLevelValue=PORT_PIN_LEVEL_LOW, PortPinSymbolicName=PORT_33_PIN_6
            PortPin_7: PortPinDirection=PORT_PIN_IN, PortPinId=535, PortPinLevelValue=PORT_PIN_LEVEL_LOW, PortPinSymbolicName=PORT_33_PIN_7
            PortPin_8: PortPinDirection=PORT_PIN_IN, PortPinId=536, PortPinLevelValue=PORT_PIN_LEVEL_LOW, PortPinSymbolicName=PORT_33_PIN_8
            PortPin_9: PortPinDirection=PORT_PIN_IN, PortPinId=537, PortPinLevelValue=PORT_PIN_LEVEL_LOW, PortPinSymbolicName=PORT_33_PIN_9
        PortContainer_34: PortNumber=34, PortNumberOfPortPins=5
          5 x PortPin, all with PortPinControllerSelect=DISABLE, PortPinDirection=PORT_PIN_IN, PortPinDirectionChangeable=0, PortPinEmergencyStop=0, PortPinEnableAnalogInputOnly=PORT_PIN_ANALOG_INPUT_DISABLE, PortPinInitialMode=GPIO, PortPinInputPadLevel=PORT_INPUT_LEVEL_CMOS_AUTOMOTIVE, PortPinInputPullResistor=PORT_PIN_IN_PULL_UP, PortPinLevelValue=PORT_PIN_LEVEL_LOW, PortPinMode=PORT_PIN_MODE_ALL, PortPinModeChangeable=0, PortPinOutputPadDriveStrength=PORT_PIN_DEFAULT_DRIVER, PortPinOutputPinDriveMode=PORT_PIN_OUT_PUSHPULL:
            PortPin_0: PortPinId=545, PortPinSymbolicName=PORT_34_PIN_1
            PortPin_1: PortPinId=546, PortPinSymbolicName=PORT_34_PIN_2
            PortPin_2: PortPinId=547, PortPinSymbolicName=PORT_34_PIN_3
            PortPin_3: PortPinId=548, PortPinSymbolicName=PORT_34_PIN_4
            PortPin_4: PortPinId=549, PortPinSymbolicName=PORT_34_PIN_5
        PortContainer_40: PortNumber=40, PortNumberOfPortPins=15
          15 x PortPin, all with PortPinControllerSelect=DISABLE, PortPinDirection=PORT_PIN_IN, PortPinDirectionChangeable=0, PortPinEmergencyStop=0, PortPinEnableAnalogInputOnly=PORT_PIN_ANALOG_INPUT_DISABLE, PortPinInitialMode=GPIO, PortPinInputPadLevel=PORT_INPUT_LEVEL_CMOS_AUTOMOTIVE, PortPinInputPullResistor=PORT_PIN_IN_PULL_UP, PortPinLevelValue=PORT_PIN_LEVEL_LOW, PortPinMode=PORT_PIN_MODE_ALL, PortPinModeChangeable=0, PortPinOutputPadDriveStrength=PORT_PIN_DEFAULT_DRIVER, PortPinOutputPinDriveMode=PORT_PIN_OUT_PUSHPULL:
            PortPin_0: PortPinId=640, PortPinSymbolicName=PORT_40_PIN_0
            PortPin_1: PortPinId=641, PortPinSymbolicName=PORT_40_PIN_1
            PortPin_10: PortPinId=650, PortPinSymbolicName=PORT_40_PIN_10
            PortPin_11: PortPinId=651, PortPinSymbolicName=PORT_40_PIN_11
            PortPin_12: PortPinId=652, PortPinSymbolicName=PORT_40_PIN_12
            PortPin_13: PortPinId=653, PortPinSymbolicName=PORT_40_PIN_13
            PortPin_14: PortPinId=654, PortPinSymbolicName=PORT_40_PIN_14
            PortPin_2: PortPinId=642, PortPinSymbolicName=PORT_40_PIN_2
            PortPin_3: PortPinId=643, PortPinSymbolicName=PORT_40_PIN_3
            PortPin_4: PortPinId=644, PortPinSymbolicName=PORT_40_PIN_4
            PortPin_5: PortPinId=645, PortPinSymbolicName=PORT_40_PIN_5
            PortPin_6: PortPinId=646, PortPinSymbolicName=PORT_40_PIN_6
            PortPin_7: PortPinId=647, PortPinSymbolicName=PORT_40_PIN_7
            PortPin_8: PortPinId=648, PortPinSymbolicName=PORT_40_PIN_8
            PortPin_9: PortPinId=649, PortPinSymbolicName=PORT_40_PIN_9
    PortGeneral:
      PortDevErrorDetect = 0
      PortInitApiMode = PORT_MCAL_SUPERVISOR
      PortInitCheckApi = 0
      PortSafetyEnable = 0
      PortSetPinDirectionApi = 0
      PortSetPinModeApi = 0
      PortVersionInfoApi = 0
package /Crc
  module config Crc
package /Uart
  module config Uart: implementation-config-variant=VARIANT-POST-BUILD
    CommonPublishedInformation:
      ArMajorVersion = 4
      ArMinorVersion = 4
      ArPatchVersion = 0
      ModuleId = 255
      Release = _TRICORE_TC397
      SwMajorVersion = 20
      SwMinorVersion = 25
      SwPatchVersion = 0
      VendorId = 17
    UartConfigSet
      UartChannel_0 (UartChannel):
        UartAutoCalcBaudParams = 1
        UartBaudRate = 115200
        UartCTSEnable = 0
        UartCTSPinSelection = SELECT_CTS_A_PORT14_PIN9
        UartCTSPolarity = HIGH
        UartChanBaudDenominator = 2500
        UartChanBaudNumerator = 2304
        UartChanBaudOverSampling = 15
        UartChanBaudPrescalar = 9
        UartChannelId = 0
        UartDataLength = 8
        UartHwUnit = ASCLIN0
        UartParityBit = NOPARITY
        UartRxChannelMode = POLLING
        UartRxPinSelection = SELECT_A_PORT14_PIN1
        UartStopBits = 1
        UartTxChannelMode = INTERRUPT
        UartNotification:
          UartAbortReceiveNotifPtr = NULL_PTR
          UartAbortTransmitNotifPtr = NULL_PTR
          UartReceiveNotifPtr = NULL_PTR
          UartStreamingRecvNotifPtr = Streamimg_Notification00
          UartTransmitNotifPtr = NULL_PTR
      UartChannel_1 (UartChannel):
        UartAutoCalcBaudParams = 1
        UartBaudRate = 115200
        UartCTSEnable = 1
        UartCTSPinSelection = SELECT_CTS_A_PORT00_PIN12
        UartCTSPolarity = HIGH
        UartChanBaudDenominator = 1000
        UartChanBaudNumerator = 24
        UartChanBaudOverSampling = 9
        UartChanBaudPrescalar = 4
        UartChannelId = 1
        UartDataLength = 8
        UartHwUnit = ASCLIN3
        UartParityBit = NOPARITY
        UartRxChannelMode = INTERRUPT
        UartRxPinSelection = SELECT_A_PORT15_PIN7
        UartStopBits = 1
        UartTxChannelMode = INTERRUPT
        UartNotification:
          UartAbortReceiveNotifPtr = NULL_PTR
          UartAbortTransmitNotifPtr = NULL_PTR
          UartReceiveNotifPtr = NULL_PTR
          UartStreamingRecvNotifPtr = NULL_PTR
          UartTransmitNotifPtr = NULL_PTR
    UartGeneral:
      UartAbortReadApi = 1
      UartAbortWriteApi = 1
      UartCsrClksel = ASCLINS
      UartDeInitApi = 1
      UartDevErrorDetect = 1
      UartIndex = 0
      UartInitCheckApi = 0
      UartInitDeInitApiMode = MCAL_SUPERVISOR
      UartMainFunctionReadPeriod = 0.001
      UartMainFunctionWritePeriod = 0.001
      UartRunTimeErrorDetect = 0
      UartSafetyEnable = 0
      UartSleepEnable = 0
      UartStreamingRecvModeApi = 1
      UartTimeoutCount = 4294967295
      UartVersionInfoApi = 1
      UartClockRef = McuClockReferencePointConfig
package /Irq
  module config Irq: implementation-config-variant=VARIANT-PRE-COMPILE
    CommonPublishedInformation:
      ArMajorVersion = 4
      ArMinorVersion = 4
      ArPatchVersion = 0
      ModuleId = 255
      Release = _TRICORE_TC397
      SwMajorVersion = 20
      SwMinorVersion = 0
      SwPatchVersion = 0
      VendorId = 17
    IrqASCLINConfig_0 (IrqASCLINConfig)
      IrqAsclinCatConfig
        IrqAsclinErrCatConfig:
          IrqAsclin0ErrCat = CAT1
          IrqAsclin{10..19}ErrCat = CAT1
          IrqAsclin1ErrCat = CAT1
          IrqAsclin{20..23}ErrCat = CAT1
          IrqAsclin{2..9}ErrCat = CAT1
        IrqAsclinRxCatConfig:
          IrqAsclin0RxCat = CAT1
          IrqAsclin{10..19}RxCat = CAT1
          IrqAsclin1RxCat = CAT1
          IrqAsclin{20..23}RxCat = CAT1
          IrqAsclin{2..9}RxCat = CAT1
        IrqAsclinTxCatConfig:
          IrqAsclin0TxCat = CAT1
          IrqAsclin{10..19}TxCat = CAT1
          IrqAsclin1TxCat = CAT1
          IrqAsclin{20..23}TxCat = CAT1
          IrqAsclin{2..9}TxCat = CAT1
      IrqAsclinPrioConfig
        IrqAsclinErrPrioConfig:
          IrqAsclin0ErrPrio = 0
          IrqAsclin{10..19}ErrPrio = 0
          IrqAsclin1ErrPrio = 0
          IrqAsclin{20..23}ErrPrio = 0
          IrqAsclin{2..9}ErrPrio = 0
        IrqAsclinRxPrioConfig:
          IrqAsclin0RxPrio = 0
          IrqAsclin{10..19}RxPrio = 0
          IrqAsclin1RxPrio = 0
          IrqAsclin{20..23}RxPrio = 0
          IrqAsclin{2..9}RxPrio = 0
        IrqAsclinTxPrioConfig:
          IrqAsclin0TxPrio = 0
          IrqAsclin{10..19}TxPrio = 0
          IrqAsclin1TxPrio = 0
          IrqAsclin{20..23}TxPrio = 0
          IrqAsclin{2..9}TxPrio = 0
      IrqAsclinTosConfig
        IrqAsclinErrTosConfig:
          IrqAsclin0ErrTos = CPU0
          IrqAsclin{10..19}ErrTos = CPU0
          IrqAsclin1ErrTos = CPU0
          IrqAsclin{20..23}ErrTos = CPU0
          IrqAsclin{2..9}ErrTos = CPU0
        IrqAsclinRxTosConfig:
          IrqAsclin0RxTos = CPU0
          IrqAsclin{10..19}RxTos = CPU0
          IrqAsclin1RxTos = CPU0
          IrqAsclin{20..23}RxTos = CPU0
          IrqAsclin{2..9}RxTos = CPU0
        IrqAsclinTxTosConfig:
          IrqAsclin0TxTos = CPU0
          IrqAsclin{10..19}TxTos = CPU0
          IrqAsclin1TxTos = CPU0
          IrqAsclin{20..23}TxTos = CPU0
          IrqAsclin{2..9}TxTos = CPU0
    IrqAdcConfig_0 (IrqAdcConfig)
      IrqAdc0Config
        IrqAdc0CatConfig: IrqAdc0SR0Cat=CAT1, IrqAdc0SR1Cat=CAT1, IrqAdc0SR2Cat=CAT1, IrqAdc0SR3Cat=CAT1
        IrqAdc0PrioConfig: IrqAdc0SR0Prio=0, IrqAdc0SR1Prio=0, IrqAdc0SR2Prio=0, IrqAdc0SR3Prio=0
        IrqAdc0TosConfig: IrqAdc0SR0Tos=CPU0, IrqAdc0SR1Tos=CPU0, IrqAdc0SR2Tos=CPU0, IrqAdc0SR3Tos=CPU0
      IrqAdc10Config
        IrqAdc10CatConfig: IrqAdc10SR0Cat=CAT1, IrqAdc10SR1Cat=CAT1, IrqAdc10SR2Cat=CAT1, IrqAdc10SR3Cat=CAT1
        IrqAdc10PrioConfig: IrqAdc10SR0Prio=0, IrqAdc10SR1Prio=0, IrqAdc10SR2Prio=0, IrqAdc10SR3Prio=0
        IrqAdc10TosConfig: IrqAdc10SR0Tos=CPU0, IrqAdc10SR1Tos=CPU0, IrqAdc10SR2Tos=CPU0, IrqAdc10SR3Tos=CPU0
      IrqAdc11Config
        IrqAdc11CatConfig: IrqAdc11SR0Cat=CAT1, IrqAdc11SR1Cat=CAT1, IrqAdc11SR2Cat=CAT1, IrqAdc11SR3Cat=CAT1
        IrqAdc11PrioConfig: IrqAdc11SR0Prio=0, IrqAdc11SR1Prio=0, IrqAdc11SR2Prio=0, IrqAdc11SR3Prio=0
        IrqAdc11TosConfig: IrqAdc11SR0Tos=CPU0, IrqAdc11SR1Tos=CPU0, IrqAdc11SR2Tos=CPU0, IrqAdc11SR3Tos=CPU0
      IrqAdc1Config
        IrqAdc1CatConfig: IrqAdc1SR0Cat=CAT1, IrqAdc1SR1Cat=CAT1, IrqAdc1SR2Cat=CAT1, IrqAdc1SR3Cat=CAT1
        IrqAdc1PrioConfig: IrqAdc1SR0Prio=0, IrqAdc1SR1Prio=0, IrqAdc1SR2Prio=0, IrqAdc1SR3Prio=0
        IrqAdc1TosConfig: IrqAdc1SR0Tos=CPU0, IrqAdc1SR1Tos=CPU0, IrqAdc1SR2Tos=CPU0, IrqAdc1SR3Tos=CPU0
      IrqAdc2Config
        IrqAdc2CatConfig: IrqAdc2SR0Cat=CAT1, IrqAdc2SR1Cat=CAT1, IrqAdc2SR2Cat=CAT1, IrqAdc2SR3Cat=CAT1
        IrqAdc2PrioConfig: IrqAdc2SR0Prio=0, IrqAdc2SR1Prio=0, IrqAdc2SR2Prio=0, IrqAdc2SR3Prio=0
        IrqAdc2TosConfig: IrqAdc2SR0Tos=CPU0, IrqAdc2SR1Tos=CPU0, IrqAdc2SR2Tos=CPU0, IrqAdc2SR3Tos=CPU0
      IrqAdc3Config
        IrqAdc3CatConfig: IrqAdc3SR0Cat=CAT1, IrqAdc3SR1Cat=CAT1, IrqAdc3SR2Cat=CAT1, IrqAdc3SR3Cat=CAT1
        IrqAdc3PrioConfig: IrqAdc3SR0Prio=0, IrqAdc3SR1Prio=0, IrqAdc3SR2Prio=0, IrqAdc3SR3Prio=0
        IrqAdc3TosConfig: IrqAdc3SR0Tos=CPU0, IrqAdc3SR1Tos=CPU0, IrqAdc3SR2Tos=CPU0, IrqAdc3SR3Tos=CPU0
      IrqAdc4Config
        IrqAdc4CatConfig: IrqAdc4SR0Cat=CAT1, IrqAdc4SR1Cat=CAT1, IrqAdc4SR2Cat=CAT1, IrqAdc4SR3Cat=CAT1
        IrqAdc4PrioConfig: IrqAdc4SR0Prio=0, IrqAdc4SR1Prio=0, IrqAdc4SR2Prio=0, IrqAdc4SR3Prio=0
        IrqAdc4TosConfig: IrqAdc4SR0Tos=CPU0, IrqAdc4SR1Tos=CPU0, IrqAdc4SR2Tos=CPU0, IrqAdc4SR3Tos=CPU0
      IrqAdc5Config
        IrqAdc5CatConfig: IrqAdc5SR0Cat=CAT1, IrqAdc5SR1Cat=CAT1, IrqAdc5SR2Cat=CAT1, IrqAdc5SR3Cat=CAT1
        IrqAdc5PrioConfig: IrqAdc5SR0Prio=0, IrqAdc5SR1Prio=0, IrqAdc5SR2Prio=0, IrqAdc5SR3Prio=0
        IrqAdc5TosConfig: IrqAdc5SR0Tos=CPU0, IrqAdc5SR1Tos=CPU0, IrqAdc5SR2Tos=CPU0, IrqAdc5SR3Tos=CPU0
      IrqAdc6Config
        IrqAdc6CatConfig: IrqAdc6SR0Cat=CAT1, IrqAdc6SR1Cat=CAT1, IrqAdc6SR2Cat=CAT1, IrqAdc6SR3Cat=CAT1
        IrqAdc6PrioConfig: IrqAdc6SR0Prio=0, IrqAdc6SR1Prio=0, IrqAdc6SR2Prio=0, IrqAdc6SR3Prio=0
        IrqAdc6TosConfig: IrqAdc6SR0Tos=CPU0, IrqAdc6SR1Tos=CPU0, IrqAdc6SR2Tos=CPU0, IrqAdc6SR3Tos=CPU0
      IrqAdc7Config
        IrqAdc7CatConfig: IrqAdc7SR0Cat=CAT1, IrqAdc7SR1Cat=CAT1, IrqAdc7SR2Cat=CAT1, IrqAdc7SR3Cat=CAT1
        IrqAdc7PrioConfig: IrqAdc7SR0Prio=0, IrqAdc7SR1Prio=0, IrqAdc7SR2Prio=0, IrqAdc7SR3Prio=0
        IrqAdc7TosConfig: IrqAdc7SR0Tos=CPU0, IrqAdc7SR1Tos=CPU0, IrqAdc7SR2Tos=CPU0, IrqAdc7SR3Tos=CPU0
      IrqAdc8Config
        IrqAdc8CatConfig: IrqAdc8SR0Cat=CAT1, IrqAdc8SR1Cat=CAT1, IrqAdc8SR2Cat=CAT1, IrqAdc8SR3Cat=CAT1
        IrqAdc8PrioConfig: IrqAdc8SR0Prio=0, IrqAdc8SR1Prio=0, IrqAdc8SR2Prio=0, IrqAdc8SR3Prio=0
        IrqAdc8TosConfig: IrqAdc8SR0Tos=CPU0, IrqAdc8SR1Tos=CPU0, IrqAdc8SR2Tos=CPU0, IrqAdc8SR3Tos=CPU0
      IrqAdc9Config
        IrqAdc9CatConfig: IrqAdc9SR0Cat=CAT1, IrqAdc9SR1Cat=CAT1, IrqAdc9SR2Cat=CAT1, IrqAdc9SR3Cat=CAT1
        IrqAdc9PrioConfig: IrqAdc9SR0Prio=0, IrqAdc9SR1Prio=0, IrqAdc9SR2Prio=0, IrqAdc9SR3Prio=0
        IrqAdc9TosConfig: IrqAdc9SR0Tos=CPU0, IrqAdc9SR1Tos=CPU0, IrqAdc9SR2Tos=CPU0, IrqAdc9SR3Tos=CPU0
      IrqAdcCG0Config
        IrqAdcCG0CatConfig: IrqAdcCG0SR0Cat=CAT1, IrqAdcCG0SR1Cat=CAT1, IrqAdcCG0SR2Cat=CAT1, IrqAdcCG0SR3Cat=CAT1
        IrqAdcCG0PrioConfig: IrqAdcCG0SR0Prio=0, IrqAdcCG0SR1Prio=0, IrqAdcCG0SR2Prio=0, IrqAdcCG0SR3Prio=0
        IrqAdcCG0TosConfig: IrqAdcCG0SR0Tos=CPU0, IrqAdcCG0SR1Tos=CPU0, IrqAdcCG0SR2Tos=CPU0, IrqAdcCG0SR3Tos=CPU0
      IrqAdcCG1Config
        IrqAdcCG1CatConfig: IrqAdcCG1SR0Cat=CAT1, IrqAdcCG1SR1Cat=CAT1, IrqAdcCG1SR2Cat=CAT1, IrqAdcCG1SR3Cat=CAT1
        IrqAdcCG1PrioConfig: IrqAdcCG1SR0Prio=0, IrqAdcCG1SR1Prio=0, IrqAdcCG1SR2Prio=0, IrqAdcCG1SR3Prio=0
        IrqAdcCG1TosConfig: IrqAdcCG1SR0Tos=CPU0, IrqAdcCG1SR1Tos=CPU0, IrqAdcCG1SR2Tos=CPU0, IrqAdcCG1SR3Tos=CPU0
    IrqCCU6Config_0 (IrqCCU6Config)
      Irq_CCU60_Config
        Irq_CCU60Cat_Config: Irq_CCU60SR0_Cat=CAT1, Irq_CCU60SR1_Cat=CAT1, Irq_CCU60SR2_Cat=CAT1, Irq_CCU60SR3_Cat=CAT1
        Irq_CCU60Prio_Config: Irq_CCU60SR0_Prio=0, Irq_CCU60SR1_Prio=0, Irq_CCU60SR2_Prio=0, Irq_CCU60SR3_Prio=0
        Irq_CCU60Tos_Config: Irq_CCU60SR0_Tos=CPU0, Irq_CCU60SR1_Tos=CPU0, Irq_CCU60SR2_Tos=CPU0, Irq_CCU60SR3_Tos=CPU0
      Irq_CCU61_Config
        Irq_CCU61Cat_Config: Irq_CCU61SR0_Cat=CAT1, Irq_CCU61SR1_Cat=CAT1, Irq_CCU61SR2_Cat=CAT1, Irq_CCU61SR3_Cat=CAT1
        Irq_CCU61Prio_Config: Irq_CCU61SR0_Prio=0, Irq_CCU61SR1_Prio=0, Irq_CCU61SR2_Prio=0, Irq_CCU61SR3_Prio=0
        Irq_CCU61Tos_Config: Irq_CCU61SR0_Tos=CPU0, Irq_CCU61SR1_Tos=CPU0, Irq_CCU61SR2_Tos=CPU0, Irq_CCU61SR3_Tos=CPU0
    IrqCanConfig_0 (IrqCanConfig)
      IrqCan0Config
        IrqCanCatConfig:
          IrqCanSR0Cat = CAT1
          IrqCanSR{10..15}Cat = CAT1
          IrqCanSR{1..9}Cat = CAT1
        IrqCanPrioConfig:
          IrqCanSR0Prio = 0
          IrqCanSR{10..15}Prio = 0
          IrqCanSR{1..9}Prio = 0
        IrqCanTosConfig:
          IrqCanSR0Tos = CPU0
          IrqCanSR{10..15}Tos = CPU0
          IrqCanSR{1..9}Tos = CPU0
      IrqCan1Config
        IrqCanCatConfig:
          IrqCanSR0Cat = CAT1
          IrqCanSR{10..15}Cat = CAT1
          IrqCanSR{1..9}Cat = CAT1
        IrqCanPrioConfig:
          IrqCanSR0Prio = 0
          IrqCanSR{10..15}Prio = 0
          IrqCanSR{1..9}Prio = 0
        IrqCanTosConfig:
          IrqCanSR0Tos = CPU0
          IrqCanSR{10..15}Tos = CPU0
          IrqCanSR{1..9}Tos = CPU0
      IrqCan2Config
        IrqCanCatConfig:
          IrqCanSR0Cat = CAT1
          IrqCanSR{10..15}Cat = CAT1
          IrqCanSR{1..9}Cat = CAT1
        IrqCanPrioConfig:
          IrqCanSR0Prio = 0
          IrqCanSR{10..15}Prio = 0
          IrqCanSR{1..9}Prio = 0
        IrqCanTosConfig:
          IrqCanSR0Tos = CPU0
          IrqCanSR{10..15}Tos = CPU0
          IrqCanSR{1..9}Tos = CPU0
      IrqCan3Config
        IrqCanCatConfig:
          IrqCanSR0Cat = CAT1
          IrqCanSR{10..15}Cat = CAT1
          IrqCanSR{1..9}Cat = CAT1
        IrqCanPrioConfig:
          IrqCanSR0Prio = 0
          IrqCanSR{10..15}Prio = 0
          IrqCanSR{1..9}Prio = 0
        IrqCanTosConfig:
          IrqCanSR0Tos = CPU0
          IrqCanSR{10..15}Tos = CPU0
          IrqCanSR{1..9}Tos = CPU0
      IrqCan4Config
        IrqCanCatConfig:
          IrqCanSR0Cat = CAT1
          IrqCanSR{10..15}Cat = CAT1
          IrqCanSR{1..9}Cat = CAT1
        IrqCanPrioConfig:
          IrqCanSR0Prio = 0
          IrqCanSR{10..15}Prio = 0
          IrqCanSR{1..9}Prio = 0
        IrqCanTosConfig:
          IrqCanSR0Tos = CPU0
          IrqCanSR{10..15}Tos = CPU0
          IrqCanSR{1..9}Tos = CPU0
    IrqDMUConfig_0 (IrqDMUConfig)
      IrqDMUCatConfig: IrqDMUFSICat=CAT1, IrqDMUHOSTCat=CAT1
      IrqDMUPrioConfig: IrqDMUFSIPrio=0, IrqDMUHOSTPrio=0
      IrqDMUTosConfig: IrqDMUFSITos=CPU0, IrqDMUHOSTTos=CPU0
    IrqDmaConfig_0 (IrqDmaConfig)
      IrqDmaCatConfig:
        IrqDmaCh0SRCat = CAT1
        IrqDmaCh{100..109}SRCat = CAT1
        IrqDmaCh10SRCat = CAT1
        IrqDmaCh{110..119}SRCat = CAT1
        IrqDmaCh11SRCat = CAT1
        IrqDmaCh{120..127}SRCat = CAT1
        IrqDmaCh{12..19}SRCat = CAT1
        IrqDmaCh1SRCat = CAT1
        IrqDmaCh{20..29}SRCat = CAT1
        IrqDmaCh2SRCat = CAT1
        IrqDmaCh{30..39}SRCat = CAT1
        IrqDmaCh3SRCat = CAT1
        IrqDmaCh{40..49}SRCat = CAT1
        IrqDmaCh4SRCat = CAT1
        IrqDmaCh{50..59}SRCat = CAT1
        IrqDmaCh5SRCat = CAT1
        IrqDmaCh{60..69}SRCat = CAT1
        IrqDmaCh6SRCat = CAT1
        IrqDmaCh{70..79}SRCat = CAT1
        IrqDmaCh7SRCat = CAT1
        IrqDmaCh{80..89}SRCat = CAT1
        IrqDmaCh8SRCat = CAT1
        IrqDmaCh{90..99}SRCat = CAT1
        IrqDmaCh9SRCat = CAT1
        IrqDmaErr{0..3}SRCat = CAT1
      IrqDmaPrioConfig:
        IrqDmaCh0SRPrio = 0
        IrqDmaCh{100..109}SRPrio = 0
        IrqDmaCh10SRPrio = 0
        IrqDmaCh{110..119}SRPrio = 0
        IrqDmaCh11SRPrio = 0
        IrqDmaCh{120..127}SRPrio = 0
        IrqDmaCh{12..19}SRPrio = 0
        IrqDmaCh1SRPrio = 0
        IrqDmaCh{20..29}SRPrio = 0
        IrqDmaCh2SRPrio = 0
        IrqDmaCh{30..39}SRPrio = 0
        IrqDmaCh3SRPrio = 0
        IrqDmaCh{40..49}SRPrio = 0
        IrqDmaCh4SRPrio = 0
        IrqDmaCh{50..59}SRPrio = 0
        IrqDmaCh5SRPrio = 0
        IrqDmaCh{60..69}SRPrio = 0
        IrqDmaCh6SRPrio = 0
        IrqDmaCh{70..79}SRPrio = 0
        IrqDmaCh7SRPrio = 0
        IrqDmaCh{80..89}SRPrio = 0
        IrqDmaCh8SRPrio = 0
        IrqDmaCh{90..99}SRPrio = 0
        IrqDmaCh9SRPrio = 0
        IrqDmaErr{0..3}SRPrio = 0
      IrqDmaTosConfig:
        IrqDmaCh0SRTos = CPU0
        IrqDmaCh{100..109}SRTos = CPU0
        IrqDmaCh10SRTos = CPU0
        IrqDmaCh{110..119}SRTos = CPU0
        IrqDmaCh11SRTos = CPU0
        IrqDmaCh{120..127}SRTos = CPU0
        IrqDmaCh{12..19}SRTos = CPU0
        IrqDmaCh1SRTos = CPU0
        IrqDmaCh{20..29}SRTos = CPU0
        IrqDmaCh2SRTos = CPU0
        IrqDmaCh{30..39}SRTos = CPU0
        IrqDmaCh3SRTos = CPU0
        IrqDmaCh{40..49}SRTos = CPU0
        IrqDmaCh4SRTos = CPU0
        IrqDmaCh{50..59}SRTos = CPU0
        IrqDmaCh5SRTos = CPU0
        IrqDmaCh{60..69}SRTos = CPU0
        IrqDmaCh6SRTos = CPU0
        IrqDmaCh{70..79}SRTos = CPU0
        IrqDmaCh7SRTos = CPU0
        IrqDmaCh{80..89}SRTos = CPU0
        IrqDmaCh8SRTos = CPU0
        IrqDmaCh{90..99}SRTos = CPU0
        IrqDmaCh9SRTos = CPU0
        IrqDmaErr{0..3}SRTos = CPU0
    IrqDsadcConfig_0 (IrqDsadcConfig)
      IrqDsadcCatConfig
        IrqDsadcSRACatConfig:
          IrqDSAdcSRA0Cat = CAT1
          IrqDSAdcSRA{10..13}Cat = CAT1
          IrqDSAdcSRA{1..9}Cat = CAT1
        IrqDsadcSRMCatConfig:
          IrqDSAdcSRM0Cat = CAT1
          IrqDSAdcSRM{10..13}Cat = CAT1
          IrqDSAdcSRM{1..9}Cat = CAT1
      IrqDsadcPrioConfig
        IrqDsadcSRAPrioConfig:
          IrqDsadcSRA0Prio = 0
          IrqDsadcSRA{10..13}Prio = 0
          IrqDsadcSRA{1..9}Prio = 0
        IrqDsadcSRMPrioConfig:
          IrqDsadcSRM0Prio = 0
          IrqDsadcSRM{10..13}Prio = 0
          IrqDsadcSRM{1..9}Prio = 0
      IrqDsadcTosConfig
        IrqDsadcSRATosConfig:
          IrqDsadcSRA0Tos = CPU0
          IrqDsadcSRA{10..13}Tos = CPU0
          IrqDsadcSRA{1..9}Tos = CPU0
        IrqDsadcSRMTosConfig:
          IrqDsadcSRM0Tos = CPU0
          IrqDsadcSRM{10..13}Tos = CPU0
          IrqDsadcSRM{1..9}Tos = CPU0
    IrqETHConfig_0 (IrqETHConfig)
      IrqETHCatConfig:
        IrqETHSR0Cat = CAT1
        IrqETHSR1Cat = CAT1
        IrqETHSR2Cat = CAT2
        IrqETHSR{3..9}Cat = CAT1
      IrqETHPrioConfig:
        IrqETHSR0Prio = 0
        IrqETHSR1Prio = 0
        IrqETHSR2Prio = 50
        IrqETHSR{3..9}Prio = 0
      IrqETHTosConfig:
        IrqETHSR{0..9}Tos = CPU0
    IrqFlexRayConfig_0 (IrqFlexRayConfig)
      Irq_FlexRay0_Config
        Irq_FlexRay0Cat_Config:
          Irq_FlexRay0IBusy_Cat = CAT1
          Irq_FlexRay0INT0_Cat = CAT1
          Irq_FlexRay0INT1_Cat = CAT1
          Irq_FlexRay0MBSC0_Cat = CAT1
          Irq_FlexRay0MBSC1_Cat = CAT1
          Irq_FlexRay0NewData0_Cat = CAT1
          Irq_FlexRay0NewData1_Cat = CAT1
          Irq_FlexRay0OBusy_Cat = CAT1
          Irq_FlexRay0TimerInt0_Cat = CAT1
          Irq_FlexRay0TimerInt1_Cat = CAT1
        Irq_FlexRay0Prio_Config:
          Irq_FlexRay0IBusy_Prio = 0
          Irq_FlexRay0INT0_Prio = 0
          Irq_FlexRay0INT1_Prio = 0
          Irq_FlexRay0MBSC0_Prio = 0
          Irq_FlexRay0MBSC1_Prio = 0
          Irq_FlexRay0NewData0_Prio = 0
          Irq_FlexRay0NewData1_Prio = 0
          Irq_FlexRay0OBusy_Prio = 0
          Irq_FlexRay0TimerInt0_Prio = 0
          Irq_FlexRay0TimerInt1_Prio = 0
        Irq_FlexRay0Tos_Config:
          Irq_FlexRay0IBusy_Tos = CPU0
          Irq_FlexRay0INT0_Tos = CPU0
          Irq_FlexRay0INT1_Tos = CPU0
          Irq_FlexRay0MBSC0_Tos = CPU0
          Irq_FlexRay0MBSC1_Tos = CPU0
          Irq_FlexRay0NewData0_Tos = CPU0
          Irq_FlexRay0NewData1_Tos = CPU0
          Irq_FlexRay0OBusy_Tos = CPU0
          Irq_FlexRay0TimerInt0_Tos = CPU0
          Irq_FlexRay0TimerInt1_Tos = CPU0
      Irq_FlexRay1_Config
        Irq_FlexRay1Cat_Config:
          Irq_FlexRay1IBusy_Cat = CAT1
          Irq_FlexRay1INT0_Cat = CAT1
          Irq_FlexRay1INT1_Cat = CAT1
          Irq_FlexRay1MBSC0_Cat = CAT1
          Irq_FlexRay1MBSC1_Cat = CAT1
          Irq_FlexRay1NewData0_Cat = CAT1
          Irq_FlexRay1NewData1_Cat = CAT1
          Irq_FlexRay1OBusy_Cat = CAT1
          Irq_FlexRay1TimerInt0_Cat = CAT1
          Irq_FlexRay1TimerInt1_Cat = CAT1
        Irq_FlexRay1Prio_Config:
          Irq_FlexRay1IBusy_Prio = 0
          Irq_FlexRay1INT0_Prio = 0
          Irq_FlexRay1INT1_Prio = 0
          Irq_FlexRay1MBSC0_Prio = 0
          Irq_FlexRay1MBSC1_Prio = 0
          Irq_FlexRay1NewData0_Prio = 0
          Irq_FlexRay1NewData1_Prio = 0
          Irq_FlexRay1OBusy_Prio = 0
          Irq_FlexRay1TimerInt0_Prio = 0
          Irq_FlexRay1TimerInt1_Prio = 0
        Irq_FlexRay1Tos_Config:
          Irq_FlexRay1IBusy_Tos = CPU0
          Irq_FlexRay1INT0_Tos = CPU0
          Irq_FlexRay1INT1_Tos = CPU0
          Irq_FlexRay1MBSC0_Tos = CPU0
          Irq_FlexRay1MBSC1_Tos = CPU0
          Irq_FlexRay1NewData0_Tos = CPU0
          Irq_FlexRay1NewData1_Tos = CPU0
          Irq_FlexRay1OBusy_Tos = CPU0
          Irq_FlexRay1TimerInt0_Tos = CPU0
          Irq_FlexRay1TimerInt1_Tos = CPU0
    IrqGPSRGroupConfig_0 (IrqGPSRGroupConfig)
      Irq_GPSRGroup0_Config
        Irq_GPSRGroup0Cat_Config:
          Irq_GPSRGroup0SR{0..7}_Cat = CAT1
        Irq_GPSRGroup0Prio_Config:
          Irq_GPSRGroup0SR{0..7}_Prio = 0
        Irq_GPSRGroup0Tos_Config:
          Irq_GPSRGroup0SR{0..7}_Tos = CPU0
      Irq_GPSRGroup1_Config
        Irq_GPSRGroup1Cat_Config:
          Irq_GPSRGroup1SR{0..7}_Cat = CAT1
        Irq_GPSRGroup1Prio_Config:
          Irq_GPSRGroup1SR{0..7}_Prio = 0
        Irq_GPSRGroup1Tos_Config:
          Irq_GPSRGroup1SR{0..7}_Tos = CPU0
      Irq_GPSRGroup2_Config
        Irq_GPSRGroup2Cat_Config:
          Irq_GPSRGroup2SR{0..7}_Cat = CAT1
        Irq_GPSRGroup2Prio_Config:
          Irq_GPSRGroup2SR{0..7}_Prio = 0
        Irq_GPSRGroup2Tos_Config:
          Irq_GPSRGroup2SR{0..7}_Tos = CPU0
      Irq_GPSRGroup3_Config
        Irq_GPSRGroup3Cat_Config:
          Irq_GPSRGroup3SR{0..7}_Cat = CAT1
        Irq_GPSRGroup3Prio_Config:
          Irq_GPSRGroup3SR{0..7}_Prio = 0
        Irq_GPSRGroup3Tos_Config:
          Irq_GPSRGroup3SR{0..7}_Tos = CPU0
      Irq_GPSRGroup4_Config
        Irq_GPSRGroup4Cat_Config:
          Irq_GPSRGroup4SR{0..7}_Cat = CAT1
        Irq_GPSRGroup4Prio_Config:
          Irq_GPSRGroup4SR{0..7}_Prio = 0
        Irq_GPSRGroup4Tos_Config:
          Irq_GPSRGroup4SR{0..7}_Tos = CPU0
      Irq_GPSRGroup5_Config
        Irq_GPSRGroup5Cat_Config:
          Irq_GPSRGroup5SR{0..7}_Cat = CAT1
        Irq_GPSRGroup5Prio_Config:
          Irq_GPSRGroup5SR{0..7}_Prio = 0
        Irq_GPSRGroup5Tos_Config:
          Irq_GPSRGroup5SR{0..7}_Tos = CPU0
    IrqGPT120Config_0 (IrqGPT120Config)
      IrqGPT120CatConfig: Irq_GPT120CIRQ_Cat=CAT1, Irq_GPT120T2_Cat=CAT1, Irq_GPT120T3_Cat=CAT1, Irq_GPT120T4_Cat=CAT1, Irq_GPT120T5_Cat=CAT1, Irq_GPT120T6_Cat=CAT1
      IrqGPT120PrioConfig: Irq_GPT120CIRQ_Prio=0, Irq_GPT120T2_Prio=0, Irq_GPT120T3_Prio=0, Irq_GPT120T4_Prio=0, Irq_GPT120T5_Prio=0, Irq_GPT120T6_Prio=0
      IrqGPT120TosConfig: Irq_GPT120CIRQ_Tos=CPU0, Irq_GPT120T2_Tos=CPU0, Irq_GPT120T3_Tos=CPU0, Irq_GPT120T4_Tos=CPU0, Irq_GPT120T5_Tos=CPU0, Irq_GPT120T6_Tos=CPU0
    IrqGeneral: IrqOsekEnable=1
    IrqGtmConfig_0 (IrqGtmConfig)
      Irq_GtmAEI_Config
        Irq_GtmAEICat_Config: Irq_GtmAEI_Cat=CAT1
        Irq_GtmAEIPrio_Config: Irq_GtmAEI_Prio=0
        Irq_GtmAEITos_Config: Irq_GtmAEI_Tos=CPU0
      Irq_GtmARU_Config
        Irq_GtmARUCat_Config: Irq_GtmARUSR0_Cat=CAT1, Irq_GtmARUSR1_Cat=CAT1, Irq_GtmARUSR2_Cat=CAT1
        Irq_GtmARUPrio_Config: Irq_GtmARUSR0_Prio=0, Irq_GtmARUSR1_Prio=0, Irq_GtmARUSR2_Prio=0
        Irq_GtmARUTos_Config: Irq_GtmARUSR0_Tos=CPU0, Irq_GtmARUSR1_Tos=CPU0, Irq_GtmARUSR2_Tos=CPU0
      12 x Irq_GtmATOM_Config:
        Irq_GtmATOM0_Config
          IrqGtmATOMCatConfig: IrqGtmATOMSR0Cat=CAT1, IrqGtmATOMSR1Cat=CAT1, IrqGtmATOMSR2Cat=CAT1, IrqGtmATOMSR3Cat=CAT1
          IrqGtmATOMPrioConfig: IrqGtmATOMSR0Prio=0, IrqGtmATOMSR1Prio=0, IrqGtmATOMSR2Prio=0, IrqGtmATOMSR3Prio=0
          IrqGtmATOMTosConfig: IrqGtmATOMSR0Tos=CPU0, IrqGtmATOMSR1Tos=CPU0, IrqGtmATOMSR2Tos=CPU0, IrqGtmATOMSR3Tos=CPU0
        Irq_GtmATOM10_Config
          IrqGtmATOMCatConfig: IrqGtmATOMSR0Cat=CAT1, IrqGtmATOMSR1Cat=CAT1, IrqGtmATOMSR2Cat=CAT1, IrqGtmATOMSR3Cat=CAT1
          IrqGtmATOMPrioConfig: IrqGtmATOMSR0Prio=0, IrqGtmATOMSR1Prio=0, IrqGtmATOMSR2Prio=0, IrqGtmATOMSR3Prio=0
          IrqGtmATOMTosConfig: IrqGtmATOMSR0Tos=CPU0, IrqGtmATOMSR1Tos=CPU0, IrqGtmATOMSR2Tos=CPU0, IrqGtmATOMSR3Tos=CPU0
        Irq_GtmATOM11_Config
          IrqGtmATOMCatConfig: IrqGtmATOMSR0Cat=CAT1, IrqGtmATOMSR1Cat=CAT1, IrqGtmATOMSR2Cat=CAT1, IrqGtmATOMSR3Cat=CAT1
          IrqGtmATOMPrioConfig: IrqGtmATOMSR0Prio=0, IrqGtmATOMSR1Prio=0, IrqGtmATOMSR2Prio=0, IrqGtmATOMSR3Prio=0
          IrqGtmATOMTosConfig: IrqGtmATOMSR0Tos=CPU0, IrqGtmATOMSR1Tos=CPU0, IrqGtmATOMSR2Tos=CPU0, IrqGtmATOMSR3Tos=CPU0
        Irq_GtmATOM1_Config
          IrqGtmATOMCatConfig: IrqGtmATOMSR0Cat=CAT1, IrqGtmATOMSR1Cat=CAT1, IrqGtmATOMSR2Cat=CAT1, IrqGtmATOMSR3Cat=CAT1
          IrqGtmATOMPrioConfig: IrqGtmATOMSR0Prio=0, IrqGtmATOMSR1Prio=0, IrqGtmATOMSR2Prio=0, IrqGtmATOMSR3Prio=0
          IrqGtmATOMTosConfig: IrqGtmATOMSR0Tos=CPU0, IrqGtmATOMSR1Tos=CPU0, IrqGtmATOMSR2Tos=CPU0, IrqGtmATOMSR3Tos=CPU0
        Irq_GtmATOM2_Config
          IrqGtmATOMCatConfig: IrqGtmATOMSR0Cat=CAT1, IrqGtmATOMSR1Cat=CAT1, IrqGtmATOMSR2Cat=CAT1, IrqGtmATOMSR3Cat=CAT1
          IrqGtmATOMPrioConfig: IrqGtmATOMSR0Prio=0, IrqGtmATOMSR1Prio=0, IrqGtmATOMSR2Prio=0, IrqGtmATOMSR3Prio=0
          IrqGtmATOMTosConfig: IrqGtmATOMSR0Tos=CPU0, IrqGtmATOMSR1Tos=CPU0, IrqGtmATOMSR2Tos=CPU0, IrqGtmATOMSR3Tos=CPU0
        Irq_GtmATOM3_Config
          IrqGtmATOMCatConfig: IrqGtmATOMSR0Cat=CAT1, IrqGtmATOMSR1Cat=CAT1, IrqGtmATOMSR2Cat=CAT1, IrqGtmATOMSR3Cat=CAT1
          IrqGtmATOMPrioConfig: IrqGtmATOMSR0Prio=0, IrqGtmATOMSR1Prio=0, IrqGtmATOMSR2Prio=0, IrqGtmATOMSR3Prio=0
          IrqGtmATOMTosConfig: IrqGtmATOMSR0Tos=CPU0, IrqGtmATOMSR1Tos=CPU0, IrqGtmATOMSR2Tos=CPU0, IrqGtmATOMSR3Tos=CPU0
        Irq_GtmATOM4_Config
          IrqGtmATOMCatConfig: IrqGtmATOMSR0Cat=CAT1, IrqGtmATOMSR1Cat=CAT1, IrqGtmATOMSR2Cat=CAT1, IrqGtmATOMSR3Cat=CAT1
          IrqGtmATOMPrioConfig: IrqGtmATOMSR0Prio=0, IrqGtmATOMSR1Prio=0, IrqGtmATOMSR2Prio=0, IrqGtmATOMSR3Prio=0
          IrqGtmATOMTosConfig: IrqGtmATOMSR0Tos=CPU0, IrqGtmATOMSR1Tos=CPU0, IrqGtmATOMSR2Tos=CPU0, IrqGtmATOMSR3Tos=CPU0
        Irq_GtmATOM5_Config
          IrqGtmATOMCatConfig: IrqGtmATOMSR0Cat=CAT1, IrqGtmATOMSR1Cat=CAT1, IrqGtmATOMSR2Cat=CAT1, IrqGtmATOMSR3Cat=CAT1
          IrqGtmATOMPrioConfig: IrqGtmATOMSR0Prio=0, IrqGtmATOMSR1Prio=0, IrqGtmATOMSR2Prio=0, IrqGtmATOMSR3Prio=0
          IrqGtmATOMTosConfig: IrqGtmATOMSR0Tos=CPU0, IrqGtmATOMSR1Tos=CPU0, IrqGtmATOMSR2Tos=CPU0, IrqGtmATOMSR3Tos=CPU0
        Irq_GtmATOM6_Config
          IrqGtmATOMCatConfig: IrqGtmATOMSR0Cat=CAT1, IrqGtmATOMSR1Cat=CAT1, IrqGtmATOMSR2Cat=CAT1, IrqGtmATOMSR3Cat=CAT1
          IrqGtmATOMPrioConfig: IrqGtmATOMSR0Prio=0, IrqGtmATOMSR1Prio=0, IrqGtmATOMSR2Prio=0, IrqGtmATOMSR3Prio=0
          IrqGtmATOMTosConfig: IrqGtmATOMSR0Tos=CPU0, IrqGtmATOMSR1Tos=CPU0, IrqGtmATOMSR2Tos=CPU0, IrqGtmATOMSR3Tos=CPU0
        Irq_GtmATOM7_Config
          IrqGtmATOMCatConfig: IrqGtmATOMSR0Cat=CAT1, IrqGtmATOMSR1Cat=CAT1, IrqGtmATOMSR2Cat=CAT1, IrqGtmATOMSR3Cat=CAT1
          IrqGtmATOMPrioConfig: IrqGtmATOMSR0Prio=0, IrqGtmATOMSR1Prio=0, IrqGtmATOMSR2Prio=0, IrqGtmATOMSR3Prio=0
          IrqGtmATOMTosConfig: IrqGtmATOMSR0Tos=CPU0, IrqGtmATOMSR1Tos=CPU0, IrqGtmATOMSR2Tos=CPU0, IrqGtmATOMSR3Tos=CPU0
        Irq_GtmATOM8_Config
          IrqGtmATOMCatConfig: IrqGtmATOMSR0Cat=CAT1, IrqGtmATOMSR1Cat=CAT1, IrqGtmATOMSR2Cat=CAT1, IrqGtmATOMSR3Cat=CAT1
          IrqGtmATOMPrioConfig: IrqGtmATOMSR0Prio=0, IrqGtmATOMSR1Prio=0, IrqGtmATOMSR2Prio=0, IrqGtmATOMSR3Prio=0
          IrqGtmATOMTosConfig: IrqGtmATOMSR0Tos=CPU0, IrqGtmATOMSR1Tos=CPU0, IrqGtmATOMSR2Tos=CPU0, IrqGtmATOMSR3Tos=CPU0
        Irq_GtmATOM9_Config
          IrqGtmATOMCatConfig: IrqGtmATOMSR0Cat=CAT1, IrqGtmATOMSR1Cat=CAT1, IrqGtmATOMSR2Cat=CAT1, IrqGtmATOMSR3Cat=CAT1
          IrqGtmATOMPrioConfig: IrqGtmATOMSR0Prio=0, IrqGtmATOMSR1Prio=0, IrqGtmATOMSR2Prio=0, IrqGtmATOMSR3Prio=0
          IrqGtmATOMTosConfig: IrqGtmATOMSR0Tos=CPU0, IrqGtmATOMSR1Tos=CPU0, IrqGtmATOMSR2Tos=CPU0, IrqGtmATOMSR3Tos=CPU0
      Irq_GtmBRC_Config
        Irq_GtmBRCCat_Config: Irq_GtmBRC_Cat=CAT1
        Irq_GtmBRCPrio_Config: Irq_GtmBRC_Prio=0
        Irq_GtmBRCTos_Config: IrqGtmBRCTos=CPU0
      Irq_GtmCMP_Config
        Irq_GtmCMPCat_Config: Irq_GtmCMP_Cat=CAT1
        Irq_GtmCMPPrio_Config: Irq_GtmCMP_Prio=0
        Irq_GtmCMPTos_Config: Irq_GtmCMP_Tos=CPU0
      27 x Irq_GtmDPLL_Config, all with Irq_GtmDPLLSR_Cat=CAT1, Irq_GtmDPLLSR_Prio=0, Irq_GtmDPLLSR_Tos=CPU0:
        Irq_GtmDPLLSR0_Config
        Irq_GtmDPLLSR{10..19}_Config
        Irq_GtmDPLLSR1_Config
        Irq_GtmDPLLSR{20..26}_Config
        Irq_GtmDPLLSR{2..9}_Config
      Irq_GtmERR_Config
        Irq_GtmERRCat_Config: Irq_GtmERRSR_Cat=CAT1
        Irq_GtmERRPrio_Config: Irq_GtmERRSR_Prio=0
        Irq_GtmERRTos_Config: IrqGtmERRSRTos=CPU0
      Irq_GtmMCSW_Config
        IrqGtmMCSWCatConfig:
          IrqGtmMCSW{0..9}Cat = CAT1
        IrqGtmMCSWPrioConfig:
          IrqGtmMCSW{0..9}Prio = 0
        IrqGtmMCSWTosConfig:
          IrqGtmMCSW{0..9}Tos = CPU0
      10 x Irq_GtmMCS_Config:
        Irq_GtmMCS0_Config
          IrqGtmMCSCatConfig:
            IrqGtmMCSSR{0..7}Cat = CAT1
          IrqGtmMCSPrioConfig:
            IrqGtmMCSSR{0..7}Prio = 0
          IrqGtmMCSTosConfig:
            IrqGtmMCSSR{0..7}Tos = CPU0
        Irq_GtmMCS1_Config
          IrqGtmMCSCatConfig:
            IrqGtmMCSSR{0..7}Cat = CAT1
          IrqGtmMCSPrioConfig:
            IrqGtmMCSSR{0..7}Prio = 0
          IrqGtmMCSTosConfig:
            IrqGtmMCSSR{0..7}Tos = CPU0
        Irq_GtmMCS2_Config
          IrqGtmMCSCatConfig:
            IrqGtmMCSSR{0..7}Cat = CAT1
          IrqGtmMCSPrioConfig:
            IrqGtmMCSSR{0..7}Prio = 0
          IrqGtmMCSTosConfig:
            IrqGtmMCSSR{0..7}Tos = CPU0
        Irq_GtmMCS3_Config
          IrqGtmMCSCatConfig:
            IrqGtmMCSSR{0..7}Cat = CAT1
          IrqGtmMCSPrioConfig:
            IrqGtmMCSSR{0..7}Prio = 0
          IrqGtmMCSTosConfig:
            IrqGtmMCSSR{0..7}Tos = CPU0
        Irq_GtmMCS4_Config
          IrqGtmMCSCatConfig:
            IrqGtmMCSSR{0..7}Cat = CAT1
          IrqGtmMCSPrioConfig:
            IrqGtmMCSSR{0..7}Prio = 0
          IrqGtmMCSTosConfig:
            IrqGtmMCSSR{0..7}Tos = CPU0
        Irq_GtmMCS5_Config
          IrqGtmMCSCatConfig:
            IrqGtmMCSSR{0..7}Cat = CAT1
          IrqGtmMCSPrioConfig:
            IrqGtmMCSSR{0..7}Prio = 0
          IrqGtmMCSTosConfig:
            IrqGtmMCSSR{0..7}Tos = CPU0
        Irq_GtmMCS6_Config
          IrqGtmMCSCatConfig:
            IrqGtmMCSSR{0..7}Cat = CAT1
          IrqGtmMCSPrioConfig:
            IrqGtmMCSSR{0..7}Prio = 0
          IrqGtmMCSTosConfig:
            IrqGtmMCSSR{0..7}Tos = CPU0
        Irq_GtmMCS7_Config
          IrqGtmMCSCatConfig:
            IrqGtmMCSSR{0..7}Cat = CAT1
          IrqGtmMCSPrioConfig:
            IrqGtmMCSSR{0..7}Prio = 0
          IrqGtmMCSTosConfig:
            IrqGtmMCSSR{0..7}Tos = CPU0
        Irq_GtmMCS8_Config
          IrqGtmMCSCatConfig:
            IrqGtmMCSSR{0..7}Cat = CAT1
          IrqGtmMCSPrioConfig:
            IrqGtmMCSSR{0..7}Prio = 0
          IrqGtmMCSTosConfig:
            IrqGtmMCSSR{0..7}Tos = CPU0
        Irq_GtmMCS9_Config
          IrqGtmMCSCatConfig:
            IrqGtmMCSSR{0..7}Cat = CAT1
          IrqGtmMCSPrioConfig:
            IrqGtmMCSSR{0..7}Prio = 0
          IrqGtmMCSTosConfig:
            IrqGtmMCSSR{0..7}Tos = CPU0
      Irq_GtmPSM0_Config
        Irq_GtmPSM0Cat_Config:
          Irq_GtmPSM0SR{0..7}_Cat = CAT1
        Irq_GtmPSM0Prio_Config:
          IrqGtmPSM0SR0Prio = 0
          Irq_GtmPSM0SR{1..7}_Prio = 0
        Irq_GtmPSM0Tos_Config:
          IrqGtmPSM0SR0Tos = CPU0
          Irq_GtmPSM0SR{1..7}_Tos = CPU0
      Irq_GtmPSM1_Config
        Irq_GtmPSM1Cat_Config:
          Irq_GtmPSM1SR{0..7}_Cat = CAT1
        Irq_GtmPSM1Prio_Config:
          IrqGtmPSM1SR0Prio = 0
          Irq_GtmPSM1SR{1..7}_Prio = 0
        Irq_GtmPSM1Tos_Config:
          IrqGtmPSM1SR0Tos = CPU0
          Irq_GtmPSM1SR{1..7}_Tos = CPU0
      Irq_GtmPSM2_Config
        Irq_GtmPSM2Cat_Config:
          Irq_GtmPSM2SR{0..7}_Cat = CAT1
        Irq_GtmPSM2Prio_Config:
          IrqGtmPSM2SR0Prio = 0
          Irq_GtmPSM2SR{1..7}_Prio = 0
        Irq_GtmPSM2Tos_Config:
          IrqGtmPSM2SR0Tos = CPU0
          Irq_GtmPSM2SR{1..7}_Tos = CPU0
      Irq_GtmSPE_Config
        Irq_GtmSPECat_Config: Irq_GtmSPE0_Cat=CAT1, Irq_GtmSPE1_Cat=CAT1, Irq_GtmSPE2_Cat=CAT1, Irq_GtmSPE3_Cat=CAT1, Irq_GtmSPE4_Cat=CAT1, Irq_GtmSPE5_Cat=CAT1
        Irq_GtmSPEPrio_Config: Irq_GtmSPE0_Prio=0, Irq_GtmSPE1_Prio=0, Irq_GtmSPE2_Prio=0, Irq_GtmSPE3_Prio=0, Irq_GtmSPE4_Prio=0, Irq_GtmSPE5_Prio=0
        Irq_GtmSPETos_Config: Irq_GtmSPE0_Tos=CPU0, Irq_GtmSPE1_Tos=CPU0, Irq_GtmSPE2_Tos=CPU0, Irq_GtmSPE3_Tos=CPU0, Irq_GtmSPE4_Tos=CPU0, Irq_GtmSPE5_Tos=CPU0
      8 x Irq_GtmTIM_Config:
        Irq_GtmTIM0_Config
          IrqGtmTIMCatConfig:
            IrqGtmTIMSR{0..7}Cat = CAT1
          IrqGtmTIMPrioConfig:
            IrqGtmTIMSR{0..7}Prio = 0
          IrqGtmTIMTosConfig:
            IrqGtmTIMSR{0..7}Tos = CPU0
        Irq_GtmTIM1_Config
          IrqGtmTIMCatConfig:
            IrqGtmTIMSR{0..7}Cat = CAT1
          IrqGtmTIMPrioConfig:
            IrqGtmTIMSR{0..7}Prio = 0
          IrqGtmTIMTosConfig:
            IrqGtmTIMSR{0..7}Tos = CPU0
        Irq_GtmTIM2_Config
          IrqGtmTIMCatConfig:
            IrqGtmTIMSR{0..7}Cat = CAT1
          IrqGtmTIMPrioConfig:
            IrqGtmTIMSR{0..7}Prio = 0
          IrqGtmTIMTosConfig:
            IrqGtmTIMSR{0..7}Tos = CPU0
        Irq_GtmTIM3_Config
          IrqGtmTIMCatConfig:
            IrqGtmTIMSR{0..7}Cat = CAT1
          IrqGtmTIMPrioConfig:
            IrqGtmTIMSR{0..7}Prio = 0
          IrqGtmTIMTosConfig:
            IrqGtmTIMSR{0..7}Tos = CPU0
        Irq_GtmTIM4_Config
          IrqGtmTIMCatConfig:
            IrqGtmTIMSR{0..7}Cat = CAT1
          IrqGtmTIMPrioConfig:
            IrqGtmTIMSR{0..7}Prio = 0
          IrqGtmTIMTosConfig:
            IrqGtmTIMSR{0..7}Tos = CPU0
        Irq_GtmTIM5_Config
          IrqGtmTIMCatConfig:
            IrqGtmTIMSR{0..7}Cat = CAT1
          IrqGtmTIMPrioConfig:
            IrqGtmTIMSR{0..7}Prio = 0
          IrqGtmTIMTosConfig:
            IrqGtmTIMSR{0..7}Tos = CPU0
        Irq_GtmTIM6_Config
          IrqGtmTIMCatConfig:
            IrqGtmTIMSR{0..7}Cat = CAT1
          IrqGtmTIMPrioConfig:
            IrqGtmTIMSR{0..7}Prio = 0
          IrqGtmTIMTosConfig:
            IrqGtmTIMSR{0..7}Tos = CPU0
        Irq_GtmTIM7_Config
          IrqGtmTIMCatConfig:
            IrqGtmTIMSR{0..7}Cat = CAT1
          IrqGtmTIMPrioConfig:
            IrqGtmTIMSR{0..7}Prio = 0
          IrqGtmTIMTosConfig:
            IrqGtmTIMSR{0..7}Tos = CPU0
      6 x Irq_GtmTOM_Config:
        Irq_GtmTOM0_Config
          IrqGtmTOMCatConfig:
            IrqGtmTOMSR{0..7}Cat = CAT1
          IrqGtmTOMPrioConfig:
            IrqGtmTOMSR{0..7}Prio = 0
          IrqGtmTOMTosConfig:
            IrqGtmTOMSR{0..7}Tos = CPU0
        Irq_GtmTOM1_Config
          IrqGtmTOMCatConfig:
            IrqGtmTOMSR{0..7}Cat = CAT1
          IrqGtmTOMPrioConfig:
            IrqGtmTOMSR{0..7}Prio = 0
          IrqGtmTOMTosConfig:
            IrqGtmTOMSR{0..7}Tos = CPU0
        Irq_GtmTOM2_Config
          IrqGtmTOMCatConfig:
            IrqGtmTOMSR{0..7}Cat = CAT1
          IrqGtmTOMPrioConfig:
            IrqGtmTOMSR{0..7}Prio = 0
          IrqGtmTOMTosConfig:
            IrqGtmTOMSR{0..7}Tos = CPU0
        Irq_GtmTOM3_Config
          IrqGtmTOMCatConfig:
            IrqGtmTOMSR{0..7}Cat = CAT1
          IrqGtmTOMPrioConfig:
            IrqGtmTOMSR{0..7}Prio = 0
          IrqGtmTOMTosConfig:
            IrqGtmTOMSR{0..7}Tos = CPU0
        Irq_GtmTOM4_Config
          IrqGtmTOMCatConfig:
            IrqGtmTOMSR{0..7}Cat = CAT1
          IrqGtmTOMPrioConfig:
            IrqGtmTOMSR{0..7}Prio = 0
          IrqGtmTOMTosConfig:
            IrqGtmTOMSR{0..7}Tos = CPU0
        Irq_GtmTOM5_Config
          IrqGtmTOMCatConfig:
            IrqGtmTOMSR{0..7}Cat = CAT1
          IrqGtmTOMPrioConfig:
            IrqGtmTOMSR{0..7}Prio = 0
          IrqGtmTOMTosConfig:
            IrqGtmTOMSR{0..7}Tos = CPU0
    IrqHsslConfig_0 (IrqHsslConfig)
      IrqHssl0Config
        IrqHssl0CatConfig
          IrqHssl0COKCatConfig: IrqHssl0COK_0Cat=CAT1, IrqHssl0COK_1Cat=CAT1, IrqHssl0COK_2Cat=CAT1, IrqHssl0COK_3Cat=CAT1
          IrqHssl0ERRCatConfig: IrqHssl0ERR_0Cat=CAT1, IrqHssl0ERR_1Cat=CAT1, IrqHssl0ERR_2Cat=CAT1, IrqHssl0ERR_3Cat=CAT1
          IrqHssl0EXICatConfig: IrqHssl0EXICat=CAT1
          IrqHssl0RDICatConfig: IrqHssl0RDI_0Cat=CAT1, IrqHssl0RDI_1Cat=CAT1, IrqHssl0RDI_2Cat=CAT1, IrqHssl0RDI_3Cat=CAT1
          IrqHssl0TRGCatConfig: IrqHssl0TRG_0Cat=CAT1, IrqHssl0TRG_1Cat=CAT1, IrqHssl0TRG_2Cat=CAT1, IrqHssl0TRG_3Cat=CAT1
        IrqHssl0PrioConfig
          IrqHssl0COKPrioConfig: IrqHssl0COK_0Prio=0, IrqHssl0COK_1Prio=0, IrqHssl0COK_2Prio=0, IrqHssl0COK_3Prio=0
          IrqHssl0ERRPrioConfig: IrqHssl0ERR_0Prio=0, IrqHssl0ERR_1Prio=0, IrqHssl0ERR_2Prio=0, IrqHssl0ERR_3Prio=0
          IrqHssl0EXIPrioConfig: IrqHssl0EXIPrio=0
          IrqHssl0RDIPrioConfig: IrqHssl0RDI_0Prio=0, IrqHssl0RDI_1Prio=0, IrqHssl0RDI_2Prio=0, IrqHssl0RDI_3Prio=0
          IrqHssl0TRGPrioConfig: IrqHssl0TRG_0Prio=0, IrqHssl0TRG_1Prio=0, IrqHssl0TRG_2Prio=0, IrqHssl0TRG_3Prio=0
        IrqHssl0TosConfig
          IrqHssl0COKTosConfig: IrqHssl0COK_0Tos=CPU0, IrqHssl0COK_1Tos=CPU0, IrqHssl0COK_2Tos=CPU0, IrqHssl0COK_3Tos=CPU0
          IrqHssl0ERRTosConfig: IrqHssl0ERR_0Tos=CPU0, IrqHssl0ERR_1Tos=CPU0, IrqHssl0ERR_2Tos=CPU0, IrqHssl0ERR_3Tos=CPU0
          IrqHssl0EXITosConfig: IrqHssl0EXITos=CPU0
          IrqHssl0RDITosConfig: IrqHssl0RDI_0Tos=CPU0, IrqHssl0RDI_1Tos=CPU0, IrqHssl0RDI_2Tos=CPU0, IrqHssl0RDI_3Tos=CPU0
          IrqHssl0TRGTosConfig: IrqHssl0TRG_0Tos=CPU0, IrqHssl0TRG_1Tos=CPU0, IrqHssl0TRG_2Tos=CPU0, IrqHssl0TRG_3Tos=CPU0
      IrqHssl1Config
        IrqHssl1CatConfig
          IrqHssl1COKCatConfig: IrqHssl1COK_0Cat=CAT1, IrqHssl1COK_1Cat=CAT1, IrqHssl1COK_2Cat=CAT1, IrqHssl1COK_3Cat=CAT1
          IrqHssl1ERRCatConfig: IrqHssl1ERR_0Cat=CAT1, IrqHssl1ERR_1Cat=CAT1, IrqHssl1ERR_2Cat=CAT1, IrqHssl1ERR_3Cat=CAT1
          IrqHssl1EXICatConfig: IrqHssl1EXICat=CAT1
          IrqHssl1RDICatConfig: IrqHssl1RDI_0Cat=CAT1, IrqHssl1RDI_1Cat=CAT1, IrqHssl1RDI_2Cat=CAT1, IrqHssl1RDI_3Cat=CAT1
          IrqHssl1TRGCatConfig: IrqHssl1TRG_0Cat=CAT1, IrqHssl1TRG_1Cat=CAT1, IrqHssl1TRG_2Cat=CAT1, IrqHssl1TRG_3Cat=CAT1
        IrqHssl1PrioConfig
          IrqHssl1COKPrioConfig: IrqHssl1COK_0Prio=0, IrqHssl1COK_1Prio=0, IrqHssl1COK_2Prio=0, IrqHssl1COK_3Prio=0
          IrqHssl1ERRPrioConfig: IrqHssl1ERR_0Prio=0, IrqHssl1ERR_1Prio=0, IrqHssl1ERR_2Prio=0, IrqHssl1ERR_3Prio=0
          IrqHssl1EXIPrioConfig: IrqHssl1EXIPrio=0
          IrqHssl1RDIPrioConfig: IrqHssl1RDI_0Prio=0, IrqHssl1RDI_1Prio=0, IrqHssl1RDI_2Prio=0, IrqHssl1RDI_3Prio=0
          IrqHssl1TRGPrioConfig: IrqHssl1TRG_0Prio=0, IrqHssl1TRG_1Prio=0, IrqHssl1TRG_2Prio=0, IrqHssl1TRG_3Prio=0
        IrqHssl1TosConfig
          IrqHssl1COKTosConfig: IrqHssl1COK_0Tos=CPU0, IrqHssl1COK_1Tos=CPU0, IrqHssl1COK_2Tos=CPU0, IrqHssl1COK_3Tos=CPU0
          IrqHssl1ERRTosConfig: IrqHssl1ERR_0Tos=CPU0, IrqHssl1ERR_1Tos=CPU0, IrqHssl1ERR_2Tos=CPU0, IrqHssl1ERR_3Tos=CPU0
          IrqHssl1EXITosConfig: IrqHssl1EXITos=CPU0
          IrqHssl1RDITosConfig: IrqHssl1RDI_0Tos=CPU0, IrqHssl1RDI_1Tos=CPU0, IrqHssl1RDI_2Tos=CPU0, IrqHssl1RDI_3Tos=CPU0
          IrqHssl1TRGTosConfig: IrqHssl1TRG_0Tos=CPU0, IrqHssl1TRG_1Tos=CPU0, IrqHssl1TRG_2Tos=CPU0, IrqHssl1TRG_3Tos=CPU0
    IrqI2cConfig_0 (IrqI2cConfig)
      IrqI2cCatConfig
        IrqI2cDtrCatConfig: IrqI2c0DtrCat=CAT1, IrqI2c1DtrCat=CAT1
        IrqI2cErrCatConfig: IrqI2c0ErrCat=CAT1, IrqI2c1ErrCat=CAT1
        IrqI2cPCatConfig: IrqI2c0PCat=CAT1, IrqI2c1PCat=CAT1
      IrqI2cPrioConfig
        IrqI2cDtrPrioConfig: IrqI2c0DtrPrio=0, IrqI2c1DtrPrio=0
        IrqI2cErrPrioConfig: IrqI2c0ErrPrio=0, IrqI2c1ErrPrio=0
        IrqI2cPPrioConfig: IrqI2c0PPrio=0, IrqI2c1PPrio=0
      IrqI2cTosConfig
        IrqI2cDtrTosConfig: IrqI2c0DtrTos=CPU0, IrqI2c1DtrTos=CPU0
        IrqI2cErrTosConfig: IrqI2c0ErrTos=CPU0, IrqI2c1ErrTos=CPU0
        IrqI2cPTosConfig: IrqI2c0PTos=CPU0, IrqI2c1PTos=CPU0
    IrqQSPIConfig_0 (IrqQSPIConfig)
      IrqQspiCatConfig
        IrqQspiErrCatConfig: IrqQspi0ErrCat=CAT1, IrqQspi1ErrCat=CAT1, IrqQspi2ErrCat=CAT1, IrqQspi3ErrCat=CAT1, IrqQspi4ErrCat=CAT1, IrqQspi5ErrCat=CAT1
        IrqQspiHCCatConfig: IrqQspi2HCCat=CAT1, IrqQspi3HCCat=CAT1
        IrqQspiPTCatConfig: IrqQspi0PTCat=CAT1, IrqQspi1PTCat=CAT1, IrqQspi2PTCat=CAT1, IrqQspi3PTCat=CAT1, IrqQspi4PTCat=CAT1, IrqQspi5PTCat=CAT1
        IrqQspiRxCatConfig: IrqQspi0RxCat=CAT1, IrqQspi1RxCat=CAT1, IrqQspi2RxCat=CAT1, IrqQspi3RxCat=CAT1, IrqQspi4RxCat=CAT1, IrqQspi5RxCat=CAT1
        IrqQspiTxCatConfig: IrqQspi0TxCat=CAT1, IrqQspi1TxCat=CAT1, IrqQspi2TxCat=CAT1, IrqQspi3TxCat=CAT1, IrqQspi4TxCat=CAT1, IrqQspi5TxCat=CAT1
        IrqQspiUDCatConfig: IrqQspi0UDCat=CAT1, IrqQspi1UDCat=CAT1, IrqQspi2UDCat=CAT1, IrqQspi3UDCat=CAT1, IrqQspi4UDCat=CAT1, IrqQspi5UDCat=CAT1
      IrqQspiPrioConfig
        IrqQspiErrPrioConfig: IrqQspi0ErrPrio=0, IrqQspi1ErrPrio=0, IrqQspi2ErrPrio=0, IrqQspi3ErrPrio=0, IrqQspi4ErrPrio=0, IrqQspi5ErrPrio=0
        IrqQspiHCPrioConfig: IrqQspi2HCPrio=0, IrqQspi3HCPrio=0
        IrqQspiPTPrioConfig: IrqQspi0PTPrio=0, IrqQspi1PTPrio=0, IrqQspi2PTPrio=0, IrqQspi3PTPrio=0, IrqQspi4PTPrio=0, IrqQspi5PTPrio=0
        IrqQspiRxPrioConfig: IrqQspi0RxPrio=0, IrqQspi1RxPrio=0, IrqQspi2RxPrio=0, IrqQspi3RxPrio=0, IrqQspi4RxPrio=0, IrqQspi5RxPrio=0
        IrqQspiTxPrioConfig: IrqQspi0TxPrio=0, IrqQspi1TxPrio=0, IrqQspi2TxPrio=0, IrqQspi3TxPrio=0, IrqQspi4TxPrio=0, IrqQspi5TxPrio=0
        IrqQspiUDPrioConfig: IrqQspi0UDPrio=0, IrqQspi1UDPrio=0, IrqQspi2UDPrio=0, IrqQspi3UDPrio=0, IrqQspi4UDPrio=0, IrqQspi5UDPrio=0
      IrqQspiTosConfig
        IrqQspiErrTosConfig: IrqQspi0ErrTos=CPU0, IrqQspi1ErrTos=CPU0, IrqQspi2ErrTos=CPU0, IrqQspi3ErrTos=CPU0, IrqQspi4ErrTos=CPU0, IrqQspi5ErrTos=CPU0
        IrqQspiHCTosConfig: IrqQspi2HCTos=CPU0, IrqQspi3HCTos=CPU0
        IrqQspiPTTosConfig: IrqQspi0PTTos=CPU0, IrqQspi1PTTos=CPU0, IrqQspi2PTTos=CPU0, IrqQspi3PTTos=CPU0, IrqQspi4PTTos=CPU0, IrqQspi5PTTos=CPU0
        IrqQspiRxTosConfig: IrqQspi0RxTos=CPU0, IrqQspi1RxTos=CPU0, IrqQspi2RxTos=CPU0, IrqQspi3RxTos=CPU0, IrqQspi4RxTos=CPU0, IrqQspi5RxTos=CPU0
        IrqQspiTxTosConfig: IrqQspi0TxTos=CPU0, IrqQspi1TxTos=CPU0, IrqQspi2TxTos=CPU0, IrqQspi3TxTos=CPU0, IrqQspi4TxTos=CPU0, IrqQspi5TxTos=CPU0
        IrqQspiUDTosConfig: IrqQspi0UDTos=CPU0, IrqQspi1UDTos=CPU0, IrqQspi2UDTos=CPU0, IrqQspi3UDTos=CPU0, IrqQspi4UDTos=CPU0, IrqQspi5UDTos=CPU0
    IrqScuConfig_0 (IrqScuConfig)
      Irq_ScuCat_Config: Irq_ScuEruSR0_Cat=CAT1, Irq_ScuEruSR1_Cat=CAT1, Irq_ScuEruSR2_Cat=CAT1, Irq_ScuEruSR3_Cat=CAT1
      Irq_ScuPrio_Config: Irq_ScuEruSR0_Prio=0, Irq_ScuEruSR1_Prio=0, Irq_ScuEruSR2_Prio=0, Irq_ScuEruSR3_Prio=0
      Irq_ScuTos_Config: Irq_ScuEruSR0_Tos=CPU0, Irq_ScuEruSR1_Tos=CPU0, Irq_ScuEruSR2_Tos=CPU0, Irq_ScuEruSR3_Tos=CPU0
    IrqSentConfig_0 (IrqSentConfig)
      IrqSentCatConfig:
        IrqSentSR{0..9}Cat = CAT1
      IrqSentPrioConfig:
        IrqSentSR{0..9}Prio = 0
      IrqSentTosConfig:
        IrqSentSR{0..9}Tos = CPU0
    IrqStmConfig_0 (IrqStmConfig)
      IrqStm0Config
        IrqStm0CatConfig: IrqStm0SR0Cat=CAT1, IrqStm0SR1Cat=CAT1
        IrqStm0PrioConfig: IrqStm0SR0Prio=0, IrqStm0SR1Prio=0
        IrqStm0TosConfig: IrqStm0SR0Tos=CPU0, IrqStm0SR1Tos=CPU0
      IrqStm1Config
        IrqStm1CatConfig: IrqStm1SR0Cat=CAT1, IrqStm1SR1Cat=CAT1
        IrqStm1PrioConfig: IrqStm1SR0Prio=0, IrqStm1SR1Prio=0
        IrqStm1TosConfig: IrqStm1SR0Tos=CPU0, IrqStm1SR1Tos=CPU0
      IrqStm2Config
        IrqStm2CatConfig: IrqStm2SR0Cat=CAT1, IrqStm2SR1Cat=CAT1
        IrqStm2PrioConfig: IrqStm2SR0Prio=0, IrqStm2SR1Prio=0
        IrqStm2TosConfig: IrqStm2SR0Tos=CPU0, IrqStm2SR1Tos=CPU0
      IrqStm3Config
        IrqStm3CatConfig: IrqStm3SR0Cat=CAT1, IrqStm3SR1Cat=CAT1
        IrqStm3PrioConfig: IrqStm3SR0Prio=0, IrqStm3SR1Prio=0
        IrqStm3TosConfig: IrqStm3SR0Tos=CPU0, IrqStm3SR1Tos=CPU0
      IrqStm4Config
        IrqStm4CatConfig: IrqStm4SR0Cat=CAT1, IrqStm4SR1Cat=CAT1
        IrqStm4PrioConfig: IrqStm4SR0Prio=0, IrqStm4SR1Prio=0
        IrqStm4TosConfig: IrqStm4SR0Tos=CPU0, IrqStm4SR1Tos=CPU0
      IrqStm5Config
        IrqStm5CatConfig: IrqStm5SR0Cat=CAT1, IrqStm5SR1Cat=CAT1
        IrqStm5PrioConfig: IrqStm5SR0Prio=0, IrqStm5SR1Prio=0
        IrqStm5TosConfig: IrqStm5SR0Tos=CPU0, IrqStm5SR1Tos=CPU0
package /Mcu
  module config Mcu: implementation-config-variant=VARIANT-POST-BUILD
    CommonPublishedInformation:
      ArMajorVersion = 4
      ArMinorVersion = 4
      ArPatchVersion = 0
      ModuleId = 101
      Release = _TRICORE_TC397
      SwMajorVersion = 20
      SwMinorVersion = 25
      SwPatchVersion = 0
      VendorId = 17
    McuGeneralConfiguration:
      McuCcu60SleepModeEnabled = 0
      McuCcu61SleepModeEnabled = 0
      McuClearColdResetStatusApi = 0
      McuClockSourceFailureNotification = 0
      McuDevErrorDetect = 1
      McuGetRamStateApi = 0
      McuGpt12SleepModeEnabled = 0
      McuGtmSleepModeEnabled = 0
      McuIdleModeCpuCore = INDIVIDUAL_IDLE_CORES_SEL0
      McuIfxCpuCcuconApi = 0
      McuIfxDeInitApi = 0
      McuIfxLpmApi = 0
      McuIfxTrapApi = 0
      McuInitCheckApi = 0
      McuInitClock = 1
      McuInitDeInitApiMode = MCU_MCAL_SUPERVISOR
      McuMainOscillatorFrequency = 20
      McuMultiCoreErrorDetect = 1
      McuNoPll = 0
      McuOscAmpRegulationEnable = 0
      McuOscCapacitance{0..3}Enable = 0
      McuOscillatorMode = EXT_CRYSTAL_CERAMIC_RES_MODE_SEL0
      McuPerformResetApi = 1
      McuRuntimeApiMode = MCU_MCAL_SUPERVISOR
      McuSafetyEnable = 0
      McuStandbyEntryMode = STANDBY_ENTRY_REQ_SLEEP_SEL0
      McuSysClkFrequency = 20
      McuSystemModeCpuCore = CPU_SYSTEM_CORE0_SEL0
      McuVersionInfoApi = 0
    McuHardwareResourceAllocationConf_0 (McuHardwareResourceAllocationConf)
      12 x McuAscLinAllocationConf:
        McuAscLinAllocationConf_0
          McuAscLinChannelAllocationConf: McuAscLinChannelAllocationConf=ASCLIN_CH_NOT_USED, McuAscLinKernelId=ASCLIN0
        McuAscLinAllocationConf_1
          McuAscLinChannelAllocationConf: McuAscLinChannelAllocationConf=ASCLIN_CH_NOT_USED, McuAscLinKernelId=ASCLIN0
        McuAscLinAllocationConf_10
          McuAscLinChannelAllocationConf: McuAscLinChannelAllocationConf=ASCLIN_CH_NOT_USED, McuAscLinKernelId=ASCLIN0
        McuAscLinAllocationConf_11
          McuAscLinChannelAllocationConf: McuAscLinChannelAllocationConf=ASCLIN_CH_NOT_USED, McuAscLinKernelId=ASCLIN0
        McuAscLinAllocationConf_2
          McuAscLinChannelAllocationConf: McuAscLinChannelAllocationConf=ASCLIN_CH_NOT_USED, McuAscLinKernelId=ASCLIN0
        McuAscLinAllocationConf_3
          McuAscLinChannelAllocationConf: McuAscLinChannelAllocationConf=ASCLIN_CH_NOT_USED, McuAscLinKernelId=ASCLIN0
        McuAscLinAllocationConf_4
          McuAscLinChannelAllocationConf: McuAscLinChannelAllocationConf=ASCLIN_CH_NOT_USED, McuAscLinKernelId=ASCLIN0
        McuAscLinAllocationConf_5
          McuAscLinChannelAllocationConf: McuAscLinChannelAllocationConf=ASCLIN_CH_NOT_USED, McuAscLinKernelId=ASCLIN0
        McuAscLinAllocationConf_6
          McuAscLinChannelAllocationConf: McuAscLinChannelAllocationConf=ASCLIN_CH_NOT_USED, McuAscLinKernelId=ASCLIN0
        McuAscLinAllocationConf_7
          McuAscLinChannelAllocationConf: McuAscLinChannelAllocationConf=ASCLIN_CH_NOT_USED, McuAscLinKernelId=ASCLIN0
        McuAscLinAllocationConf_8
          McuAscLinChannelAllocationConf: McuAscLinChannelAllocationConf=ASCLIN_CH_NOT_USED, McuAscLinKernelId=ASCLIN0
        McuAscLinAllocationConf_9
          McuAscLinChannelAllocationConf: McuAscLinChannelAllocationConf=ASCLIN_CH_NOT_USED, McuAscLinKernelId=ASCLIN0
      McuCcu6ModuleAllocationConf_0 (McuCcu6ModuleAllocationConf): McuCcu6ModuleAllocationConf=CCU6_MODULE_NOT_USED
      McuCcu6ModuleAllocationConf_1 (McuCcu6ModuleAllocationConf): McuCcu6ModuleAllocationConf=CCU6_MODULE_NOT_USED
      McuEruAllocationConf_0 (McuEruAllocationConf)
        8 x McuEruChannelInputLineConf, all with McuEruChannelInputLineConf=ERU_CHANNEL_INP_NOT_USED:
          McuEruChannelInputLineConf_{0..7}
        8 x McuEruChannelOutputUnitConf, all with McuEruChannelOutputUnitConf=ERU_CHANNEL_OUT_NOT_USED:
          McuEruChannelOutputUnitConf_{0..7}
      5 x McuGpt12ModuleAllocationConf, all with McuGpt12ModuleAllocationConf=GPT_TIMER_NOT_USED:
        McuGpt12ModuleAllocationConf_0: McuGpt12TimerAllocation=GPT_TIMER_2
        McuGpt12ModuleAllocationConf_1: McuGpt12TimerAllocation=GPT_TIMER_3
        McuGpt12ModuleAllocationConf_2: McuGpt12TimerAllocation=GPT_TIMER_4
        McuGpt12ModuleAllocationConf_3: McuGpt12TimerAllocation=GPT_TIMER_5
        McuGpt12ModuleAllocationConf_4: McuGpt12TimerAllocation=GPT_TIMER_6
      McuGtmAllocationConf_0 (McuGtmAllocationConf)
        12 x McuGtmAtomAllocationConf:
          McuGtmAtomAllocationConf_0
            8 x McuGtmAtomChannelAllocationConf, all with McuAtomChannelEventHandledByDsadc=0, McuGtmAtomChannelAllocationConf=GTM_ATOM_CHANNEL_NOT_USED:
              McuGtmAtomChannelAllocationConf_{0..7}
          McuGtmAtomAllocationConf_1
            8 x McuGtmAtomChannelAllocationConf, all with McuAtomChannelEventHandledByDsadc=0, McuGtmAtomChannelAllocationConf=GTM_ATOM_CHANNEL_NOT_USED:
              McuGtmAtomChannelAllocationConf_{0..7}
          McuGtmAtomAllocationConf_10
            8 x McuGtmAtomChannelAllocationConf, all with McuAtomChannelEventHandledByDsadc=0, McuGtmAtomChannelAllocationConf=GTM_ATOM_CHANNEL_NOT_USED:
              McuGtmAtomChannelAllocationConf_{0..7}
          McuGtmAtomAllocationConf_11
            8 x McuGtmAtomChannelAllocationConf, all with McuAtomChannelEventHandledByDsadc=0, McuGtmAtomChannelAllocationConf=GTM_ATOM_CHANNEL_NOT_USED:
              McuGtmAtomChannelAllocationConf_{0..7}
          McuGtmAtomAllocationConf_2
            8 x McuGtmAtomChannelAllocationConf, all with McuAtomChannelEventHandledByDsadc=0, McuGtmAtomChannelAllocationConf=GTM_ATOM_CHANNEL_NOT_USED:
              McuGtmAtomChannelAllocationConf_{0..7}
          McuGtmAtomAllocationConf_3
            8 x McuGtmAtomChannelAllocationConf, all with McuAtomChannelEventHandledByDsadc=0, McuGtmAtomChannelAllocationConf=GTM_ATOM_CHANNEL_NOT_USED:
              McuGtmAtomChannelAllocationConf_{0..7}
          McuGtmAtomAllocationConf_4
            8 x McuGtmAtomChannelAllocationConf, all with McuAtomChannelEventHandledByDsadc=0, McuGtmAtomChannelAllocationConf=GTM_ATOM_CHANNEL_NOT_USED:
              McuGtmAtomChannelAllocationConf_{0..7}
          McuGtmAtomAllocationConf_5
            8 x McuGtmAtomChannelAllocationConf, all with McuAtomChannelEventHandledByDsadc=0, McuGtmAtomChannelAllocationConf=GTM_ATOM_CHANNEL_NOT_USED:
              McuGtmAtomChannelAllocationConf_{0..7}
          McuGtmAtomAllocationConf_6
            8 x McuGtmAtomChannelAllocationConf, all with McuAtomChannelEventHandledByDsadc=0, McuGtmAtomChannelAllocationConf=GTM_ATOM_CHANNEL_NOT_USED:
              McuGtmAtomChannelAllocationConf_{0..7}
          McuGtmAtomAllocationConf_7
            8 x McuGtmAtomChannelAllocationConf, all with McuAtomChannelEventHandledByDsadc=0, McuGtmAtomChannelAllocationConf=GTM_ATOM_CHANNEL_NOT_USED:
              McuGtmAtomChannelAllocationConf_{0..7}
          McuGtmAtomAllocationConf_8
            8 x McuGtmAtomChannelAllocationConf, all with McuAtomChannelEventHandledByDsadc=0, McuGtmAtomChannelAllocationConf=GTM_ATOM_CHANNEL_NOT_USED:
              McuGtmAtomChannelAllocationConf_{0..7}
          McuGtmAtomAllocationConf_9
            8 x McuGtmAtomChannelAllocationConf, all with McuAtomChannelEventHandledByDsadc=0, McuGtmAtomChannelAllocationConf=GTM_ATOM_CHANNEL_NOT_USED:
              McuGtmAtomChannelAllocationConf_{0..7}
        8 x McuGtmTimAllocationConf:
          McuGtmTimAllocationConf_0
            8 x McuGtmTimChannelAllocationConf, all with McuGtmTimChannelAllocationConf=GTM_TIM_CHANNEL_NOT_USED:
              McuGtmTimChannelAllocationConf_{0..7}
          McuGtmTimAllocationConf_1
            8 x McuGtmTimChannelAllocationConf, all with McuGtmTimChannelAllocationConf=GTM_TIM_CHANNEL_NOT_USED:
              McuGtmTimChannelAllocationConf_{0..7}
          McuGtmTimAllocationConf_2
            8 x McuGtmTimChannelAllocationConf, all with McuGtmTimChannelAllocationConf=GTM_TIM_CHANNEL_NOT_USED:
              McuGtmTimChannelAllocationConf_{0..7}
          McuGtmTimAllocationConf_3
            8 x McuGtmTimChannelAllocationConf, all with McuGtmTimChannelAllocationConf=GTM_TIM_CHANNEL_NOT_USED:
              McuGtmTimChannelAllocationConf_{0..7}
          McuGtmTimAllocationConf_4
            8 x McuGtmTimChannelAllocationConf, all with McuGtmTimChannelAllocationConf=GTM_TIM_CHANNEL_NOT_USED:
              McuGtmTimChannelAllocationConf_{0..7}
          McuGtmTimAllocationConf_5
            8 x McuGtmTimChannelAllocationConf, all with McuGtmTimChannelAllocationConf=GTM_TIM_CHANNEL_NOT_USED:
              McuGtmTimChannelAllocationConf_{0..7}
          McuGtmTimAllocationConf_6
            8 x McuGtmTimChannelAllocationConf, all with McuGtmTimChannelAllocationConf=GTM_TIM_CHANNEL_NOT_USED:
              McuGtmTimChannelAllocationConf_{0..7}
          McuGtmTimAllocationConf_7
            8 x McuGtmTimChannelAllocationConf, all with McuGtmTimChannelAllocationConf=GTM_TIM_CHANNEL_NOT_USED:
              McuGtmTimChannelAllocationConf_{0..7}
        6 x McuGtmTomAllocationConf:
          McuGtmTomAllocationConf_0
            16 x McuGtmTomChannelAllocationConf, all with McuGtmTomChannelAllocationConf=GTM_TOM_CHANNEL_NOT_USED, McuTomChannelEventHandledByDsadc=0:
              McuGtmTomChannelAllocationConf_0
              McuGtmTomChannelAllocationConf_1
              McuGtmTomChannelAllocationConf_{10..15}
              McuGtmTomChannelAllocationConf_{2..9}
          McuGtmTomAllocationConf_1
            16 x McuGtmTomChannelAllocationConf, all with McuGtmTomChannelAllocationConf=GTM_TOM_CHANNEL_NOT_USED, McuTomChannelEventHandledByDsadc=0:
              McuGtmTomChannelAllocationConf_0
              McuGtmTomChannelAllocationConf_1
              McuGtmTomChannelAllocationConf_{10..15}
              McuGtmTomChannelAllocationConf_{2..9}
          McuGtmTomAllocationConf_2
            16 x McuGtmTomChannelAllocationConf, all with McuGtmTomChannelAllocationConf=GTM_TOM_CHANNEL_NOT_USED, McuTomChannelEventHandledByDsadc=0:
              McuGtmTomChannelAllocationConf_0
              McuGtmTomChannelAllocationConf_1
              McuGtmTomChannelAllocationConf_{10..15}
              McuGtmTomChannelAllocationConf_{2..9}
          McuGtmTomAllocationConf_3
            16 x McuGtmTomChannelAllocationConf, all with McuGtmTomChannelAllocationConf=GTM_TOM_CHANNEL_NOT_USED, McuTomChannelEventHandledByDsadc=0:
              McuGtmTomChannelAllocationConf_0
              McuGtmTomChannelAllocationConf_1
              McuGtmTomChannelAllocationConf_{10..15}
              McuGtmTomChannelAllocationConf_{2..9}
          McuGtmTomAllocationConf_4
            16 x McuGtmTomChannelAllocationConf, all with McuGtmTomChannelAllocationConf=GTM_TOM_CHANNEL_NOT_USED, McuTomChannelEventHandledByDsadc=0:
              McuGtmTomChannelAllocationConf_0
              McuGtmTomChannelAllocationConf_1
              McuGtmTomChannelAllocationConf_{10..15}
              McuGtmTomChannelAllocationConf_{2..9}
          McuGtmTomAllocationConf_5
            16 x McuGtmTomChannelAllocationConf, all with McuGtmTomChannelAllocationConf=GTM_TOM_CHANNEL_NOT_USED, McuTomChannelEventHandledByDsadc=0:
              McuGtmTomChannelAllocationConf_0
              McuGtmTomChannelAllocationConf_1
              McuGtmTomChannelAllocationConf_{10..15}
              McuGtmTomChannelAllocationConf_{2..9}
      6 x McuStmAllocationConf, all with McuStmCmp0RegAllocationConf=STM_CMP0_NOT_USED, McuStmCmp1RegAllocationConf=STM_CMP1_NOT_USED:
        McuStmAllocationConf_{0..5}
    McuModuleConfiguration: McuClockSrcFailureNotification=DISABLED, McuNumberOfMcuModes=1, McuRamSectors=0
      GtmGlobalConfiguration_0 (GtmGlobalConfiguration)
        12 x GtmAtomGlobalConf:
          GtmAtomGlobalConf_0
            8 x GtmAtomChannelConf, all with GtmAtomChInternalTriggerEnable=0, GtmAtomChResetCn0OnTriggerEnable=0, GtmTimerPortPinSelect=NONE:
              GtmAtomChannelConf_{0..7}
            GtmAtomGroupConf
              GtmAtomActionTimeBaseUnitConf: GtmAtomActionTimeBaseSelection=ATOM_ACT_TB_TBU_TS0, GtmAtomActionTimeBaseValue=1
          GtmAtomGlobalConf_1
            8 x GtmAtomChannelConf, all with GtmAtomChInternalTriggerEnable=0, GtmAtomChResetCn0OnTriggerEnable=0, GtmTimerPortPinSelect=NONE:
              GtmAtomChannelConf_{0..7}
            GtmAtomGroupConf
              GtmAtomActionTimeBaseUnitConf: GtmAtomActionTimeBaseSelection=ATOM_ACT_TB_TBU_TS0, GtmAtomActionTimeBaseValue=1
          GtmAtomGlobalConf_10
            8 x GtmAtomChannelConf, all with GtmAtomChInternalTriggerEnable=0, GtmAtomChResetCn0OnTriggerEnable=0, GtmTimerPortPinSelect=NONE:
              GtmAtomChannelConf_{0..7}
            GtmAtomGroupConf
              GtmAtomActionTimeBaseUnitConf: GtmAtomActionTimeBaseSelection=ATOM_ACT_TB_TBU_TS0, GtmAtomActionTimeBaseValue=1
          GtmAtomGlobalConf_11
            8 x GtmAtomChannelConf, all with GtmAtomChInternalTriggerEnable=0, GtmAtomChResetCn0OnTriggerEnable=0, GtmTimerPortPinSelect=NONE:
              GtmAtomChannelConf_{0..7}
            GtmAtomGroupConf
              GtmAtomActionTimeBaseUnitConf: GtmAtomActionTimeBaseSelection=ATOM_ACT_TB_TBU_TS0, GtmAtomActionTimeBaseValue=1
          GtmAtomGlobalConf_2
            8 x GtmAtomChannelConf, all with GtmAtomChInternalTriggerEnable=0, GtmAtomChResetCn0OnTriggerEnable=0, GtmTimerPortPinSelect=NONE:
              GtmAtomChannelConf_{0..7}
            GtmAtomGroupConf
              GtmAtomActionTimeBaseUnitConf: GtmAtomActionTimeBaseSelection=ATOM_ACT_TB_TBU_TS0, GtmAtomActionTimeBaseValue=1
          GtmAtomGlobalConf_3
            8 x GtmAtomChannelConf, all with GtmAtomChInternalTriggerEnable=0, GtmAtomChResetCn0OnTriggerEnable=0, GtmTimerPortPinSelect=NONE:
              GtmAtomChannelConf_{0..7}
            GtmAtomGroupConf
              GtmAtomActionTimeBaseUnitConf: GtmAtomActionTimeBaseSelection=ATOM_ACT_TB_TBU_TS0, GtmAtomActionTimeBaseValue=1
          GtmAtomGlobalConf_4
            8 x GtmAtomChannelConf, all with GtmAtomChInternalTriggerEnable=0, GtmAtomChResetCn0OnTriggerEnable=0, GtmTimerPortPinSelect=NONE:
              GtmAtomChannelConf_{0..7}
            GtmAtomGroupConf
              GtmAtomActionTimeBaseUnitConf: GtmAtomActionTimeBaseSelection=ATOM_ACT_TB_TBU_TS0, GtmAtomActionTimeBaseValue=1
          GtmAtomGlobalConf_5
            8 x GtmAtomChannelConf, all with GtmAtomChInternalTriggerEnable=0, GtmAtomChResetCn0OnTriggerEnable=0, GtmTimerPortPinSelect=NONE:
              GtmAtomChannelConf_{0..7}
            GtmAtomGroupConf
              GtmAtomActionTimeBaseUnitConf: GtmAtomActionTimeBaseSelection=ATOM_ACT_TB_TBU_TS0, GtmAtomActionTimeBaseValue=1
          GtmAtomGlobalConf_6
            8 x GtmAtomChannelConf, all with GtmAtomChInternalTriggerEnable=0, GtmAtomChResetCn0OnTriggerEnable=0, GtmTimerPortPinSelect=NONE:
              GtmAtomChannelConf_{0..7}
            GtmAtomGroupConf
              GtmAtomActionTimeBaseUnitConf: GtmAtomActionTimeBaseSelection=ATOM_ACT_TB_TBU_TS0, GtmAtomActionTimeBaseValue=1
          GtmAtomGlobalConf_7
            8 x GtmAtomChannelConf, all with GtmAtomChInternalTriggerEnable=0, GtmAtomChResetCn0OnTriggerEnable=0, GtmTimerPortPinSelect=NONE:
              GtmAtomChannelConf_{0..7}
            GtmAtomGroupConf
              GtmAtomActionTimeBaseUnitConf: GtmAtomActionTimeBaseSelection=ATOM_ACT_TB_TBU_TS0, GtmAtomActionTimeBaseValue=1
          GtmAtomGlobalConf_8
            8 x GtmAtomChannelConf, all with GtmAtomChInternalTriggerEnable=0, GtmAtomChResetCn0OnTriggerEnable=0, GtmTimerPortPinSelect=NONE:
              GtmAtomChannelConf_{0..7}
            GtmAtomGroupConf
              GtmAtomActionTimeBaseUnitConf: GtmAtomActionTimeBaseSelection=ATOM_ACT_TB_TBU_TS0, GtmAtomActionTimeBaseValue=1
          GtmAtomGlobalConf_9
            8 x GtmAtomChannelConf, all with GtmAtomChInternalTriggerEnable=0, GtmAtomChResetCn0OnTriggerEnable=0, GtmTimerPortPinSelect=NONE:
              GtmAtomChannelConf_{0..7}
            GtmAtomGroupConf
              GtmAtomActionTimeBaseUnitConf: GtmAtomActionTimeBaseSelection=ATOM_ACT_TB_TBU_TS0, GtmAtomActionTimeBaseValue=1
        12 x GtmClusterConf, all with GtmCmuClusterInputClockDividerEnable=CLS_CLK_CFG_ENABLED_WITH_DIV_SEL2:
          GtmClusterConf_0
            GtmClusterConfClockSetting:
              GtmClusterConfClock{0..7}Src = CMU_CONF_CLOCK{0..7}_SEL0
            GtmClusterFixedClockSetting: GtmClusterFixedClockSrc=CMU_FIXED_CLOCK0_SEL0
          GtmClusterConf_1
            GtmClusterConfClockSetting:
              GtmClusterConfClock{0..7}Src = CMU_CONF_CLOCK{0..7}_SEL0
            GtmClusterFixedClockSetting: GtmClusterFixedClockSrc=CMU_FIXED_CLOCK0_SEL0
          GtmClusterConf_10
            GtmClusterConfClockSetting:
              GtmClusterConfClock{0..7}Src = CMU_CONF_CLOCK{0..7}_SEL0
            GtmClusterFixedClockSetting: GtmClusterFixedClockSrc=CMU_FIXED_CLOCK0_SEL0
          GtmClusterConf_11
            GtmClusterConfClockSetting:
              GtmClusterConfClock{0..7}Src = CMU_CONF_CLOCK{0..7}_SEL0
            GtmClusterFixedClockSetting: GtmClusterFixedClockSrc=CMU_FIXED_CLOCK0_SEL0
          GtmClusterConf_2
            GtmClusterConfClockSetting:
              GtmClusterConfClock{0..7}Src = CMU_CONF_CLOCK{0..7}_SEL0
            GtmClusterFixedClockSetting: GtmClusterFixedClockSrc=CMU_FIXED_CLOCK0_SEL0
          GtmClusterConf_3
            GtmClusterConfClockSetting:
              GtmClusterConfClock{0..7}Src = CMU_CONF_CLOCK{0..7}_SEL0
            GtmClusterFixedClockSetting: GtmClusterFixedClockSrc=CMU_FIXED_CLOCK0_SEL0
          GtmClusterConf_4
            GtmClusterConfClockSetting:
              GtmClusterConfClock{0..7}Src = CMU_CONF_CLOCK{0..7}_SEL0
            GtmClusterFixedClockSetting: GtmClusterFixedClockSrc=CMU_FIXED_CLOCK0_SEL0
          GtmClusterConf_5
            GtmClusterConfClockSetting:
              GtmClusterConfClock{0..7}Src = CMU_CONF_CLOCK{0..7}_SEL0
            GtmClusterFixedClockSetting: GtmClusterFixedClockSrc=CMU_FIXED_CLOCK0_SEL0
          GtmClusterConf_6
            GtmClusterConfClockSetting:
              GtmClusterConfClock{0..7}Src = CMU_CONF_CLOCK{0..7}_SEL0
            GtmClusterFixedClockSetting: GtmClusterFixedClockSrc=CMU_FIXED_CLOCK0_SEL0
          GtmClusterConf_7
            GtmClusterConfClockSetting:
              GtmClusterConfClock{0..7}Src = CMU_CONF_CLOCK{0..7}_SEL0
            GtmClusterFixedClockSetting: GtmClusterFixedClockSrc=CMU_FIXED_CLOCK0_SEL0
          GtmClusterConf_8
            GtmClusterConfClockSetting:
              GtmClusterConfClock{0..7}Src = CMU_CONF_CLOCK{0..7}_SEL0
            GtmClusterFixedClockSetting: GtmClusterFixedClockSrc=CMU_FIXED_CLOCK0_SEL0
          GtmClusterConf_9
            GtmClusterConfClockSetting:
              GtmClusterConfClock{0..7}Src = CMU_CONF_CLOCK{0..7}_SEL0
            GtmClusterFixedClockSetting: GtmClusterFixedClockSrc=CMU_FIXED_CLOCK0_SEL0
        4 x GtmTbuChannelConf, all with GtmTbuChClockSourceSelection=CMU_CLOCK0_SEL0, GtmTbuChMode=FREE_RUNNING_COUNTER_SEL0, GtmTbuChModuloCntrSel=TBU_CH1_SEL0, GtmTbuChResolutionSel=TBU_CH_LOWER_COUNT_BITS_SEL0, GtmTbuChannelEnable=0:
          GtmTbuChannelConf_{0..3}
        8 x GtmTimGlobalConf:
          GtmTimGlobalConf_0
            8 x GtmTimChannelConf, all with GtmTimInpPortPinSel=SEL0_NONE:
              GtmTimChannelConf_{0..7}
          GtmTimGlobalConf_1
            8 x GtmTimChannelConf, all with GtmTimInpPortPinSel=SEL0_NONE:
              GtmTimChannelConf_{0..7}
          GtmTimGlobalConf_2
            8 x GtmTimChannelConf, all with GtmTimInpPortPinSel=SEL0_NONE:
              GtmTimChannelConf_{0..7}
          GtmTimGlobalConf_3
            8 x GtmTimChannelConf, all with GtmTimInpPortPinSel=SEL0_NONE:
              GtmTimChannelConf_{0..7}
          GtmTimGlobalConf_4
            8 x GtmTimChannelConf, all with GtmTimInpPortPinSel=SEL0_NONE:
              GtmTimChannelConf_{0..7}
          GtmTimGlobalConf_5
            8 x GtmTimChannelConf, all with GtmTimInpPortPinSel=SEL0_NONE:
              GtmTimChannelConf_{0..7}
          GtmTimGlobalConf_6
            8 x GtmTimChannelConf, all with GtmTimInpPortPinSel=SEL0_NONE:
              GtmTimChannelConf_{0..7}
          GtmTimGlobalConf_7
            8 x GtmTimChannelConf, all with GtmTimInpPortPinSel=SEL0_NONE:
              GtmTimChannelConf_{0..7}
        6 x GtmTomGlobalConf:
          GtmTomGlobalConf_0
            16 x GtmTomChannelConf, all with GtmTimerPortPinSelect=NONE, GtmTomChInternalTriggerEnable=0, GtmTomChResetCn0OnTriggerEnable=0:
              GtmTomChannelConf_0
              GtmTomChannelConf_1
              GtmTomChannelConf_{10..15}
              GtmTomChannelConf_{2..9}
            GtmTomGroupConf_0 (GtmTomGroupConf)
              GtmTomActionTimeBaseUnitConf: GtmTomActionTimeBaseSelection=TOM_ACT_TB_TBU_TS0, GtmTomActionTimeBaseValue=1
            GtmTomGroupConf_1 (GtmTomGroupConf)
              GtmTomActionTimeBaseUnitConf: GtmTomActionTimeBaseSelection=TOM_ACT_TB_TBU_TS0, GtmTomActionTimeBaseValue=1
          GtmTomGlobalConf_1
            16 x GtmTomChannelConf, all with GtmTimerPortPinSelect=NONE, GtmTomChInternalTriggerEnable=0, GtmTomChResetCn0OnTriggerEnable=0:
              GtmTomChannelConf_0
              GtmTomChannelConf_1
              GtmTomChannelConf_{10..15}
              GtmTomChannelConf_{2..9}
            GtmTomGroupConf_0 (GtmTomGroupConf)
              GtmTomActionTimeBaseUnitConf: GtmTomActionTimeBaseSelection=TOM_ACT_TB_TBU_TS0, GtmTomActionTimeBaseValue=1
            GtmTomGroupConf_1 (GtmTomGroupConf)
              GtmTomActionTimeBaseUnitConf: GtmTomActionTimeBaseSelection=TOM_ACT_TB_TBU_TS0, GtmTomActionTimeBaseValue=1
          GtmTomGlobalConf_2
            16 x GtmTomChannelConf, all with GtmTimerPortPinSelect=NONE, GtmTomChInternalTriggerEnable=0, GtmTomChResetCn0OnTriggerEnable=0:
              GtmTomChannelConf_0
              GtmTomChannelConf_1
              GtmTomChannelConf_{10..15}
              GtmTomChannelConf_{2..9}
            GtmTomGroupConf_0 (GtmTomGroupConf)
              GtmTomActionTimeBaseUnitConf: GtmTomActionTimeBaseSelection=TOM_ACT_TB_TBU_TS0, GtmTomActionTimeBaseValue=1
            GtmTomGroupConf_1 (GtmTomGroupConf)
              GtmTomActionTimeBaseUnitConf: GtmTomActionTimeBaseSelection=TOM_ACT_TB_TBU_TS0, GtmTomActionTimeBaseValue=1
          GtmTomGlobalConf_3
            16 x GtmTomChannelConf, all with GtmTimerPortPinSelect=NONE, GtmTomChInternalTriggerEnable=0, GtmTomChResetCn0OnTriggerEnable=0:
              GtmTomChannelConf_0
              GtmTomChannelConf_1
              GtmTomChannelConf_{10..15}
              GtmTomChannelConf_{2..9}
            GtmTomGroupConf_0 (GtmTomGroupConf)
              GtmTomActionTimeBaseUnitConf: GtmTomActionTimeBaseSelection=TOM_ACT_TB_TBU_TS0, GtmTomActionTimeBaseValue=1
            GtmTomGroupConf_1 (GtmTomGroupConf)
              GtmTomActionTimeBaseUnitConf: GtmTomActionTimeBaseSelection=TOM_ACT_TB_TBU_TS0, GtmTomActionTimeBaseValue=1
          GtmTomGlobalConf_4
            16 x GtmTomChannelConf, all with GtmTimerPortPinSelect=NONE, GtmTomChInternalTriggerEnable=0, GtmTomChResetCn0OnTriggerEnable=0:
              GtmTomChannelConf_0
              GtmTomChannelConf_1
              GtmTomChannelConf_{10..15}
              GtmTomChannelConf_{2..9}
            GtmTomGroupConf_0 (GtmTomGroupConf)
              GtmTomActionTimeBaseUnitConf: GtmTomActionTimeBaseSelection=TOM_ACT_TB_TBU_TS0, GtmTomActionTimeBaseValue=1
            GtmTomGroupConf_1 (GtmTomGroupConf)
              GtmTomActionTimeBaseUnitConf: GtmTomActionTimeBaseSelection=TOM_ACT_TB_TBU_TS0, GtmTomActionTimeBaseValue=1
          GtmTomGlobalConf_5
            16 x GtmTomChannelConf, all with GtmTimerPortPinSelect=NONE, GtmTomChInternalTriggerEnable=0, GtmTomChResetCn0OnTriggerEnable=0:
              GtmTomChannelConf_0
              GtmTomChannelConf_1
              GtmTomChannelConf_{10..15}
              GtmTomChannelConf_{2..9}
            GtmTomGroupConf_0 (GtmTomGroupConf)
              GtmTomActionTimeBaseUnitConf: GtmTomActionTimeBaseSelection=TOM_ACT_TB_TBU_TS0, GtmTomActionTimeBaseValue=1
            GtmTomGroupConf_1 (GtmTomGroupConf)
              GtmTomActionTimeBaseUnitConf: GtmTomActionTimeBaseSelection=TOM_ACT_TB_TBU_TS0, GtmTomActionTimeBaseValue=1
        12 x GtmTriggerForAdc, all with GtmAdcTrigger0Select=TRIG_0_NO_TRIGGER, GtmAdcTrigger1Select=TRIG_0_NO_TRIGGER, GtmAdcTrigger2Select=TRIG_0_NO_TRIGGER, GtmAdcTrigger3Select=TRIG_0_NO_TRIGGER, GtmAdcTrigger4Select=TRIG_0_NO_TRIGGER:
          GtmTriggerForAdc_0
          GtmTriggerForAdc_1
          GtmTriggerForAdc_10
          GtmTriggerForAdc_11
          GtmTriggerForAdc_{2..9}
        6 x GtmTriggerForDsadc, all with GtmDsadcTrigger0Select=TRIG_0_NO_TRIGGER, GtmDsadcTrigger1Select=TRIG_0_NO_TRIGGER, GtmDsadcTrigger2Select=TRIG_0_NO_TRIGGER, GtmDsadcTrigger3Select=TRIG_0_NO_TRIGGER:
          GtmTriggerForDsadc_{0..5}
        McuGtmClockManagementConf: GtmCmuGlobalClockDenominator=1, GtmCmuGlobalClockNumerator=1
          GtmConfigClockSetting:
            GtmCmuConfigClock0Div = 0
            GtmCmuConfigClock0Enable = 1
            GtmCmuConfigClock1Div = 0
            GtmCmuConfigClock1Enable = 1
            GtmCmuConfigClock2Div = 0
            GtmCmuConfigClock2Enable = 1
            GtmCmuConfigClock3Div = 0
            GtmCmuConfigClock3Enable = 1
            GtmCmuConfigClock4Div = 0
            GtmCmuConfigClock4Enable = 1
            GtmCmuConfigClock5Div = 0
            GtmCmuConfigClock5Enable = 1
            GtmCmuConfigClock6Div = 0
            GtmCmuConfigClock6Enable = 1
            GtmCmuConfigClock7Div = 0
            GtmCmuConfigClock7Enable = 1
          GtmExtClockSetting:
            GtmCmuExtClock0Denominator = 1
            GtmCmuExtClock0Enable = 0
            GtmCmuExtClock0Numerator = 1
            GtmCmuExtClock1Denominator = 1
            GtmCmuExtClock1Enable = 0
            GtmCmuExtClock1Numerator = 1
            GtmCmuExtClock2Denominator = 1
            GtmCmuExtClock2Enable = 0
            GtmCmuExtClock2Numerator = 1
          GtmFixedClockSetting: GtmCmuFixedClockEnable=1, GtmCmuFixedClockSel=CMU_GLOBAL_CLOCK_SEL0
      McuClockSettingConfig_0 (McuClockSettingConfig): McuClockSettingId=0
        McuClockReferencePoint_GETH (McuClockReferencePoint): McuClockRefSelection=MCU_CPU0_FREQUENCY, McuClockReferencePointFrequency=1.0E8
        McuClockReferencePointConfig
          McuClockMonitorConfig:
            McuBackupClockMonEnable = 0
            McuBackupClockRangeMonEnable = 0
            McuPll{0..2}ClockMonEnable = 0
            McuSpbClockMonEnable = 0
          McuExternalClockOutputConfig:
            McuExtClock0Enable = 0
            McuExtClock1Enable = 0
            McuExtClock1Inverted = 0
            McuExtClockOutSel0 = FOUT_EXT_CLOCK0_SEL0
            McuExtClockOutSel1 = FOUT_EXT_CLOCK1_SEL0
            McuFoutClockDiv = 1
          McuPeripheralPllSettingConfig:
            McuClockReferencePointFrequency1 = 1.6E8
            McuClockReferencePointFrequency2 = 2.0E8
            McuFreqSource1ClockDivSelect = DIV_FACTOR_2_BYPASSED_SEL1
            McuPerPllK2DivStepDownChangeDelay = 10
            McuPerPllK2DivStepUpChangeDelay = 10
            McuPerPllK3DivStepDownChangeDelay = 10
            McuPerPllK3DivStepUpChangeDelay = 10
            McuPeripheralPllK2Divider = 3
            McuPeripheralPllK3Divider = 1
            McuPeripheralPllNDivider = 31
            McuPeripheralPllPDivider = 0
            McuPll2DivSelect = MCU_K3_DIV_FACTOR_NOT_BYPASSED_SEL0
          McuPllDistributionSettingConfig:
            McuAdasFrequency = 0.0
            McuAdcFrequency = 1.6E8
            McuAscLinFastFrequency = 2.0E8
            McuAscLinSlowClockSourceSelection = ASCLINS_CLOCK_SOURCE_DISABLED_SEL0
            McuAscLinSlowFrequency = 2.0E7
            McuBBBFrequency = 1.5E8
            McuCPU{0..5}Frequency = 3.0E8
            McuClockDistributionInpClockSel = PLL_INPUT_CLOCK_SRC_SELECT_SEL1
            McuConvCtrlPhaseSynchConf = PHASE_SYNCH_CONST_ACTIVE_SEL0
            McuEbuClkEnable = 1
            McuEbuFrequency = 1.6E8
            McuErayClkEnable = 0
            McuErayFrequency = 8.0E7
            McuFSI2Frequency = 3.0E8
            McuFSIFrequency = 1.0E8
            McuGEthFrequency = 1.0E8
            McuGTMFrequency = 2.0E8
            McuHsctFrequency = 3.2E8
            McuHspdm160Frequency = 1.6E8
            McuHspdm320Frequency = 1.6E8
            McuHspdmClkEnable = 1
            McuI2CFrequency = 1.0E8
            McuLowPowerDivValue = LOW_POWER_DIVIDER_DISABLE_SEL0
            McuMCanClockSourceSelection = MCAN_CLOCK_SOURCE_MCANI_SEL1
            McuMCanFrequency = 4.0E7
            McuMcanHFrequency = 1.0E8
            McuMscClockSourceSelection = MSC_CLOCK_SOURCE_DISABLED_SEL0
            McuMscFrequency = 0.0
            McuQspiClockSourceSelection = QSPI_CLOCK_SOURCE_DISABLED_SEL0
            McuQspiFrequency = 1.0E8
            McuReferenceFrequency1 = 1.25E7
            McuReferenceFrequency2 = 6666667.0
            McuSPBFrequency = 1.0E8
            McuSRIFrequency = 3.0E8
            McuSTMFrequency = 1.0E8
          McuSystemPllSettingConfig:
            McuClockReferencePointFrequency0 = 3.0E8
            McuFMPllModAmp = 1.25
            McuFmPllEnable = 0
            McuPllInputSrcSelection = OSC_CLOCK_SRC_SELECT_SEL1
            McuSysPllK2DivStepDownChangeDelay = 10
            McuSysPllK2DivStepUpChangeDelay = 10
            McuSystemPllK2Divider = 1
            McuSystemPllNDivider = 29
            McuSystemPllPDivider = 0
      McuEruGlobalConf: McuEruInputFilterRegVal=0
      McuGpt12PrescalerConf: Gpt1BlockPrescalerSel=GPT1_BLOCK_NOT_USED, Gpt2BlockPrescalerSel=GPT2_BLOCK_NOT_USED
      McuModeSettingConf_0 (McuModeSettingConf): McuEvrcLPMOnSleepReqEnable=0, McuMode=0
        McuStdbyModeSettingConf:
          McuStdbyModeBlankingFilterDelay = DELAY_0_MS_SEL0
          McuStdbyModeClkSelection = SCR_CLOCK_SEL0
          McuStdbyModeESR0TriStateEnable = 0
          McuStdbyModePORSTFilterEnable = 0
          McuStdbyModePortTriStateEnable = 0
          McuStdbyModeRamEnable = MCU_STANDBYRAM_DISABLED_SEL0
          McuStdbyModeWakeupFromEVR = 0
          McuStdbyModeWakeupFromPORST = 1
          McuStdbyModeWakeupFromSCR = 0
          McuStdbyModeESR0Conf: McuStdbyModeESR0EdgeDetection=ESR0_TRIG_RISING_EDGE_SEL1, McuStdbyModeESR0FltEnable=0, McuStdbyModeESR0WakeupEnable=0
          McuStdbyModeESR1Conf: McuStdbyModeESR1EdgeDetection=ESR1_TRIG_RISING_EDGE_SEL1, McuStdbyModeESR1FltEnable=0, McuStdbyModeESR1WakeupEnable=0
          McuStdbyModePinAConf: McuStdbyModePinAEdgeDetection=PINA_TRIG_RISING_EDGE_SEL1, McuStdbyModePinAFltEnable=0, McuStdbyModePinAWakeupEnable=0
          McuStdbyModePinBConf: McuStdbyModePinBEdgeDetection=PINB_TRIG_RISING_EDGE_SEL1, McuStdbyModePinBFltEnable=0, McuStdbyModePinBWakeupEnable=0
          McuStdbyModeVddVextConf:
            McuStdbyModeEntryOnVDDRampDown = 0
            McuStdbyModeEntryOnVEXTRampDown = 0
            McuStdbyModeVddUMMonMode = VDD_UV_MON_MODE_SEL2
            McuStdbyModeVddUVThres = 184
            McuStdbyModeVextUMMonMode = VEXT_UV_MON_MODE_SEL2
            McuStdbyModeVextUVThres = 117
          McuStdbyModeWakeupTimerConf:
            McuStdbyModeWakeupTimerClkDiv = WUT_70KHZ_NO_DIV_CLK_SEL0
            McuStdbyModeWakeupTimerEnable = 0
            McuStdbyModeWakeupTimerMode = WUT_AUTO_RELOAD_MODE_SEL0
            McuStdbyModeWakeupTimerValue = 16777215
      McuResetSettingConf:
        McuESR0ResetConf = MCU_ESR0_NO_RESET_SEL0
        McuESR1ResetConf = MCU_ESR1_NO_RESET_SEL0
        McuSMUResetConf = MCU_SMU_SYSTEM_RESET_SEL1
        McuSTM0ResetConf = MCU_STM0_NO_RESET_SEL0
        McuSTM0ResetOnApplResetEnable = 1
        McuSTM1ResetConf = MCU_STM1_NO_RESET_SEL0
        McuSTM1ResetOnApplResetEnable = 1
        McuSTM2ResetConf = MCU_STM2_NO_RESET_SEL0
        McuSTM2ResetOnApplResetEnable = 1
        McuSTM3ResetConf = MCU_STM3_NO_RESET_SEL0
        McuSTM3ResetOnApplResetEnable = 1
        McuSTM4ResetConf = MCU_STM4_NO_RESET_SEL0
        McuSTM4ResetOnApplResetEnable = 1
        McuSTM5ResetConf = MCU_STM5_NO_RESET_SEL0
        McuSTM5ResetOnApplResetEnable = 1
        McuSWResetConf = MCU_SW_SYSTEM_RESET_SEL1
      McuTrapSettingConf:
        McuCPU0ESR0TrapEnable = 0
        McuCPU0ESR1TrapEnable = 0
        McuCPU0SMUTrapEnable = 0
        McuCPU0Trap2Enable = 0
        McuCPU1ESR0TrapEnable = 0
        McuCPU1ESR1TrapEnable = 0
        McuCPU1SMUTrapEnable = 0
        McuCPU1Trap2Enable = 0
        McuCPU2ESR0TrapEnable = 0
        McuCPU2ESR1TrapEnable = 0
        McuCPU2SMUTrapEnable = 0
        McuCPU2Trap2Enable = 0
        McuCPU3ESR0TrapEnable = 0
        McuCPU3ESR1TrapEnable = 0
        McuCPU3SMUTrapEnable = 0
        McuCPU3Trap2Enable = 0
        McuCPU4ESR0TrapEnable = 0
        McuCPU4ESR1TrapEnable = 0
        McuCPU4SMUTrapEnable = 0
        McuCPU4Trap2Enable = 0
        McuCPU5ESR0TrapEnable = 0
        McuCPU5ESR1TrapEnable = 0
        McuCPU5SMUTrapEnable = 0
        McuCPU5Trap2Enable = 0
    McuPublishedInformation
      21 x McuResetReasonConf:
        MCU_CB0_RESET: McuResetReason=11
        MCU_CB1_RESET: McuResetReason=12
        MCU_CB3_RESET: McuResetReason=13
        MCU_ESR0_RESET: McuResetReason=0
        MCU_ESR1_RESET: McuResetReason=1
        MCU_EVR33_RESET: McuResetReason=15
        MCU_EVRC_RESET: McuResetReason=14
        MCU_LBIST_RESET: McuResetReason=18
        MCU_POWER_ON_RESET: McuResetReason=10
        MCU_RESET_MULTIPLE: McuResetReason=254
        MCU_RESET_UNDEFINED: McuResetReason=255
        MCU_SMU_RESET: McuResetReason=2
        MCU_STBYR_RESET: McuResetReason=17
        MCU_STM0_RESET: McuResetReason=4
        MCU_STM1_RESET: McuResetReason=5
        MCU_STM2_RESET: McuResetReason=6
        MCU_STM3_RESET: McuResetReason=7
        MCU_STM4_RESET: McuResetReason=8
        MCU_STM5_RESET: McuResetReason=9
        MCU_SUPPLY_WDOG_RESET: McuResetReason=16
        MCU_SW_RESET: McuResetReason=3
